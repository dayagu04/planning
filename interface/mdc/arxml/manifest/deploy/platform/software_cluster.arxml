AUTOSAR XML (schema 00048)
package /HuaweiMDC/UploadableSoftwarePackage
  software cluster MdcPlatform: category=ROOT_SOFTWARE_CLUSTER, diagnostic-extract=MdcDext, module-instantiation=IsoDoip, vendor-id=0, vendor-signature=MdcSignature, version=1.0.0.0
    diagnostic-addresss:
      address-semantics=PHYSICAL-ADDRESS, diagnostic-address=4120
      address-semantics=FUNCTIONAL-ADDRESS, diagnostic-address=58368
  crypto service certificate MdcSignature: algorithm-family=RSA, format=X-509, maximum-length=4096
