AUTOSAR XML (schema 00048)
package /HuaweiMDC/DiagnosticMdcExtractTemplate/DEM/DTCs/ExtendedDataRecords
  diagnostic extended data record extendDataRecord_1: record-number=1, trigger=TEST-FAILED, update=true
  diagnostic extended data record extendDataRecord_2: record-number=2, trigger=TEST-FAILED, update=true
package /HuaweiMDC/DiagnosticMdcExtractTemplate/DEM/DTCs/FreezeFrames
  diagnostic freeze frame snapshot1: record-number=1, trigger=TEST-FAILED, update=true
package /HuaweiMDC/DiagnosticMdcExtractTemplate/DEM/DTCs/DiagAgings
  diagnostic aging aging1: aging-cycles=opcycle_sleep_wakeup, threshold=100
package /HuaweiMDC/DiagnosticMdcExtractTemplate/DEM/OperationCylces
  diagnostic operation cycle opcycle_sleep_wakeup: automatic-end=false, cycle-autostart=false, cycle-status-storage=false, type=WARMUP
package /HuaweiMDC/DiagnosticMdcExtractTemplate/CommConfig
  diagnostic software cluster props DtcStatusAvailability: dtc-status-availability-mask=127
  diagnostic contribution set MdcDext
    common-properties aging-requires-tested-cycle=false, clear-dtc-limitation=ALL-SUPPORTED-DTCS, dtc-status-availability-mask=123, max-number-of-request-correctly-received-response-pending=3, memory-entry-storage-trigger=CONFIRMED, response-on-second-declined-request=false, status-bit-handling-test-failed-since-last-clear=STATUS-BIT-AGING-AND-DISPLACEMENT, type-of-dtc-supported=SAE-J-2012--DA, type-of-freeze-frame-record-numeration=CALCULATED:
      diagnostic debounce algorithm props debounceAlgorithm_noDebounce: debounce-behavior=FREEZE
        debounce-algorithm:
          diag event debounce monitor internal debounceAlgorithm_noDebounce
    elements:
      aging1
      AllSessionAccessPermission
      DefaultSession
      extendDataRecord_1
      extendDataRecord_2
      ExtendedSession
      NonDefaultSessionAccessPermission
      OnlyProgrammingSessionAccessPermission
      OnlyExtendedSessionAccessPermission
      ProgrammingSession
      snapshot1
      opcycle_sleep_wakeup
      DiagnosticDataIdentifier_0xd003
      DiagnosticDataIdentifier_0xd005
      NonProgrammingSessionAccessPermission
package /HuaweiMDC/DiagnosticMdcExtractTemplate/DCM/DignosticSessions
  diagnostic session DefaultSession: id=1, jump-to-boot-loader=NO-BOOT, p-2-server-max=0.05, p-2-star-server-max=5.0
  diagnostic session ExtendedSession: id=3, jump-to-boot-loader=NO-BOOT, p-2-server-max=0.05, p-2-star-server-max=5.0
  diagnostic session ProgrammingSession: id=2, jump-to-boot-loader=NO-BOOT, p-2-server-max=0.05, p-2-star-server-max=5.0
package /HuaweiMDC/DiagnosticMdcExtractTemplate/DCM/DIDs
  diagnostic data identifier DiagnosticDataIdentifier_0xd003: id=53251, did-size=1
    diagnostic-parameter bit-offset=0:
      diagnostic data element DiagnosticDataElement_0xd003
  diagnostic data identifier DiagnosticDataIdentifier_0xd005: id=53253, did-size=4
    diagnostic-parameter bit-offset=0:
      diagnostic data element DiagnosticDataElement_0xd005
package /HuaweiMDC/DiagnosticMdcExtractTemplate/DCM/AccessPermission
  5 x diagnostic access permission:
    AllSessionAccessPermission: diagnostic-session=[DefaultSession, ProgrammingSession, ExtendedSession]
    OnlyExtendedSessionAccessPermission: diagnostic-session=ExtendedSession
    NonDefaultSessionAccessPermission: diagnostic-session=[ProgrammingSession, ExtendedSession]
    OnlyProgrammingSessionAccessPermission: diagnostic-session=ProgrammingSession
    NonProgrammingSessionAccessPermission: diagnostic-session=[DefaultSession, ExtendedSession]
package /HuaweiMDC/DiagnosticMdcExtractTemplate/DCM/DiagClass
  diagnostic read data by identifier class readDidClass: access-permission-validity=ACCESS-PERMISSION-INSTANCE-OVERRIDES-CLASS, max-did-to-read=1024
  diagnostic write data by identifier class writeDidClass: access-permission-validity=ACCESS-PERMISSION-INSTANCE-OVERRIDES-CLASS
  diagnostic io control class ioCtrlClass: access-permission-validity=ACCESS-PERMISSION-INSTANCE-OVERRIDES-CLASS
  diagnostic routine control class routineClass: access-permission-validity=ACCESS-PERMISSION-INSTANCE-OVERRIDES-CLASS
