AUTOSAR XML (schema 00048)
package /HuaweiMDC/Ethernet
  ethernet cluster MdcSocAEthernetCluster
    4 x ethernet physical channel:
      InnerEthernetPhysicalChannel: comm-connectors=InnerEthernetCommConnector
        network endpoint InnerNetworkEndpoint
          network-endpoint-addresses:
            default-gateway=127.0.0.1, ipv-4-address=192.168.10.6, network-mask=255.255.255.0
            ipv-4-address=239.192.255.123
      SocInnerEthernetPhysicalChannel: comm-connectors=InnerEthernetCommConnector
        network endpoint SocInnerNetworkEndpoint
          network-endpoint-addresses:
            default-gateway=127.0.0.1, ipv-4-address=127.0.0.1, network-mask=255.255.255.0
            ipv-4-address=239.192.255.123
        vlan SocInnerNet: vlan-identifier=4093
      MdcExternEthernetPhysicalChannel: comm-connectors=MdcExternEthernetCommConnector
        network endpoint MdcExternNetworkEndpoint
          network-endpoint-addresses:
            default-gateway=127.0.0.1, ipv-4-address=192.168.62.11, network-mask=255.255.255.0
            ipv-4-address=239.0.0.255
        vlan MdcExternNet: vlan-identifier=62
      MultiSocAEthernetPhysicalChannel: comm-connectors=MultiSocAEthernetCommConnector
        network endpoint MultiSocANetworkEndpoint
          network-endpoint-addresses:
            default-gateway=127.0.0.1, ipv-4-address=192.168.2.12, network-mask=255.255.255.0
            ipv-4-address=239.0.0.255
        vlan MultiSocANet: vlan-identifier=20
package /HuaweiMDC/Machine
  machine MdcSocAMachine: default-application-timeout={enter-timeout-value=8.0, exit-timeout-value=8.0}, machine-design=MdcSocAMachineDesign, trusted-platform-executable-launch-behavior=MONITOR-MODE
    function-groups:
      mode declaration group prototype Access: type=Access
      mode declaration group prototype MachineState: type=MachineState
    module-instantiations:
      os module instantiation OS
        resource group ResourceLimit
      do ip instantiation IsoDoip: eid=2505430597752, entity-status-max-byte-field-use=true, gid=281474976710655, gid-invalidity-pattern=255, logical-address=4291, max-request-bytes=4194304, vin-invalidity-pattern=255
        do-ip-network-configuration eid-use-mac=true, is-activation-line-dependent=false, max-initial-vehicle-announcement-time=0.5, max-tester-connections=3, network-interface-id=0, tcp-alive-check-response-timeout=0.5, tcp-general-inactivity-time=300.0, tcp-initial-inactivity-time=2.0, vehicle-announcement-count=0, vehicle-announcement-interval=0.1, vehicle-identification-sync-status=false:
          network configuration IsoDoIpEth: communication-connector=InnerEthernetCommConnector, ipv-4-multicast-ip-address=239.2.0.1, tcp-port=13400, udp-port=13400
        request-configurations:
          end-address=32767, request-type=PHYSICAL, start-address=4096
          end-address=61439, request-type=FUNCTIONAL, start-address=58368
    processor Cpu
      processor core Processor0_Core0: core-id=0
      processor core Processor0_Core1: core-id=1
  machine design MdcSocAMachineDesign
    ethernet communication connector InnerEthernetCommConnector: unicast-network-endpoint=InnerNetworkEndpoint
    ethernet communication connector SocInnerEthernetCommConnector: unicast-network-endpoint=SocInnerNetworkEndpoint
    ethernet communication connector MdcExternEthernetCommConnector: unicast-network-endpoint=MdcExternNetworkEndpoint
    ethernet communication connector MultiSocAEthernetCommConnector: unicast-network-endpoint=MultiSocANetworkEndpoint
    service-discover-configs:
      multicast-sd-ip-address=InnerNetworkEndpoint, someip-service-discovery-port=30491
      multicast-sd-ip-address=SocInnerNetworkEndpoint, someip-service-discovery-port=30491
