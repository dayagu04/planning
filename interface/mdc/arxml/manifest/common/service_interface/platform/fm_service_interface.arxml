AUTOSAR XML (schema 00048)
package /HuaweiMDC/MdcPlatformServices/PlatformServiceInterface/DataTypes
  11 x std cpp implementation data type:
    FmFaultData: category=STRUCTURE
      namespaces:
        symbol props mdc
        symbol props fm
      11 x cpp implementation data type element:
        faultId: type-reference=UInt16
        faultObj: type-reference=UInt16
        phyCpuNo: type-reference=UInt8
        cpuCoreNo: type-reference=UInt8
        componentId: type-reference=UInt32
        type: type-reference=UInt8
        flag: type-reference=UInt32
        paraNum: type-reference=UInt8
        para: type-reference=FmParaArray
        clss: type-reference=UInt8
        time: type-reference=FmCharVec
    FmFaultDetail: category=STRUCTURE
      namespaces:
        symbol props mdc
        symbol props fm
      4 x cpp implementation data type element:
        faultData: type-reference=FmFaultData
        actionName: type-reference=String
        timePointFirst: type-reference=UInt64
        timePointLast: type-reference=UInt64
    FmFaultDetailVector: category=VECTOR, cpp-template-argument=FmFaultDetail
      namespaces:
        symbol props mdc
        symbol props fm
    FmParaArray: category=ARRAY, array-size=4, cpp-template-argument=Int64
      namespaces:
        symbol props mdc
        symbol props fm
    FmFaultFull: category=STRUCTURE
      namespaces:
        symbol props mdc
        symbol props fm
      17 x cpp implementation data type element:
        faultId: type-reference=UInt16
        faultObj: type-reference=UInt16
        phyCpuNo: type-reference=UInt8
        cpuCoreNo: type-reference=UInt8
        type: type-reference=UInt8
        clss: type-reference=UInt8
        level: type-reference=UInt8
        flag: type-reference=UInt32
        componentId: type-reference=UInt32
        count: type-reference=UInt32
        timeFirst: type-reference=String
        timeLast: type-reference=String
        para: type-reference=String
        desc: type-reference=String
        actionName: type-reference=String
        actionResult: type-reference=Int32
        subFaultVec: type-reference=FmStringVec
    FmStringVec: category=VECTOR, cpp-template-argument=String
      namespaces:
        symbol props mdc
        symbol props fm
    FmFaultFullVec: category=VECTOR, cpp-template-argument=FmFaultFull
      namespaces:
        symbol props mdc
        symbol props fm
    FmCharVec: category=VECTOR, cpp-template-argument=Int8
      namespaces:
        symbol props mdc
        symbol props fm
    FmFaultStatData: category=STRUCTURE
      namespaces:
        symbol props mdc
        symbol props fm
      7 x cpp implementation data type element:
        faultCnt: type-reference=UInt32
        faultClearCnt: type-reference=UInt32
        minTimeInvl: type-reference=UInt64
        maxTimeInvl: type-reference=UInt64
        avgTimeInvl: type-reference=Double
        alarmCnt: type-reference=UInt32
        alarmClearCnt: type-reference=UInt32
    FmMcuDataHeader: category=STRUCTURE
      namespaces:
        symbol props mdc
        symbol props fm
      5 x cpp implementation data type element:
        type: type-reference=uint8_t
        version: type-reference=uint8_t
        checkSum: type-reference=uint32_t
        seqId: type-reference=uint32_t
        sendTime: type-reference=uint64_t
    FmMcuDataRetInfo: category=STRUCTURE
      namespaces:
        symbol props mdc
        symbol props fm
      cpp implementation data type element type: type-reference=uint8_t
      cpp implementation data type element seqId: type-reference=uint32_t
      cpp implementation data type element retCode: type-reference=uint32_t
package /HuaweiMDC/MdcPlatformServices/PlatformServiceInterface/FmServiceInterface
  someip service interface deployment FmQueryServiceDeployment: service-interface-id=1088, service-interface-version={major-version=1, minor-version=0}
    4 x someip method deployment, all with transport-protocol=TCP:
      QueryFaultDetail_Someip: method-id=3
      QueryFaulOnFlag_Someip: method-id=4
      QueryFaultStatistic_Someip: method-id=5
      QuerySystemFaultStatus_Someip: method-id=6
  someip service interface deployment FmReportEventServiceInterfaceDeployment: service-interface-id=1089, service-interface-version={major-version=1, minor-version=0}
    someip method deployment ReportFault_Someip: method-id=3, transport-protocol=UDP
    someip method deployment ReportCheckPoint_Someip: method-id=4, transport-protocol=UDP
    someip method deployment ReportProcState_Someip: method-id=5, transport-protocol=UDP
  dds service interface deployment FmQueryServiceDdsDeployment: service-interface-id=1088
    4 x dds method deployment:
      QueryFaultDetail_Dds: dds-rpc-service=QueryFaultDetial_DdsRpc
      QueryFaultOnFlag_Dds: dds-rpc-service=QueryFaultOnFlag_DdsRpc
      QueryFaultStatistic_Dds: dds-rpc-service=QueryFaultStatistic_DdsRpc
      QuerySystemFaultStatus_Dds: dds-rpc-service=QuerySystemFaultStatus_DdsRpc
    4 x dds rpc service deployment:
      QueryFaultDetial_DdsRpc: reply-topic-name=ReplyQueryFaultDetailDdsRpc, request-topic-name=RequestQueryFaultDetailDdsRpc
      QueryFaultOnFlag_DdsRpc: reply-topic-name=ReplyQueryFaultOnFlagDdsRpc, request-topic-name=RequestQueryFaultOnFlagDdsRpc
      QueryFaultStatistic_DdsRpc: reply-topic-name=ReplyQueryFaultStatisticDdsRpc, request-topic-name=RequestQueryFaultStatisticDdsRpc
      QuerySystemFaultStatus_DdsRpc: reply-topic-name=ReplyQuerySystemFaultStatusDdsRpc, request-topic-name=RequestQuerySystemFaultStatusDdsRpc
  dds service interface deployment FmReportEventServiceDdsDeployment: service-interface-id=1089
    dds method deployment ReportFault_Dds: dds-rpc-service=ReportFault_DdsRpc
    dds method deployment ReportCheckPoint_Dds: dds-rpc-service=ReportCheckPoint_DdsRpc
    dds method deployment ReportProcState_Dds: dds-rpc-service=ReportProcState_DdsRpc
    dds rpc service deployment ReportFault_DdsRpc: reply-topic-name=ReplyReportFaultDdsRpc, request-topic-name=RequestReportFaultDdsRpc
    dds rpc service deployment ReportCheckPoint_DdsRpc: reply-topic-name=ReplyReportCheckPointDdsRpc, request-topic-name=RequestReportCheckPointDdsRpc
    dds rpc service deployment ReportProcState_DdsRpc: reply-topic-name=ReplyReportProcStateDdsRpc, request-topic-name=RequestReportProcStateDdsRpc
  someip service interface deployment FmTransMcuDataServiceInterfaceDeployment: service-interface-id=1090, service-interface-version={major-version=1, minor-version=0}
    someip method deployment ReportMcuData_Someip: method-id=1, transport-protocol=UDP
