AUTOSAR XML (schema 00048)
package /HuaweiMDC/MdcPlatformServices/PlatformServiceInterface/FmMcuReportFaultServiceInterface
  someip service interface deployment FmMcuReportFaultServiceDeployment: service-interface-id=1680, service-interface-version={major-version=1, minor-version=0}
    someip method deployment ReportFault_Someip: method-id=1, transport-protocol=UDP
