AUTOSAR XML (schema 00048)
package /HuaweiMDC/MdcPlatformServices/ConfigServerMsgDataType/ImplementationDataTypes
  std cpp implementation data type ParamUpdateData: category=STRUCTURE
    namespaces:
      symbol props mdc
      symbol props config
      symbol props server
    5 x cpp implementation data type element:
      paramName: type-reference=String
      paramValue: type-reference=String
      paramType: type-reference=UInt8
      clientName: type-reference=String
      uuid: type-reference=String
  std cpp implementation data type ServerNotifyData: category=STRUCTURE
    namespaces:
      symbol props mdc
      symbol props config
      symbol props server
    cpp implementation data type element notifyType: type-reference=int32_t
    cpp implementation data type element clientName: type-reference=String
    cpp implementation data type element extraData: type-reference=String
  std cpp implementation data type CfgStringList: category=VECTOR, cpp-template-argument=String
package /HuaweiMDC/MdcPlatformServices/ConfigServerServiceInterface
  service interface ConfigServerServiceInterface: is-service=true
    namespaces:
      symbol props mdc
      symbol props config
      symbol props server
    events:
      data ParamUpdateEvent: type=ParamUpdateData
      data ServerNotifyEvent: type=ServerNotifyData
    methods:
      8 x operation:
        AnswerAlive
          arg clientName: type=String, direction=IN
          arg result: type=int32_t, direction=OUT
        DelParam
          arg clientName: type=String, direction=IN
          arg paramName: type=String, direction=IN
          arg result: type=Int32, direction=OUT
        GetMonitorClients
          4 x arg:
            clientName: type=String, direction=IN
            paramName: type=String, direction=IN
            monitorClients: type=CfgStringList, direction=OUT
            result: type=Int32, direction=OUT
        GetParam
          5 x arg:
            clientName: type=String, direction=IN
            paramName: type=String, direction=IN
            paramValue: type=String, direction=OUT
            paramType: type=UInt8, direction=OUT
            result: type=Int32, direction=OUT
        MonitorParam
          arg clientName: type=String, direction=IN
          arg paramName: type=String, direction=IN
          arg result: type=Int32, direction=OUT
        SetParam
          7 x arg:
            clientName: type=String, direction=IN
            paramName: type=String, direction=IN
            paramValue: type=String, direction=IN
            paramType: type=UInt8, direction=IN
            persistType: type=UInt8, direction=IN
            uuid: type=String, direction=IN
            result: type=Int32, direction=OUT
        UnMonitorParam
          arg clientName: type=String, direction=IN
          arg paramName: type=String, direction=IN
          arg result: type=Int32, direction=OUT
        InitClient
          arg clientName: type=String, direction=IN
          arg result: type=Int32, direction=OUT
  someip service interface deployment ConfigServerSomeipServiceInterfaceDeployment: service-interface=ConfigServerServiceInterface, service-interface-id=3392, service-interface-version={major-version=1, minor-version=0}
    someip event deployment ParamUpdateEvent_Event: event=ParamUpdateEvent, event-id=1001, transport-protocol=UDP
    someip event deployment ServerNotifyEvent_Event: event=ServerNotifyEvent, event-id=1002, transport-protocol=UDP
    8 x someip method deployment, all with transport-protocol=UDP:
      AnswerAlive_Method: method=AnswerAlive, method-id=7
      DelParam_Method: method=DelParam, method-id=3
      GetMonitorClients_Method: method=GetMonitorClients, method-id=6
      GetParam_Method: method=GetParam, method-id=1
      MonitorParam_Method: method=MonitorParam, method-id=4
      SetParam_Method: method=SetParam, method-id=2
      UnMonitorParam_Method: method=UnMonitorParam, method-id=5
      InitClient_Method: method=InitClient, method-id=8
    someip event group ParamUpdateEventGroup: event-group-id=1, event=ParamUpdateEvent_Event
    someip event group ServerNotifyEventGroup: event-group-id=2, event=ServerNotifyEvent_Event
