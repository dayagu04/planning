AUTOSAR XML (schema 00048)
package /HuaweiMDC/PlatformServiceInterface/SmcMsgDataTypes/EnumerateType
  compu method StateChangeResultType: 0=kSuccess, 1=kInvalid, 2=kFailed, 3=kTimeout, 4=kCommError, 5=kFileError, 6=kRejected
  compu method ResetResult: 0=kSuccess, 1=kFailed, 2=kCommError
package /HuaweiMDC/PlatformServiceInterface/SmcMsgDataTypes/DataTypes
  12 x std cpp implementation data type:
    FunctionGroupInfo: category=STRUCTURE
      namespaces:
        symbol props ara
        symbol props sm
      cpp implementation data type element functionGroupName: type-reference=String
      cpp implementation data type element stateNames: type-reference=StateNames
    FunctionGroupInfoVec: category=VECTOR, cpp-template-argument=FunctionGroupInfo
      namespaces:
        symbol props ara
        symbol props sm
    SingleStateField: category=STRUCTURE
      namespaces:
        symbol props ara
        symbol props sm
      cpp implementation data type element functionGroupName: type-reference=String
      cpp implementation data type element stateName: type-reference=String
      cpp implementation data type element processResult: type-reference=uint8_t
    StateNames: category=VECTOR, cpp-template-argument=String
      namespaces:
        symbol props ara
        symbol props sm
    StateTransition: category=STRUCTURE
      namespaces:
        symbol props ara
        symbol props sm
      cpp implementation data type element functionGroupName: type-reference=String
      cpp implementation data type element stateName: type-reference=String
    StateTransitionVec: category=VECTOR, cpp-template-argument=StateTransition
      namespaces:
        symbol props ara
        symbol props sm
    TriggerDataType: category=VECTOR, cpp-template-argument=SingleStateField
      namespaces:
        symbol props ara
        symbol props sm
    ResetCode: category=STRUCTURE
      namespaces:
        symbol props ara
        symbol props sm
      cpp implementation data type element resetType: type-reference=ResetType
      cpp implementation data type element resetTime: type-reference=UInt32
    ResetType: compu {0=kSoft, 1=kHard}, type-reference=UInt8
      namespaces:
        symbol props ara
        symbol props sm
    ResetResult: compu-method=StateChangeResultType, type-reference=UInt8
      namespaces:
        symbol props ara
        symbol props sm
    ResetCause: compu {0=kNormal, 1=kUpdate}, type-reference=UInt8
      namespaces:
        symbol props ara
        symbol props sm
    StateTransitionResult: compu-method=StateChangeResultType, type-reference=UInt8
      namespaces:
        symbol props ara
        symbol props sm
package /HuaweiMDC/PlatformServiceInterface/SmcServiceInterface
  service interface TriggerInOut: is-service=true
    namespaces:
      symbol props ara
      symbol props sm
    field Notifier: type=TriggerDataType, has-getter=true, has-notifier=true, has-setter=false
    field Trigger: type=TriggerDataType, has-getter=false, has-notifier=false, has-setter=true
    methods:
      4 x operation:
        AcquireFunctionGroupInfo: fire-and-forget=false
          arg functionGroupInfoVec: type=FunctionGroupInfoVec, direction=OUT
        ProcessSyncRequest: fire-and-forget=false
          arg stateTrans: type=StateTransitionVec, direction=IN
          arg result: type=uint8_t, direction=OUT
        ResetSystem: fire-and-forget=false
          4 x arg:
            resetParams: type=ResetCode, direction=IN
            user: type=String, direction=IN
            resetReason: type=ResetCause, direction=IN
            resetResult: type=uint8_t, direction=OUT
        ProcessAsyncRequest: fire-and-forget=true
          arg stateTrans: type=StateTransitionVec, direction=IN
  someip service interface deployment TriggerInOutDeployment: service-interface=TriggerInOut, service-interface-id=2980, service-interface-version={major-version=1, minor-version=0}
    someip field deployment NotifierSomeipFieldDeploy: field=Notifier
      get getter: method-id=1205, transport-protocol=TCP
      notifier notifier: event-id=1206, transport-protocol=TCP
    someip field deployment TriggerSomeipFieldDeploy: field=Trigger
      set setter: method-id=1204, transport-protocol=TCP
    4 x someip method deployment, all with transport-protocol=TCP:
      AcquireFunctionGroupInfoSomeipDeploy: method=AcquireFunctionGroupInfo, method-id=2
      ProcessSyncRequestSomeipDeploy: method=ProcessSyncRequest, method-id=1
      ResetSystem: method=ResetSystem, method-id=3
      ProcessAsyncRequestSomeipDeploy: method=ProcessAsyncRequest, method-id=4
    someip event group NotifierSomeipEventGroup: event-group-id=13455, event=notifier
