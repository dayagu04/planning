AUTOSAR XML (schema 00048)
package /HuaweiMDC/PlatformServiceInterface/LpmcMsgDataTypes/DataTypes
  std cpp implementation data type MdcWakeupEventData: category=STRUCTURE
    namespaces:
      symbol props mdc
      symbol props lpm
    cpp implementation data type element isWakeup: type-reference=int32_t
package /HuaweiMDC/PlatformServiceInterface/LpmcServiceInterface
  someip service interface deployment LpmcServiceInterfaceDeployment: service-interface-id=3266, service-interface-version={major-version=1, minor-version=0}
    someip event deployment MdcWakeupSomeipEventDeployment: event-id=1103, transport-protocol=UDP
    someip method deployment SetLowPowerModeSomeipDeployment: method-id=1, transport-protocol=UDP
    someip method deployment SetEnterDeepSleepTimeDeployment: method-id=2, transport-protocol=UDP
    someip event group MdcWakeupSomeipEventGroup: event-group-id=1, event=MdcWakeupSomeipEventDeployment
