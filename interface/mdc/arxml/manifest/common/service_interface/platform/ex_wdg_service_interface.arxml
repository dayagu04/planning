AUTOSAR XML (schema 00048)
package /HuaweiMDC/MdcPlatformServices/PlatformServiceInterface/DataTypes
  std cpp implementation data type AnswerEnum: compu {0=ANSWER_OPENING, 1=ANSWER_PANDA, 2=ANSWER_GLODEN_MONKEY, 3=ANSWER_SOUTH_CHINA_TIGER, 4=ANSWER_CRESTED_IBIS, 5=ANSWER_CHINESE_STURGEON, 6=ANSWER_CHINESE_RURAL_DOG}, type-reference=UInt8
    namespaces:
      symbol props mdc
      symbol props ex_wdg
  std cpp implementation data type AnswerMsgType: category=STRUCTURE
    namespaces:
      symbol props mdc
      symbol props ex_wdg
    4 x cpp implementation data type element:
      versionId: type-reference=UInt32
      msgId: type-reference=UInt32
      answerParamLen: type-reference=UInt8
      qaParam: type-reference=ParamType
  std cpp implementation data type ParamType: category=VECTOR, cpp-template-argument=UInt8
    namespaces:
      symbol props mdc
      symbol props ex_wdg
  std cpp implementation data type QuesionEnum: compu {0=QUESION_OPENING, 1=QUESION_PANDA, 2=QUESION_GLODEN_MONKEY, 3=QUESION_SOUTH_CHINA_TIGER, 4=QUESION_CRESTED_IBIS, 5=QUESION_CHINESE_STURGEON, 6=QUESION_CHINESE_RURAL_DOG}, type-reference=UInt8
    namespaces:
      symbol props mdc
      symbol props ex_wdg
  std cpp implementation data type QuesionMsgType: category=STRUCTURE
    namespaces:
      symbol props mdc
      symbol props ex_wdg
    5 x cpp implementation data type element:
      versionId: type-reference=UInt32
      msgId: type-reference=UInt32
      quesionType: type-reference=UInt8
      quesionParamLen: type-reference=UInt8
      qaParam: type-reference=ParamType
package /HuaweiMDC/MdcPlatformServices/PlatformServiceInterface/ExWdgServiceInterface
  someip service interface deployment ExwdgLowPowerNotifyDeployment: service-interface-id=1027, service-interface-version={major-version=1, minor-version=0}
    someip method deployment LowPowerNotify_Someip: method-id=1, transport-protocol=TCP
  someip service interface deployment QADeployment: service-interface-id=1025, service-interface-version={major-version=1, minor-version=0}
    someip method deployment Answer_Someip: method-id=2, transport-protocol=UDP
    someip method deployment Quesion_Someip: method-id=1, transport-protocol=UDP
  dds service interface deployment ExwdgLowPowerNotifyDdsDeployment: service-interface-id=1027
    dds method deployment LowPowerNotify_Dds: dds-rpc-service=LowPowerNotify_DdsRpc
    dds rpc service deployment LowPowerNotify_DdsRpc: reply-topic-name=ReplyLowPowerNotifyDdsRpc, request-topic-name=RequestLowPowerNotifyDdsRpc
  dds service interface deployment QADdsDeployment: service-interface-id=1025
    dds method deployment Answer_Dds: dds-rpc-service=Anser_DdsRpc
    dds method deployment Question_Dds: dds-rpc-service=Question_DdsRpc
    dds rpc service deployment Anser_DdsRpc: reply-topic-name=ReplyAnswerDdsRpc, request-topic-name=RequestAnswerDdsRpc
    dds rpc service deployment Question_DdsRpc: reply-topic-name=ReplyQuestionDdsRpc, request-topic-name=RequestQuestionDdsRpc
