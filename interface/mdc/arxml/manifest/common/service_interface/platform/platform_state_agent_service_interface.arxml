AUTOSAR XML (schema 00048)
package /HuaweiMDC/PlatformServiceInterface/PlatformStateAgentServiceInterface
  dds service interface deployment PlatformStateAgentDeployment: service-interface-id=2983
    dds event deployment PlatformStateEventDdsDeployment: topic-name=PlatformStateEventDdsDeployment
    dds method deployment QueryPlatformStateDdsDeployment: dds-rpc-service=RpcQueryPlatformStateDdsDeployment
    dds method deployment RequestPlatformStateDdsDeployment: dds-rpc-service=RpcRequestPlatformStateDdsDeployment
    dds rpc service deployment RpcQueryPlatformStateDdsDeployment: reply-topic-name=ReplyRpcQueryPlatformStateDdsDeployment, request-topic-name=RequestRpcQueryPlatformStateDdsDeployment
    dds rpc service deployment RpcRequestPlatformStateDdsDeployment: reply-topic-name=ReplyRpcRequestPlatformStateDdsDeployment, request-topic-name=RequestRpcRequestPlatformStateDdsDeployment
package /HuaweiMDC/PlatformServiceInterface/PlatformStateAgentMsgDataTypes/DataTypes
  std cpp implementation data type PlatformStateMsg: category=STRUCTURE
    namespaces:
      symbol props ara
      symbol props sm
    cpp implementation data type element platformState: type-reference=uint8_t
