AUTOSAR XML (schema 00048)
package /HuaweiMDC/PlatformServiceInterface/UpdateManagerMsgDataTypes/CompuMethods
  compu method CM_ProcessResultType: 0=kSuccess, 1=kReady, 2=kBusy, 3=kActivating, 4=kActivated, 5=kRollingBack, 6=kRolledBack, 7=kCleaning_Up, 8=kVerifying
package /HuaweiMDC/PlatformServiceInterface/UpdateManagerMsgDataTypes/DataTypes
  20 x std cpp implementation data type:
    CheckItemResult: category=STRUCTURE
      namespaces:
        symbol props mdc
        symbol props swm
      cpp implementation data type element name: type-reference=String
      cpp implementation data type element result: type-reference=Int32
      cpp implementation data type element message: type-reference=String
    CheckItemResultVector: category=VECTOR, cpp-template-argument=CheckItemResult
      namespaces:
        symbol props mdc
        symbol props swm
    ExpectedVersionCheckResult: category=STRUCTURE
      namespaces:
        symbol props mdc
        symbol props swm
      4 x cpp implementation data type element:
        state: type-reference=UInt8
        checkStatus: type-reference=UInt8
        expectedVersion: type-reference=SysVersion
        currVersion: type-reference=SysVersion
    ItemStateVector: category=VECTOR, cpp-template-argument=itemState
      namespaces:
        symbol props mdc
        symbol props swm
    PackageManagerStatusType: compu {0=kIdle, 1=kReady, 2=kBusy, 3=kActivating, 4=kActivated, 5=kRollingBack, 6=kRolledBack, 7=kCleaning_Up, 8=kVerifying}, type-reference=UInt8
      namespaces:
        symbol props mdc
        symbol props swm
    PreCheckResult: category=STRUCTURE
      namespaces:
        symbol props mdc
        symbol props swm
      cpp implementation data type element result: type-reference=UInt8
      cpp implementation data type element results: category=VECTOR, type-reference=CheckItemResultVector
    ProcessResultType: category=STRUCTURE
      namespaces:
        symbol props mdc
        symbol props swm
      cpp implementation data type element result: type-reference=ProcessSwPackageReturnType
      cpp implementation data type element transferId: type-reference=TransferIdType
    ProcessSwPackageReturnType: category=STRUCTURE
      namespaces:
        symbol props mdc
        symbol props swm
      cpp implementation data type element result: type-reference=String
      cpp implementation data type element transferId: type-reference=TransferIdType
    Response: category=STRUCTURE
      namespaces:
        symbol props mdc
        symbol props swm
      cpp implementation data type element code: type-reference=Int32
      cpp implementation data type element message: type-reference=String
    StrongRevisionLabelString: type-reference=String
      namespaces:
        symbol props mdc
        symbol props swm
    SwClusterInfoType: category=STRUCTURE
      namespaces:
        symbol props mdc
        symbol props swm
      cpp implementation data type element name: type-reference=SwNameType
      cpp implementation data type element Version: type-reference=StrongRevisionLabelString
      cpp implementation data type element State: type-reference=SwClusterStateType
    SwClusterInfoVectorType: category=VECTOR, cpp-template-argument=SwClusterInfoType
      namespaces:
        symbol props mdc
        symbol props swm
    SwClusterStateType: compu {0=kPresent, 1=kAdded, 2=kUpdated, 3=kRemoved}, type-reference=UInt8
      namespaces:
        symbol props mdc
        symbol props swm
    SwNameType: type-reference=String
      namespaces:
        symbol props mdc
        symbol props swm
    SwNameVectorType: category=VECTOR, cpp-template-argument=SwNameType
      namespaces:
        symbol props mdc
        symbol props swm
    TransferIdType: category=ARRAY, array-size=16, cpp-template-argument=UInt8
      namespaces:
        symbol props mdc
        symbol props swm
    itemState: category=STRUCTURE
      namespaces:
        symbol props mdc
        symbol props swm
      4 x cpp implementation data type element:
        name: type-reference=String
        process: type-reference=UInt8
        errcode: type-reference=Int32
        message: type-reference=String
    SoftwareVersionItem: category=STRUCTURE
      namespaces:
        symbol props mdc
        symbol props swm
      cpp implementation data type element deviceName: type-reference=String
      cpp implementation data type element swName: type-reference=Int32
      cpp implementation data type element version: type-reference=String
    VerifyCheckResultVectorType: category=VECTOR, cpp-template-argument=VerifyCheckResult
      namespaces:
        symbol props mdc
        symbol props swm
    VerifyCheckResult: category=STRUCTURE
      namespaces:
        symbol props mdc
        symbol props swm
      5 x cpp implementation data type element, all with type-reference=String:
        pkgName
        deviceName
        currentVersion
        expectVersion
        message
package /HuaweiMDC/PlatformServiceInterface/UpdateManagerServiceInterface
  someip service interface deployment UpdateManagerSomeipServiceInterfaceDeployment: service-interface-id=3073, service-interface-version={major-version=1, minor-version=0}
    14 x someip method deployment, all with transport-protocol=UDP:
      ActivateSomeIpMethodDeploy: method-id=10
      FinishSomeIpMethodDeploy: method-id=11
      GetActivationProgressSomeIpMethodDeploy: method-id=7
      GetSwProcessProgressSomeIpMethodDeploy: method-id=14
      GetUpdatePreCheckProgressSomeIpMethodDeploy: method-id=4
      GetUpdatePreCheckResultSomeIpMethodDeploy: method-id=5
      GetUpdateProgressSomeIpMethodDeploy: method-id=6
      GetUpdateStatusSomeIpMethodDeploy: method-id=3
      ProcessSwPackageSomeIpMethodDeploy: method-id=17
      UpdatePreCheckSomeIpMethodDeploy: method-id=1
      UpdateSomeIpMethodDeploy: method-id=2
      GetVerifyListSomeIpMethodDeploy: method-id=18
      RollbackSomeIpMethodDeploy: method-id=8
      ActivateByModeSomeIpMethodDeploy: method-id=20
