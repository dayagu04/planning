AUTOSAR XML (schema 00048)
package /HuaweiMDC/PlatformServiceInterface/VoConfigDataType
  8 x std cpp implementation data type:
    ChnInfo: category=STRUCTURE
      namespaces:
        symbol props mdc
        symbol props vo
      5 x cpp implementation data type element:
        chnId: type-reference=uint8_t
        slotId: type-reference=SlotId
        isEnabled: type-reference=bool
        function: type-reference=String
        videoParam: type-reference=VideoParam
    VideoParam: category=STRUCTURE
      namespaces:
        symbol props mdc
        symbol props vo
      cpp implementation data type element imageFormat: type-reference=ImageFormatTypeE
      cpp implementation data type element frameRate: type-reference=uint32_t
      cpp implementation data type element resolution: type-reference=Resolution
    Resolution: category=STRUCTURE
      namespaces:
        symbol props mdc
        symbol props vo
      cpp implementation data type element width: type-reference=uint32_t
      cpp implementation data type element height: type-reference=uint32_t
    ChnAttr: category=STRUCTURE
      namespaces:
        symbol props mdc
        symbol props vo
      cpp implementation data type element isEnabled: type-reference=bool
    SlotId: compu {0=D4, 1=D3}, type-reference=uint8_t
      namespaces:
        symbol props mdc
        symbol props vo
    ChnInfoList: category=VECTOR, cpp-template-argument=ChnInfo
      namespaces:
        symbol props mdc
        symbol props vo
    VoEnum: compu {0=EXTERNAL, 1=INTERNAL, 2=VO3}, type-reference=uint8_t
      namespaces:
        symbol props mdc
        symbol props vo
    DisplayAttrEnum: compu {0=SETTING_1632_640_30HZ, 1=SETTING_1856_880_30HZ}, type-reference=uint8_t
      namespaces:
        symbol props mdc
        symbol props vo
package /HuaweiMDC/PlatformServiceInterface/VoConfigServiceInterface
  someip service interface deployment VoConfigSomeipServiceInterfaceDeployment: service-interface-id=5249, service-interface-version={major-version=1, minor-version=0}
    6 x someip method deployment, all with transport-protocol=UDP:
      GetVoConfigDeployment: method-id=1
      GetVoChnAttrDeployemnt: method-id=2
      SetVoChnAttrDeployment: method-id=3
      SetVoSourceDeployment: method-id=4
      GetVoSourceDeployment: method-id=5
      SetChnDisplayAttrDeployment: method-id=6
