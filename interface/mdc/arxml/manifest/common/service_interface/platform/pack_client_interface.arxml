AUTOSAR XML (schema 00048)
package /HuaweiMDC/PlatformServiceInterface/PackClientType
  std cpp implementation data type PackParamType: category=STRUCTURE
    namespaces:
      symbol props mdc
      symbol props dcap
    5 x cpp implementation data type element, all with is-optional=false:
      startTimestamp: type-reference=String
      endTimestamp: type-reference=String
      fileType: type-reference=ObjectMap
      packageSize: type-reference=UInt32
      path: type-reference=String
  std cpp implementation data type ObjectMap: category=ASSOCIATIVE_MAP, template-arguments=[String, StringVector]
    namespaces:
      symbol props mdc
      symbol props dcap
  std cpp implementation data type PackageDigestType: category=STRUCTURE
    namespaces:
      symbol props mdc
      symbol props dcap
    cpp implementation data type element digestStr: is-optional=false, type-reference=String
    cpp implementation data type element retCode: is-optional=false, type-reference=Int32
package /HuaweiMDC/PlatformServiceInterface/PlatformServices
  dds service interface deployment PackClientServiceInterfaceDeployment: service-interface-id=3777
    4 x dds method deployment, all with transport-protocols=UDP:
      StartPackDeployment: dds-rpc-service=RpcOfStartPackDeployment
      StopPackDeployment: dds-rpc-service=RpcOfStopPackDeployment
      QueryPackStatusDeployment: dds-rpc-service=RpcOfQueryPackStatusDeployment
      QueryPackageDigestDeployment: dds-rpc-service=RpcOfQueryPackageDigestDeployment
    4 x dds rpc service deployment, all with frag-size=2048, list-size=256:
      RpcOfStartPackDeployment: reply-topic-name=ReplyOfRpcOfStartPackDeployment, request-topic-name=RequestOfRpcOfStartPackDeployment
      RpcOfStopPackDeployment: reply-topic-name=ReplyOfRpcOfStopPackDeployment, request-topic-name=RequestOfRpcOfStopPackDeployment
      RpcOfQueryPackStatusDeployment: reply-topic-name=ReplyOfRpcOfQueryPackStatusDeployment, request-topic-name=RequestOfRpcOfQueryPackStatusDeployment
      RpcOfQueryPackageDigestDeployment: reply-topic-name=ReplyOfRpcOfQueryPackageDigestDeployment, request-topic-name=RequestOfRpcOfQueryPackageDigestDeployment
