AUTOSAR XML (schema 00048)
package /HuaweiMDC/PlatformServices
  dds service interface deployment DiagComServerDeployment: frag-size=2048, list-size=256, service-interface-id=103
    dds method deployment RequestDeployment: dds-rpc-service=RpcOfRequestDeployment, transport-protocols=UDP
    dds rpc service deployment RpcOfRequestDeployment: frag-size=2048, list-size=256, reply-topic-name=ReplyTopicNameOfRequestDeployment, request-topic-name=RequestTopicNameOfRequestDeployment
