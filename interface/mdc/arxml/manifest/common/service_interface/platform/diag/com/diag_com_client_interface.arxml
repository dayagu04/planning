AUTOSAR XML (schema 00048)
package /HuaweiMDC/DiagDataType
  std cpp implementation data type RequestTriggerType: category=STRUCTURE
    namespaces:
      symbol props ara
      symbol props diag
    cpp implementation data type element instanceSpecifier: is-optional=false, type-reference=String
    cpp implementation data type element serailNumber: type-reference=UInt64
    cpp implementation data type element eventType: is-optional=false, type-reference=UInt8
package /HuaweiMDC/PlatformServices
  dds service interface deployment DiagComClientDeployment: service-interface-id=101
    dds event deployment RequestTriggerDeployment: frag-size=2048, list-size=256, topic-name=TopicNameOfRequestTriggerDeployment, transport-protocols=UDP
    dds method deployment GetRequestDeployment: dds-rpc-service=RpcOfGetRequestDeployment, transport-protocols=UDP
    dds method deployment SendResponseDeployment: dds-rpc-service=RpcOfSendResponseDeployment, transport-protocols=UDP
    dds rpc service deployment RpcOfGetRequestDeployment: frag-size=2048, list-size=256, reply-topic-name=ReplyOfRpcOfGetRequestDeployment, request-topic-name=RequestOfRpcOfGetRequestDeployment
    dds rpc service deployment RpcOfSendResponseDeployment: frag-size=2048, list-size=256, reply-topic-name=ReplyOfRpcOfSendResponseDeployment, request-topic-name=RequestOfRpcOfSendResponseDeployment
