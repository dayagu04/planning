AUTOSAR XML (schema 00048)
package /HuaweiMDC/PlatformService
  dds service interface deployment DiagComNotifierDeployment: service-interface-id=102
    dds event deployment DataDeployment: frag-size=2048, list-size=256, topic-name=TopicNameOfDataDeployment, transport-protocols=UDP
