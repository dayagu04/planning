AUTOSAR XML (schema 00048)
package /HuaweiMDC/PlatformServices/DiagMsgDataType/CompuMethod
  compu method CM_KeyCompareResultType: 0=kKeyValid, 1=kKeyInvalid, 2=kReadKmError, 3=kConnectToTEEError
  compu method CM_SeedGetResultType: 0=kGetSeedSuccess, 1=kGetSeedFailed
package /HuaweiMDC/PlatformServices/DiagMsgDataType/DataTypes
  12 x std cpp implementation data type:
    ByteArray: category=VECTOR, cpp-template-argument=UInt8
      namespaces:
        symbol props ara
        symbol props diag
    ByteVector: category=VECTOR, cpp-template-argument=UInt8
      namespaces:
        symbol props ara
        symbol props diag
    ComCtrlRequestParamsType: category=STRUCTURE
      namespaces:
        symbol props ara
        symbol props diag
      4 x cpp implementation data type element:
        controlType: type-reference=UInt8
        communicationType: type-reference=UInt8
        subnetNumber: type-reference=UInt8
        nodeIdentificationNumber: type-reference=UInt16
    DidInfo: category=STRUCTURE
      namespaces:
        symbol props ara
        symbol props diag
      cpp implementation data type element didId: type-reference=UInt16
      cpp implementation data type element didValue: type-reference=ByteArray
    FreezeFrameInfo: category=VECTOR, cpp-template-argument=DidInfo
      namespaces:
        symbol props ara
        symbol props diag
    GidStatusStruct: category=STRUCTURE
      namespaces:
        symbol props ara
        symbol props diag
      cpp implementation data type element GID: type-reference=ByteArray
      cpp implementation data type element furtherActionReq: type-reference=UInt8
      cpp implementation data type element syncStatus: type-reference=UInt8
    InitMonitorReasonType: compu {0=kClear, 1=kRestart, 2=kReenabled, 3=kStorageEnabled}, type-reference=UInt8
    MetaInfoType: category=ASSOCIATIVE_MAP, template-arguments=[String, String]
      namespaces:
        symbol props ara
        symbol props diag
    MonitorActionType: compu {0=kPassed, 1=kFailed, 2=kPrepassed, 3=kPrefailed, 4=kFdcThresholdReached, 5=kResetTestFailed, 6=kFreezeDebouncing, 7=kResetDebouncing, 8=kPrestore, 9=kClearPrestore}, type-reference=UInt8
    OperationCycleStateType: compu {0=kStart, 1=kEnd}, type-reference=UInt8
    RoutineErrorCode: compu {0=kERoutineNoError, 1=kERoutineUndefined, 2=kERoutineNotFound, 3=kERoutineRequestInvalid, 4=kERoutineInternalError, 5=kERoutineHandlerNotAvailable, 6=kERoutineSequenceError, 7=kERoutineRequestOutofRange}, type-reference=UInt8
    ResetRequestType: compu {0=kSoftReset, 1=kHardReset, 2=kKeyOffOnReset, 3=kCustomReset}, type-reference=uint32_t
