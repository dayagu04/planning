AUTOSAR XML (schema 00048)
package /HuaweiMDC/DiagnosticPortInterface
  diagnostic condition interface DiagConditionIntf
  diagnostic data identifier generic interface DiagDidGenericIntf: service-kind=DIAGNOSTIC-COMMUNICATION-MANAGER
  diagnostic monitor interface DiagMonitorIntf: service-kind=DIAGNOSTIC-EVENT-MANAGER
  diagnostic operation cycle interface DiagOpCycleIntf
  diagnostic routine generic interface DiagRoutineGenericIntf
  diagnostic security level interface DiagSecurityLevelIntf
  diagnostic download interface DiagDownloadIntf
  diagnostic upload interface DiagUploadIntf
  diagnostic dtc information interface DiagDtcInfoIntf
