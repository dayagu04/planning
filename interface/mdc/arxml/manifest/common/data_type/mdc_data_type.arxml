AUTOSAR XML (schema 00048)
package /HuaweiMDC/StdCppDataType
  12 x std cpp implementation data type:
    Boolean: category=TYPE_REFERENCE
    Double: category=TYPE_REFERENCE
    Float: category=TYPE_REFERENCE
    Int16: category=TYPE_REFERENCE
    Int32: category=TYPE_REFERENCE
    Int64: category=TYPE_REFERENCE
    Int8: category=TYPE_REFERENCE
    String: category=STRING
    UInt16: category=TYPE_REFERENCE
    UInt32: category=TYPE_REFERENCE
    UInt64: category=TYPE_REFERENCE
    UInt8: category=TYPE_REFERENCE
