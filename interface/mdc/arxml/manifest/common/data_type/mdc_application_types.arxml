[part 2 of 2: packages /HuaweiMDC/instance_manifests/instanceToMachineMappings to /HuaweiMDC/instance_manifests/requiredInstances]
AUTOSAR XML (schema 00048)
package /HuaweiMDC/instance_manifests/instanceToMachineMappings
  9 x dds service instance to machine mapping, all with communication-connector=InnerEthernetCommConnector:
    IflytekSdmapInfo_DdsProvidedServiceInstance4_ToDdsMachineMapping: service-instance=IflytekSdmapSdmapInfo_DdsProvidedServiceInstance4
    IflytekCameraPerceptionLaneLines_DdsProvidedServiceInstance7_ToDdsMachineMapping: service-instance=IflytekCameraPerceptionLaneLines_DdsProvidedServiceInstance7
    RPortPrototype1_DdsRequiredServiceInstance20_ToDdsMachineMapping: service-instance=IflytekSensorCameraSurroundResizeImageFront_DdsRequiredServiceInstance20
    RPortPrototype1_DdsRequiredServiceInstance21_ToDdsMachineMapping: service-instance=IflytekSensorCameraSurroundResizeImageLeft_DdsRequiredServiceInstance21
    RPortPrototype1_DdsRequiredServiceInstance22_ToDdsMachineMapping: service-instance=IflytekSensorCameraSurroundResizeImageRight_DdsRequiredServiceInstance22
    RPortPrototype2_DdsRequiredServiceInstance23_ToDdsMachineMapping: service-instance=IflytekSensorCameraSurroundResizeImageRear_DdsRequiredServiceInstance23
    IflytekCameraPerception3dGeneralObjects_DdsProvidedServiceInstance8_ToDdsMachineMapping: service-instance=IflytekCameraPerception3dGeneralObjects_DdsProvidedServiceInstance8
    IflytekCameraPerceptionOccupancyObjects_DdsProvidedServiceInstance9_ToDdsMachineMapping: service-instance=IflytekCameraPerceptionOccupancyObjects_DdsProvidedServiceInstance9
    IflytekCameraPerceptionLaneTopo_DdsProvidedServiceInstance10_ToDdsMachineMapping: service-instance=IflytekCameraPerceptionLaneTopo_DdsProvidedServiceInstance10
  28 x someip service instance to machine mapping, all with communication-connector=InnerEthernetCommConnector, tcp-port=0:
    PPortPrototype1_ProvidedSomeipServiceInstance1_ToSomeIpMachineMapping: service-instance=IflytekAlarmInfoCameraNodeAroundView_ProvidedSomeipFmAService
    IflytekSdmapAlarmInfo_ProvidedSomeipServiceInstance2_ToSomeIpMachineMapping: service-instance=IflytekAlarmInfoSdmap_ProvidedSomeipServiceInstance2
    RPortPrototype1_RequiredSomeipServiceInstance1_ToSomeIpMachineMapping: service-instance=IflytekAlarmInfoSdmap_RequiredSomeipServiceInstance1
    AroundViewCameraPerceptionAlarmInfo_ProvidedSomeipServiceInstance3_ToSomeIpMachineMapping: service-instance=IflytekAlarmInfoAroundViewCameraPerception_ProvidedSomeipFmAService
    RPortPrototype1_RequiredSomeipServiceInstance2_ToSomeIpMachineMapping: service-instance=IflytekAlarmInfoAroundViewCameraPerception_RequiredSomeipServiceInstance2
    SocACommunicationAlarmInfo_ProvidedSomeipServiceInstance4_ToSomeIpMachineMapping: service-instance=IflytekAlarmInfoSocACommunication_ProvidedSomeipFmAService
    PanoramaViewCameraPerceptionLanelineAlarmInfo_ProvidedSomeipServiceInstance5_ToSomeIpMachineMapping: service-instance=IflytekAlarmInfoPanoramaViewCameraPerceptionLaneline_ProvidedSomeipFmAService
    RPortPrototype1_RequiredSomeipServiceInstance3_ToSomeIpMachineMapping: service-instance=IflytekAlarmInfoPanoramaViewCameraPerceptionLaneline_RequiredSomeipServiceInstance3
    GnssServiceNodeAlarmInfo_ProvidedSomeipServiceInstance6_ToSomeIpMachineMapping: service-instance=IflytekAlarmInfoGnssServiceNode_ProvidedSomeipServiceInstance6
    EhrAlarmInfo_ProvidedSomeipServiceInstance7_ToSomeIpMachineMapping: service-instance=IflytekAlarmInfoEhr_ProvidedSomeipServiceInstance7
    IflytekAlarmInfoLocalization_ProvidedSomeipServiceInstance9_ToSomeIpMachineMapping: service-instance=IflytekAlarmInfoLocalization_ProvidedSomeipServiceInstance9
    IflytekAlarmInfoSocBCommunication_ProvidedSomeipServiceInstance10_ToSomeIpMachineMapping: service-instance=IflytekAlarmInfoSocBCommunication_ProvidedSomeipServiceInstance10
    IflytekAlarmInfoPanoramaViewCameraNode_ProvidedSomeipServiceInstance16_ToSomeIpMachineMapping: service-instance=IflytekAlarmInfoCameraNodePanoramaView_ProvidedSomeipServiceInstance16
    IflytekAlarmInfoPanoramaViewCameraPerception_ProvidedSomeipServiceInstance17_ToSomeIpMachineMapping: service-instance=IflytekAlarmInfoPanoramaViewCameraPerception_ProvidedSomeipServiceInstance17
    IflytekAlarmInfoHmiService_ProvidedSomeipServiceInstance22_ToSomeIpMachineMapping: service-instance=IflytekAlarmInfoHmiService_ProvidedSomeipServiceInstance22
    RPortPrototype1_RequiredSomeipServiceInstance6_ToSomeIpMachineMapping: service-instance=IflytekAlarmInfoHmiService_RequiredSomeipHmiService
    IflytekAlarmInfoMdcB_ProvidedSomeipServiceInstance27_ToSomeIpMachineMapping: service-instance=IflytekAlarmInfoMdcB_ProvidedSomeipServiceInstance27
    RPortPrototype1_RequiredSomeipServiceInstance8_ToSomeIpMachineMapping: service-instance=IflytekAlarmInfoMdcB_RequiredSomeipServiceInstance8
    IflytekAlarmInfoMdcB_RequiredSomeipServiceInstance8_ToSomeIpMachineMapping: service-instance=IflytekAlarmInfoMdcB_RequiredSomeipServiceInstance8
    IflytekAlarmInfoSocBCommunication_ProvidedSomeipServiceInstance10_ToSomeIpMachineMapping: service-instance=IflytekAlarmInfoSocBCommunication_ProvidedSomeipServiceInstance10
    IflytekAlarmInfoHmiService_ProvidedSomeipServiceInstance22_ToSomeIpMachineMapping: service-instance=IflytekAlarmInfoHmiService_ProvidedSomeipServiceInstance22
    IflytekAlarmInfoSdmap_ProvidedSomeipServiceInstance2_ToSomeIpMachineMapping: service-instance=IflytekAlarmInfoSdmap_ProvidedSomeipServiceInstance2
    IflytekAlarmInfoGnssServiceNode_ProvidedSomeipServiceInstance6_ToSomeIpMachineMapping: service-instance=IflytekAlarmInfoGnssServiceNode_ProvidedSomeipServiceInstance6
    IflytekAlarmInfoLocalization_ProvidedSomeipServiceInstance9_ToSomeIpMachineMapping: service-instance=IflytekAlarmInfoLocalization_ProvidedSomeipServiceInstance9
    IflytekAlarmInfoPanoramaViewCameraPerception_ProvidedSomeipServiceInstance17_ToSomeIpMachineMapping: service-instance=IflytekAlarmInfoPanoramaViewCameraPerception_ProvidedSomeipServiceInstance17
    IflytekAlarmInfoEhr_ProvidedSomeipServiceInstance7_ToSomeIpMachineMapping: service-instance=IflytekAlarmInfoEhr_ProvidedSomeipServiceInstance7
    IflytekAlarmInfoMdcB_ProvidedSomeipServiceInstance27_ToSomeIpMachineMapping: service-instance=IflytekAlarmInfoMdcB_ProvidedSomeipServiceInstance27
    IflytekAlarmInfoPanoramaViewCameraNode_ProvidedSomeipServiceInstance16_ToSomeIpMachineMapping: service-instance=IflytekAlarmInfoCameraNodePanoramaView_ProvidedSomeipServiceInstance16
  12 x dds service instance to machine mapping, all with communication-connector=InnerEthernetCommConnector:
    IflytekHmiInner_DdsProvidedServiceInstance9_ToDdsMachineMapping: service-instance=IflytekHmiInner_DdsProvidedHmiService
    RPortPrototype1_DdsRequiredServiceInstance29_ToDdsMachineMapping: service-instance=IflytekLocalizationEgomotion_DdsRequiredServiceInstance29
    IflytekCameraPerceptionParkingSlotList_DdsProvidedServiceInstance11_ToDdsMachineMapping: service-instance=IflytekCameraPerceptionParkingSlotList_DdsProvidedServiceInstance11
    IflytekCameraPerceptionGroundLine_DdsProvidedServiceInstance12_ToDdsMachineMapping: service-instance=IflytekCameraPerceptionGroundLine_DdsProvidedServiceInstance12
    IflytekCameraPerceptionParkingLaneLine_DdsProvidedServiceInstance13_ToDdsMachineMapping: service-instance=IflytekCameraPerceptionParkingLaneLine_DdsProvidedServiceInstance13
    IflytekCameraPerceptionDeceler_DdsProvidedServiceInstance14_ToDdsMachineMapping: service-instance=IflytekCameraPerceptionDeceler_DdsProvidedServiceInstance14
    IflytekMegaLocalMap_DdsProvidedServiceInstance5_ToDdsMachineMapping: service-instance=IflytekMegaLocalMap_DdsProvidedServiceInstance5
    RPortPrototype1_DdsRequiredServiceInstance29_ToDdsMachineMapping: service-instance=IflytekCameraPerceptionParkingSlotList_DdsRequiredServiceInstance29
    RPortPrototype1_DdsRequiredServiceInstance29_ToDdsMachineMapping: service-instance=IflytekCameraPerceptionDeceler_DdsRequiredServiceInstance29
    RPortPrototype1_DdsRequiredServiceInstance29_ToDdsMachineMapping: service-instance=IflytekCameraPerceptionGroundLine_DdsRequiredServiceInstance29
    RPortPrototype1_DdsRequiredServiceInstance29_ToDdsMachineMapping: service-instance=IflytekCameraPerceptionParkingLaneLine_DdsRequiredServiceInstance29
    RPortPrototype1_DdsRequiredServiceInstance29_ToDdsMachineMapping: service-instance=IflytekLocalizationEgomotion_DdsRequiredServiceInstance30
  someip service instance to machine mapping IflytekAlarmInfoMega_ProvidedSomeipServiceInstance27_ToSomeIpMachineMapping: communication-connector=InnerEthernetCommConnector, service-instance=IflytekAlarmInfoMega_ProvidedSomeipFmAService, tcp-port=0
  someip service instance to machine mapping RPortPrototype1_RequiredSomeipServiceInstance9_ToSomeIpMachineMapping: communication-connector=InnerEthernetCommConnector, service-instance=IflytekAlarmInfoMega_RequiredSomeipServiceInstance9, tcp-port=0
  someip service instance to machine mapping IflytekAlarmInfoStaticFusion_ProvidedSomeipServiceInstance26_ToSomeIpMachineMapping: communication-connector=InnerEthernetCommConnector, service-instance=IflytekAlarmInfoStaticFusion_ProvidedSomeipFmAService, tcp-port=0
  4 x dds service instance to machine mapping, all with communication-connector=InnerEthernetCommConnector:
    RPortPrototype1_DdsRequiredServiceInstance31_ToDdsMachineMapping: service-instance=IflytekLocalizationSemanticInfo_DdsRequiredServiceInstance31
    IflytekMegaMappingStatus_DdsProvidedServiceInstance15_ToDdsMachineMapping: service-instance=IflytekMegaMappingStatus_DdsProvidedMega
    RPortPrototype1_DdsRequiredServiceInstance34_ToDdsMachineMapping: service-instance=IflytekCameraPerception3dGeneralObjects_DdsRequiredServiceInstance34
    IflytekSinproRadarPerceptionTarget_DdsProvidedServiceInstance19_ToDdsMachineMapping: service-instance=IflytekRadarFmPerception4dTarget_DdsProvidedServiceInstance19
  9 x someip service instance to machine mapping, all with communication-connector=InnerEthernetCommConnector, tcp-port=0:
    RPortPrototype1_RequiredSomeipServiceInstance12_ToSomeIpMachineMapping: service-instance=IflytekSensorGetSurroundCameraIntriParam_RequiredSomeipFmAService
    RPortPrototype1_RequiredSomeipServiceInstance13_ToSomeIpMachineMapping: service-instance=IflytekSensorGetPanoramaCameraIntriParam_RequiredSomeipFmAService
    RPortPrototype1_RequiredSomeipServiceInstance14_ToSomeIpMachineMapping: service-instance=IflytekSensorWriteFile_RequiredSomeipFmAService
    IflytekFactoryCalibrationActivation_ProvidedSomeipServiceInstance28_ToSomeIpMachineMapping: service-instance=IflytekFactoryCalibrationActivation_ProvidedSomeipServiceInstance28
    RPortPrototype1_RequiredSomeipServiceInstance13_ToSomeIpMachineMapping: service-instance=IflytekFactoryCalibrationActivation_RequiredSomeipFmAService
    IflytekFactoryCalibrationResult_ProvidedSomeipServiceInstance29_ToSomeIpMachineMapping: service-instance=IflytekFactoryCalibrationResult_ProvidedSomeipServiceInstance29
    RPortPrototype1_RequiredSomeipServiceInstance14_ToSomeIpMachineMapping: service-instance=IflytekFactoryCalibrationResult_RequiredSomeipFmAService
    IflytekStateManager_ProvidedSomeipServiceInstance31_ToSomeIpMachineMapping: service-instance=IflytekStateManager_ProvidedSomeipMdcAFm
    RPortPrototype1_RequiredSomeipServiceInstance16_ToSomeIpMachineMapping: service-instance=IflytekStateManager_RequiredSomeipFmAService
  14 x dds service instance to machine mapping, all with communication-connector=InnerEthernetCommConnector:
    RPortPrototype1_DdsRequiredServiceInstance47_ToDdsMachineMapping: service-instance=IflytekLocalizationEgomotion_DdsRequiredServiceInstance47
    RPortPrototype1_DdsRequiredServiceInstance44_ToDdsMachineMapping: service-instance=IflytekAlarmInfoSoc_DdsRequiredFmAService
    IflytekAlarmInfoSoc_DdsProvidedServiceInstance23_ToDdsMachineMapping: service-instance=IflytekAlarmInfoSoc_DdsProvidedServiceInstance23
    RPortPrototype1_DdsRequiredServiceInstance44_ToDdsMachineMapping: service-instance=IflytekSensorCameraSurroundFrontFullResolutionH265_DdsRequiredServiceInstance44
    RPortPrototype1_DdsRequiredServiceInstance41_ToDdsMachineMapping: service-instance=IflytekSensorCameraSurroundLeftFullResolutionH265_DdsRequiredServiceInstance41
    RPortPrototype1_DdsRequiredServiceInstance42_ToDdsMachineMapping: service-instance=IflytekSensorCameraSurroundRearFullResolutionH265_DdsRequiredServiceInstance42
    RPortPrototype1_DdsRequiredServiceInstance43_ToDdsMachineMapping: service-instance=IflytekSensorCameraSurroundRightFullResolutionH265_DdsRequiredServiceInstance43
    RPortPrototype1_DdsRequiredServiceInstance39_ToDdsMachineMapping: service-instance=IflytekSensorCameraFront30FullResolutionH265_DdsRequiredServiceInstance39
    RPortPrototype1_DdsRequiredServiceInstance40_ToDdsMachineMapping: service-instance=IflytekSensorCameraFront120FullResolutionH265_DdsRequiredServiceInstance40
    RPortPrototype1_DdsRequiredServiceInstance41_ToDdsMachineMapping: service-instance=IflytekSensorCameraSideFlFullResolutionH265_DdsRequiredServiceInstance41
    RPortPrototype1_DdsRequiredServiceInstance42_ToDdsMachineMapping: service-instance=IflytekSensorCameraSideFrFullResolutionH265_DdsRequiredServiceInstance42
    RPortPrototype1_DdsRequiredServiceInstance43_ToDdsMachineMapping: service-instance=IflytekSensorCameraSideRlFullResolutionH265_DdsRequiredServiceInstance43
    RPortPrototype1_DdsRequiredServiceInstance44_ToDdsMachineMapping: service-instance=IflytekSensorCameraSideRrFullResolutionH265_DdsRequiredServiceInstance44
    IflytekRadarFmPerception4dPointCloud_DdsProvidedServiceInstance24_ToDdsMachineMapping: service-instance=IflytekRadarFmPerception4dPointCloud_DdsProvidedServiceInstance24
  someip service instance to machine mapping IflytekAlarmInfoRadar4dService_ProvidedSomeipServiceInstance32_ToSomeIpMachineMapping: communication-connector=InnerEthernetCommConnector, service-instance=IflytekAlarmInfoRadar4dService_ProvidedSomeipServiceInstance32, tcp-port=0
  someip service instance to machine mapping RPortPrototype1_RequiredSomeipServiceInstance18_ToSomeIpMachineMapping: communication-connector=InnerEthernetCommConnector, service-instance=IflytekAlarmInfoRadar4dService_RequiredSomeipServiceInstance18, tcp-port=0
  4 x dds service instance to machine mapping, all with communication-connector=InnerEthernetCommConnector:
    RPortPrototype1_DdsRequiredServiceInstance46_ToDdsMachineMapping: service-instance=IflytekLocalizationEgomotion_DdsRequiredServiceInstance46
    IflytekCameraPerceptionObjects_DdsProvidedServiceInstance26_ToDdsMachineMapping: service-instance=IflytekCameraPerceptionObjects_DdsProvidedServiceInstance26
    RPortPrototype1_DdsRequiredServiceInstance49_ToDdsMachineMapping: service-instance=IflytekSensorCameraRearFullResolutionH265MDCA_DdsRequiredServiceInstance49
    RPortPrototype1_DdsRequiredServiceInstance104_ToDdsMachineMapping
  4 x someip service instance to machine mapping, all with communication-connector=InnerEthernetCommConnector, tcp-port=0:
    IflytekConfigManager_ProvidedSomeipServiceInstance29_ToSomeIpMachineMapping: service-instance=IflytekConfigManager_ProvidedSomeipMdcAFm
    RPortPrototype1_RequiredSomeipServiceInstance20_ToSomeIpMachineMapping: service-instance=IflytekConfigManager_RequiredSomeipServiceInstance20
    IflytekAlarmInfoMdcB_RequiredSomeipServiceInstance24_ToSomeIpMachineMapping: service-instance=IflytekAlarmInfoMdcB_RequiredSomeipServiceInstance24
    IflytekAlarmInfoCalibration_ProvidedSomeipServiceInstance22_ToSomeIpMachineMapping: service-instance=IflytekAlarmInfoCalibration_ProvidedSomeipServiceInstance22
  7 x dds service instance to machine mapping, all with communication-connector=InnerEthernetCommConnector:
    RPortPrototype1_DdsRequiredServiceInstance40_ToDdsMachineMapping: service-instance=IflytekSensorImu_DdsRequiredServiceInstance40
    RPortPrototype1_DdsRequiredServiceInstance41_ToDdsMachineMapping: service-instance=IflytekSensorMcuToFmInfo_DdsRequiredFmAService
    RPortPrototype1_DdsRequiredServiceInstance42_ToDdsMachineMapping: service-instance=IflytekAlarmInfoMcu_DdsRequiredFmAService
    RPortPrototype1_DdsRequiredServiceInstance43_ToDdsMachineMapping: service-instance=IflytekVehicleService_DdsRequiredHmiService
    RPortPrototype1_DdsRequiredServiceInstance44_ToDdsMachineMapping: service-instance=IflytekHmiMcuToSocBsw_DdsRequiredHmiService
    IflytekFmMcuInfo_DdsProvidedServiceInstance23_ToDdsMachineMapping: service-instance=IflytekFmMcuInfo_DdsProvidedFmAService
    IflytekHmiSocToMcuBsw_DdsProvidedServiceInstance24_ToDdsMachineMapping: service-instance=IflytekHmiSocToMcuBsw_DdsProvidedHmiService
  someip service instance to machine mapping IflytekAlarmInfoComServicePncNode_ProvidedSomeipServiceInstance24_ToSomeIpMachineMapping: communication-connector=InnerEthernetCommConnector, service-instance=IflytekAlarmInfoComServicePncNode_ProvidedSomeipFmAService, tcp-port=0
  dds service instance to machine mapping IflytekPredictionPredictionResult_DdsProvidedServiceInstance24_ToDdsMachineMapping: communication-connector=InnerEthernetCommConnector, service-instance=IflytekPredictionPredictionResult_DdsProvidedServiceInstance24
  dds service instance to machine mapping RPortPrototype1_DdsRequiredServiceInstance48_ToDdsMachineMapping: communication-connector=InnerEthernetCommConnector, service-instance=IflytekFusionSpatialParkingSlot_DdsRequiredServiceInstance48
  someip service instance to machine mapping IflytekAlarmInfoObstacleFusion_ProvidedSomeipServiceInstance25_ToSomeIpMachineMapping: communication-connector=InnerEthernetCommConnector, service-instance=IflytekAlarmInfoObstacleFusion_ProvidedSomeipFmAService, tcp-port=0
  dds service instance to machine mapping RPortPrototype1_DdsRequiredServiceInstance47_ToDdsMachineMapping: communication-connector=InnerEthernetCommConnector, service-instance=IflytekUssUsswaveInfo_DdsRequiredServiceInstance47
  dds service instance to machine mapping RPortPrototype1_DdsRequiredServiceInstance47_ToDdsMachineMapping: communication-connector=InnerEthernetCommConnector, service-instance=IflytekVehicleService_DdsRequiredServiceInstance47
  4 x someip service instance to machine mapping, all with communication-connector=InnerEthernetCommConnector, tcp-port=0:
    IflytekAlarmPlanning_ProvidedSomeipServiceInstance26_ToSomeIpMachineMapping: service-instance=IflytekAlarmInfoPlanning_ProvidedSomeipFmAService
    IflytekAlarmInfoOtaNode_ProvidedSomeipServiceInstance27_ToSomeIpMachineMapping: service-instance=IflytekAlarmInfoOtaNode_ProvidedSomeipFmAService
    RPortPrototype1_RequiredSomeipServiceInstance24_ToSomeIpMachineMapping: service-instance=IflytekAlarmInfoOtaNode_RequiredSomeipServiceInstance24
    IflytekAlarmInfoControl_ProvidedSomeipServiceInstance28_ToSomeIpMachineMapping: service-instance=IflytekAlarmInfoControl_ProvidedSomeipFmAService
  dds service instance to machine mapping RPortPrototype1_DdsRequiredServiceInstance48_ToDdsMachineMapping: communication-connector=InnerEthernetCommConnector, service-instance=IflytekVehicleService_DdsRequiredServiceInstance48
  dds service instance to machine mapping RPortPrototype1_DdsRequiredServiceInstance48_ToDdsMachineMapping: communication-connector=InnerEthernetCommConnector
  6 x someip service instance to machine mapping, all with communication-connector=InnerEthernetCommConnector, tcp-port=0:
    RPortPrototype1_RequiredSomeipServiceInstance23_ToSomeIpMachineMapping: service-instance=IflytekAlarmInfoMdcA_RequiredSomeipMdcAFm
    RPortPrototype1_RequiredSomeipServiceInstance23_ToSomeIpMachineMapping
    RPortPrototype1_RequiredSomeipServiceInstance23_ToSomeIpMachineMapping: service-instance=IflytekConfigManager_RequiredSomeipFmAService
    IflytekAlarmInfoMdcA_ProvidedSomeipServiceInstance29_ToSomeIpMachineMapping: service-instance=IflytekAlarmInfoMdcA_ProvidedSomeipFmAService
    IflytekAlarmInfoMdcA_RequiredSomeipServiceInstance24_ToSomeIpMachineMapping
    IflytekAlarmInfoFiniteStateManager_ProvidedSomeipServiceInstance29_ToSomeIpMachineMapping: service-instance=IflytekAlarmInfoFiniteStateManager_ProvidedSomeipServiceInstance29
  64 x dds service instance to machine mapping, all with communication-connector=InnerEthernetCommConnector:
    RPortPrototype1_DdsRequiredServiceInstance43_ToDdsMachineMapping: service-instance=IflytekFsmHmiSocOuter_DdsRequiredHmiService
    RPortPrototype2_DdsRequiredServiceInstance44_ToDdsMachineMapping: service-instance=IflytekFsmSocState_DdsRequiredHmiService
    RPortPrototype1_DdsRequiredServiceInstance{45..47}_ToDdsMachineMapping: service-instance=IflytekFsmSocState_DdsRequiredServiceInstance{45..47}
    RPortPrototype1_DdsRequiredServiceInstance48_ToDdsMachineMapping: service-instance=IflytekCalibrationCalibInfo_DdsRequiredServiceInstance48
    RPortPrototype1_DdsRequiredServiceInstance49_ToDdsMachineMapping: service-instance=IflytekSensorCameraSurroundFrontFullResolutionH265_DdsRequiredServiceInstance49
    RPortPrototype1_DdsRequiredServiceInstance50_ToDdsMachineMapping: service-instance=IflytekSensorCameraSurroundLeftFullResolutionH265_DdsRequiredServiceInstance50
    RPortPrototype1_DdsRequiredServiceInstance51_ToDdsMachineMapping: service-instance=IflytekSensorCameraSurroundRearFullResolutionH265_DdsRequiredServiceInstance51
    RPortPrototype1_DdsRequiredServiceInstance52_ToDdsMachineMapping: service-instance=IflytekSensorCameraSurroundRightFullResolutionH265_DdsRequiredServiceInstance52
    RPortPrototype1_DdsRequiredServiceInstance53_ToDdsMachineMapping: service-instance=IflytekSensorCameraFront120FullResolutionH265_DdsRequiredServiceInstance53
    RPortPrototype1_DdsRequiredServiceInstance54_ToDdsMachineMapping: service-instance=IflytekSensorCameraFront30FullResolutionH265_DdsRequiredServiceInstance54
    RPortPrototype1_DdsRequiredServiceInstance55_ToDdsMachineMapping: service-instance=IflytekSensorCameraSideFlFullResolutionH265_DdsRequiredServiceInstance55
    RPortPrototype1_DdsRequiredServiceInstance56_ToDdsMachineMapping: service-instance=IflytekSensorCameraSideFrFullResolutionH265_DdsRequiredServiceInstance56
    RPortPrototype1_DdsRequiredServiceInstance57_ToDdsMachineMapping: service-instance=IflytekSensorCameraSideRlFullResolutionH265_DdsRequiredServiceInstance57
    RPortPrototype1_DdsRequiredServiceInstance58_ToDdsMachineMapping: service-instance=IflytekSensorCameraSideRrFullResolutionH265_DdsRequiredServiceInstance58
    RPortPrototype1_DdsRequiredServiceInstance59_ToDdsMachineMapping: service-instance=IflytekSensorCameraRearFullResolutionH265_DdsRequiredServiceInstance59
    RPortPrototype1_DdsRequiredServiceInstance60_ToDdsMachineMapping: service-instance=IflytekCameraPerceptionTrafficSignRecognition_DdsRequiredServiceInstance60
    RPortPrototype1_DdsRequiredServiceInstance61_ToDdsMachineMapping: service-instance=IflytekCameraPerceptionOccGrid_DdsRequiredServiceInstance61
    RPortPrototype1_DdsRequiredServiceInstance63_ToDdsMachineMapping: service-instance=IflytekCameraPerceptionLaneTopo_DdsRequiredServiceInstance63
    RPortPrototype1_DdsRequiredServiceInstance64_ToDdsMachineMapping: service-instance=IflytekPredictionPredictionResult_DdsRequiredServiceInstance64
    RPortPrototype1_DdsRequiredServiceInstance65_ToDdsMachineMapping: service-instance=IflytekCameraPerceptionLaneLines_DdsRequiredServiceInstance65
    RPortPrototype1_DdsRequiredServiceInstance66_ToDdsMachineMapping: service-instance=IflytekCameraPerceptionObjects_DdsRequiredServiceInstance66
    RPortPrototype1_DdsRequiredServiceInstance67_ToDdsMachineMapping: service-instance=IflytekCameraPerceptionOccupancyObjects_DdsRequiredServiceInstance67
    RPortPrototype1_DdsRequiredServiceInstance68_ToDdsMachineMapping: service-instance=IflytekCameraPerception3dGeneralObjects_DdsRequiredServiceInstance68
    RPortPrototype1_DdsRequiredServiceInstance69_ToDdsMachineMapping: service-instance=IflytekCameraPerceptionParkingSlotList_DdsRequiredServiceInstance69
    RPortPrototype1_DdsRequiredServiceInstance70_ToDdsMachineMapping: service-instance=IflytekCameraPerceptionParkingLaneLine_DdsRequiredServiceInstance70
    RPortPrototype1_DdsRequiredServiceInstance71_ToDdsMachineMapping: service-instance=IflytekCameraPerceptionGroundLine_DdsRequiredServiceInstance71
    RPortPrototype1_DdsRequiredServiceInstance72_ToDdsMachineMapping: service-instance=IflytekCameraPerceptionDeceler_DdsRequiredServiceInstance72
    RPortPrototype1_DdsRequiredServiceInstance73_ToDdsMachineMapping: service-instance=IflytekFusionSpatialParkingSlot_DdsRequiredServiceInstance73
    RPortPrototype1_DdsRequiredServiceInstance74_ToDdsMachineMapping: service-instance=IflytekFusionParkingSlot_DdsRequiredServiceInstance74
    RPortPrototype1_DdsRequiredServiceInstance75_ToDdsMachineMapping: service-instance=IflytekFusionRoadFusion_DdsRequiredServiceInstance75
    RPortPrototype2_DdsRequiredServiceInstance76_ToDdsMachineMapping: service-instance=IflytekFusionObjects_DdsRequiredServiceInstance76
    RPortPrototype1_DdsRequiredServiceInstance77_ToDdsMachineMapping: service-instance=IflytekFusionObjectsCompress_DdsRequiredServiceInstance77
    RPortPrototype1_DdsRequiredServiceInstance78_ToDdsMachineMapping: service-instance=IflytekFusionUssPerceptionInfo_DdsRequiredServiceInstance78
    RPortPrototype1_DdsRequiredServiceInstance79_ToDdsMachineMapping: service-instance=IflytekFusionOccupancyObjects_DdsRequiredServiceInstance79
    RPortPrototype1_DdsRequiredServiceInstance80_ToDdsMachineMapping: service-instance=IflytekFusionRoadFusionCompress_DdsRequiredServiceInstance80
    RPortPrototype1_DdsRequiredServiceInstance81_ToDdsMachineMapping: service-instance=IflytekFusionGroundLine_DdsRequiredServiceInstance81
    RPortPrototype1_DdsRequiredServiceInstance82_ToDdsMachineMapping: service-instance=IflytekFusionSpeedBump_DdsRequiredServiceInstance82
    RPortPrototype1_DdsRequiredServiceInstance83_ToDdsMachineMapping: service-instance=IflytekMegaLocalMap_DdsRequiredServiceInstance83
    RPortPrototype1_DdsRequiredServiceInstance84_ToDdsMachineMapping: service-instance=IflytekMegaMappingStatus_DdsRequiredServiceInstance84
    RPortPrototype1_DdsRequiredServiceInstance85_ToDdsMachineMapping: service-instance=IflytekUssUsswaveInfo_DdsRequiredServiceInstance85
    RPortPrototype1_DdsRequiredServiceInstance86_ToDdsMachineMapping: service-instance=IflytekRadarFlPerceptionInfo_DdsRequiredServiceInstance86
    RPortPrototype1_DdsRequiredServiceInstance87_ToDdsMachineMapping: service-instance=IflytekRadarFrPerceptionInfo_DdsRequiredServiceInstance87
    RPortPrototype1_DdsRequiredServiceInstance88_ToDdsMachineMapping: service-instance=IflytekRadarRlPerceptionInfo_DdsRequiredServiceInstance88
    RPortPrototype1_DdsRequiredServiceInstance89_ToDdsMachineMapping: service-instance=IflytekRadarRrPerceptionInfo_DdsRequiredServiceInstance89
    RPortPrototype1_DdsRequiredServiceInstance90_ToDdsMachineMapping: service-instance=IflytekRadarFmPerception4dPointCloud_DdsRequiredServiceInstance90
    RPortPrototype1_DdsRequiredServiceInstance91_ToDdsMachineMapping: service-instance=IflytekRadarFmPerception4dTarget_DdsRequiredServiceInstance91
    RPortPrototype1_DdsRequiredServiceInstance92_ToDdsMachineMapping: service-instance=IflytekSensorImu_DdsRequiredServiceInstance92
    RPortPrototype1_DdsRequiredServiceInstance93_ToDdsMachineMapping: service-instance=IflytekVehicleService_DdsRequiredServiceInstance93
    RPortPrototype1_DdsRequiredServiceInstance94_ToDdsMachineMapping: service-instance=IflytekSensorGnss_DdsRequiredServiceInstance94
    RPortPrototype1_DdsRequiredServiceInstance95_ToDdsMachineMapping: service-instance=IflytekLocalizationEgomotion_DdsRequiredServiceInstance95
    RPortPrototype1_DdsRequiredServiceInstance96_ToDdsMachineMapping: service-instance=IflytekLocalizationSemanticInfo_DdsRequiredServiceInstance96
    RPortPrototype1_DdsRequiredServiceInstance97_ToDdsMachineMapping: service-instance=IflytekEhrSdmapInfo_DdsRequiredServiceInstance97
    RPortPrototype1_DdsRequiredServiceInstance98_ToDdsMachineMapping: service-instance=IflytekEhrStaticMap_DdsRequiredServiceInstance98
    RPortPrototype1_DdsRequiredServiceInstance99_ToDdsMachineMapping: service-instance=IflytekEhrSdpromapInfo_DdsRequiredServiceInstance99
    RPortPrototype1_DdsRequiredServiceInstance103_ToDdsMachineMapping: service-instance=IflytekHmiInner_DdsRequiredServiceInstance103
    RPortPrototype1_DdsRequiredServiceInstance104_ToDdsMachineMapping: service-instance=IflytekFsmSocState_DdsRequiredServiceInstance104
    RPortPrototype1_DdsRequiredServiceInstance105_ToDdsMachineMapping: service-instance=IflytekFsmHmiSocOuter_DdsRequiredServiceInstance105
    RPortPrototype1_DdsRequiredServiceInstance106_ToDdsMachineMapping: service-instance=IflytekAdasFunctionAdas_DdsRequiredServiceInstance106
    RPortPrototype1_DdsRequiredServiceInstance107_ToDdsMachineMapping: service-instance=IflytekControlControlCommand_DdsRequiredServiceInstance107
    RPortPrototype1_DdsRequiredServiceInstance108_ToDdsMachineMapping: service-instance=IflytekPlanningPlan_DdsRequiredServiceInstance108
    RPortPrototype1_DdsRequiredServiceInstance109_ToDdsMachineMapping: service-instance=IflytekPlanningHmi_DdsRequiredServiceInstance109
    RPortPrototype1_DdsRequiredServiceInstance110_ToDdsMachineMapping: service-instance=IflytekSdmapSdmapInfo_DdsRequiredServiceInstance110
  someip service instance to machine mapping IflytekAlarmInfoFdl_ProvidedSomeipServiceInstance30_ToSomeIpMachineMapping: communication-connector=InnerEthernetCommConnector, service-instance=IflytekAlarmInfoFdl_ProvidedSomeipServiceInstance30, tcp-port=0
  someip service instance to machine mapping RPortPrototype1_RequiredSomeipServiceInstance24_ToSomeIpMachineMapping: communication-connector=InnerEthernetCommConnector, service-instance=IflytekAlarmInfoFdl_RequiredSomeipServiceInstance24, tcp-port=0
  4 x dds service instance to machine mapping, all with communication-connector=InnerEthernetCommConnector:
    IflytekAlarmInfoFmAService_DdsProvidedServiceInstance25_ToDdsMachineMapping: service-instance=IflytekAlarmInfoFmAService_DdsProvidedFmAService
    IflytekDTCInfoFmAService_DdsProvidedServiceInstance26_ToDdsMachineMapping: service-instance=IflytekDTCInfoFmAService_DdsProvidedFmAService
    RPortPrototype1_DdsRequiredServiceInstance112_ToDdsMachineMapping: service-instance=IflytekDTCInfoFmAService_DdsRequiredServiceInstance112
    RPortPrototype1_DdsRequiredServiceInstance113_ToDdsMachineMapping: service-instance=IflytekAlarmInfoFmAService_DdsRequiredServiceInstance113
  4 x someip service instance to machine mapping, all with communication-connector=InnerEthernetCommConnector, tcp-port=0:
    RPortPrototype1_RequiredSomeipServiceInstance25_ToSomeIpMachineMapping: service-instance=IflytekConfigManager_RequiredSomeipServiceInstance25
    RPortPrototype1_RequiredSomeipServiceInstance23_ToSomeIpMachineMapping: service-instance=IflytekPostSaleCalibrationActivation_RequiredSomeipFmAService
    RPortPrototype1_RequiredSomeipServiceInstance24_ToSomeIpMachineMapping: service-instance=IflytekPostSaleCalibrationStop_RequiredSomeipFmAService
    RPortPrototype1_RequiredSomeipServiceInstance25_ToSomeIpMachineMapping: service-instance=IflytekPostSaleCalibrationResult_RequiredSomeipFmAService
  32 x dds service instance to machine mapping, all with communication-connector=InnerEthernetCommConnector:
    RPortPrototype1_DdsRequiredServiceInstance114_ToDdsMachineMapping: service-instance=IflytekVehicleService_DdsRequiredMega
    RPortPrototype1_DdsRequiredServiceInstance115_ToDdsMachineMapping: service-instance=IflytekVehicleService_DdsRequiredFmAService
    IflytekAlarmInfoToBCamera_DdsProvidedServiceInstance26_ToDdsMachineMapping: service-instance=IflytekAlarmInfoToBCamera_DdsProvidedFmBService
    IflytekAlarmInfoToACamera_DdsProvidedServiceInstance27_ToDdsMachineMapping: service-instance=IflytekAlarmInfoToACamera_DdsProvidedFmAService
    RPortPrototype1_DdsRequiredServiceInstance116_ToDdsMachineMapping: service-instance=IflytekCameraPerceptionOccupancyObjects_DdsRequiredHmiService
    RPortPrototype1_DdsRequiredServiceInstance117_ToDdsMachineMapping: service-instance=IflytekSystemVersion_DdsRequiredFunctionDataLoop
    IflytekFdlTrigger_DdsProvidedServiceInstance28_ToDdsMachineMapping: service-instance=IflytekFdlTrigger_DdsProvidedFunctionDataLoopB
    RPortPrototype1_DdsRequiredServiceInstance118_ToDdsMachineMapping: service-instance=IflytekFdlTriggerAck_DdsRequiredFunctionDataLoopB
    IflytekFdlTriggerAck_DdsProvidedServiceInstance29_ToDdsMachineMapping: service-instance=IflytekFdlTriggerAck_DdsProvidedFunctionDataLoopA
    RPortPrototype1_DdsRequiredServiceInstance119_ToDdsMachineMapping: service-instance=IflytekFdlTrigger_DdsRequiredFunctionDataLoopA
    RPortPrototype1_DdsRequiredServiceInstance120_ToDdsMachineMapping: service-instance=IflytekMcuFmASentinel_DdsRequiredFmAService
    IflytekFmAMcuSentinel_DdsProvidedServiceInstance30_ToDdsMachineMapping: service-instance=IflytekFmAMcuSentinel_DdsProvidedFmAService
    IflytekFmACameraSentinel_DdsProvidedServiceInstance31_ToDdsMachineMapping: service-instance=IflytekFmACameraSentinel_DdsProvidedFmAService
    RPortPrototype1_DdsRequiredServiceInstance122_ToDdsMachineMapping: service-instance=IflytekPlanningDebugInfo_DdsRequiredFunctionDataLoop
    RPortPrototype1_DdsRequiredServiceInstance123_ToDdsMachineMapping: service-instance=IflytekControlDebugInfo_DdsRequiredFunctionDataLoop
    RPortPrototype1_DdsRequiredServiceInstance124_ToDdsMachineMapping: service-instance=IflytekAdasFunctionDebugInfo_DdsRequiredFunctionDataLoop
    IflytekRadarPerception4dTargetMcu_DdsProvidedServiceInstance32_ToDdsMachineMapping: service-instance=IflytekRadarPerception4dTargetMcu_DdsProvidedServiceInstance32
    IflytekEngineerInner_DdsProvidedServiceInstance33_ToDdsMachineMapping: service-instance=IflytekEngineerInner_DdsProvidedHmiService
    RPortPrototype1_DdsRequiredServiceInstance125_ToDdsMachineMapping: service-instance=IflytekEngineerInner_DdsRequiredFmAService
    RPortPrototype1_DdsRequiredServiceInstance126_ToDdsMachineMapping: service-instance=IflytekAlarmInfoFmAService_DdsRequiredHmiService
    IflytekFmAMcuDegradeFunciton_DdsProvidedServiceInstance34_ToDdsMachineMapping: service-instance=IflytekFmAMcuDegradeFunciton_DdsProvidedServiceInstance34
    IflytekFmADegradeFunciton_DdsProvidedServiceInstance35_ToDdsMachineMapping: service-instance=IflytekFmADegradeFunciton_DdsProvidedServiceInstance35
    IflytekCameraPerceptionPanoramaView2DBoundingBoxes_DdsProvidedServiceInstance36_ToDdsMachineMapping: service-instance=IflytekCameraPerceptionPanoramaView2DBoundingBoxes_DdsProvidedServiceInstance36
    IflytekCameraPerceptionAroundView2DBoundingBoxes_DdsProvidedServiceInstance37_ToDdsMachineMapping: service-instance=IflytekCameraPerceptionAroundView2DBoundingBoxes_DdsProvidedServiceInstance37
    RPortPrototype1_DdsRequiredServiceInstance127_ToDdsMachineMapping: service-instance=IflytekSensorCameraRearFullResolutionH265MDCA_DdsRequiredFunctionDataLoop
    RPortPrototype1_DdsRequiredServiceInstance128_ToDdsMachineMapping: service-instance=IflytekFmAMcuSentinel_DdsRequiredServiceInstance128
    RPortPrototype1_DdsRequiredServiceInstance129_ToDdsMachineMapping: service-instance=IflytekMcuFmASentinel_DdsRequiredServiceInstance129
    RPortPrototype1_DdsRequiredServiceInstance130_ToDdsMachineMapping: service-instance=IflytekFmADegradeFunciton_DdsRequiredServiceInstance130
    RPortPrototype1_DdsRequiredServiceInstance131_ToDdsMachineMapping: service-instance=IflytekEngineerInner_DdsRequiredServiceInstance131
    RPortPrototype1_DdsRequiredServiceInstance132_ToDdsMachineMapping: service-instance=IflytekCameraPerceptionAroundView2DBoundingBoxes_DdsRequiredServiceInstance132
    RPortPrototype1_DdsRequiredServiceInstance133_ToDdsMachineMapping: service-instance=IflytekCameraPerceptionPanoramaView2DBoundingBoxes_DdsRequiredServiceInstance133
    RPortPrototype1_DdsRequiredServiceInstance134_ToDdsMachineMapping: service-instance=IflytekCameraPerceptionScene_DdsRequiredServiceInstance134
  someip service instance to machine mapping IflytekAlarmInfoPhmB_ProvidedSomeipServiceInstance31_ToSomeIpMachineMapping: communication-connector=InnerEthernetCommConnector, service-instance=IflytekAlarmInfoPhmB_ProvidedSomeipFmBService, tcp-port=0
  someip service instance to machine mapping RPortPrototype1_RequiredSomeipServiceInstance26_ToSomeIpMachineMapping: communication-connector=InnerEthernetCommConnector, service-instance=IflytekAlarmInfoPhmB_RequiredSomeipSocBPhm, tcp-port=0
  10 x dds service instance to machine mapping, all with communication-connector=InnerEthernetCommConnector:
    RPortPrototype1_DdsRequiredServiceInstance135_ToDdsMachineMapping: service-instance=IflytekEhrPhmReport_DdsRequiredSocBPhm
    RPortPrototype1_DdsRequiredServiceInstance137_ToDdsMachineMapping: service-instance=IflytekLocalizationPhmReport_DdsRequiredSocBPhm
    RPortPrototype1_DdsRequiredServiceInstance138_ToDdsMachineMapping: service-instance=IflytekGnssPhmReport_DdsRequiredSocBPhm
    IflytekHmiPhmReport_DdsProvidedServiceInstance39_ToDdsMachineMapping: service-instance=IflytekHmiPhmReport_DdsProvidedHmiService
    RPortPrototype1_DdsRequiredServiceInstance139_ToDdsMachineMapping: service-instance=IflytekHmiPhmReport_DdsRequiredSocBPhm
    Iflytek4dRadarPhmReport_DdsProvidedServiceInstance40_ToDdsMachineMapping: service-instance=Iflytek4dRadarPhmReport_DdsProvidedRadar4dService
    RPortPrototype1_DdsRequiredServiceInstance140_ToDdsMachineMapping: service-instance=Iflytek4dRadarPhmReport_DdsRequiredSocBPhm
    RPortPrototype1_DdsRequiredServiceInstance141_ToDdsMachineMapping: service-instance=IflytekCameraPerceptionPanoramaPhmReport_DdsRequiredSocBPhm
    RPortPrototype1_DdsRequiredServiceInstance142_ToDdsMachineMapping: service-instance=IflytekFsmPhmReport_DdsRequiredSocBPhm
    RPortPrototype1_DdsRequiredServiceInstance143_ToDdsMachineMapping: service-instance=IflytekCameraPanoramaPhmReport_DdsRequiredSocBPhm
  someip service instance to machine mapping RPortPrototype1_RequiredSomeipServiceInstance27_ToSomeIpMachineMapping: communication-connector=InnerEthernetCommConnector, service-instance=IflytekConfigManager_RequiredSomeipSocBPhm, tcp-port=0
  someip service instance to machine mapping RPortPrototype1_RequiredSomeipServiceInstance28_ToSomeIpMachineMapping: communication-connector=InnerEthernetCommConnector, service-instance=IflytekStateManager_RequiredSomeipSocBPhm, tcp-port=0
  12 x dds service instance to machine mapping, all with communication-connector=InnerEthernetCommConnector:
    IflytekCameraPerceptionPanoramaLanelinePhmReport_DdsProvidedServiceInstance41_ToDdsMachineMapping: service-instance=IflytekCameraPerceptionPanoramaLanelinePhmReport_DdsProvidedPanoramaViewCameraPerceptionLaneline
    RPortPrototype1_DdsRequiredServiceInstance144_ToDdsMachineMapping: service-instance=IflytekCameraPerceptionPanoramaLanelinePhmReport_DdsRequiredSocAPhm
    RPortPrototype1_DdsRequiredServiceInstance145_ToDdsMachineMapping: service-instance=IflytekFusionObstaclePhmReport_DdsRequiredSocAPhm
    RPortPrototype1_DdsRequiredServiceInstance146_ToDdsMachineMapping: service-instance=IflytekPlanningPhmReport_DdsRequiredSocAPhm
    RPortPrototype1_DdsRequiredServiceInstance147_ToDdsMachineMapping: service-instance=IflytekComPncPhmReport_DdsRequiredSocAPhm
    IflytekCameraPerceptionAroundPhmReport_DdsProvidedServiceInstance42_ToDdsMachineMapping: service-instance=IflytekCameraPerceptionAroundPhmReport_DdsProvidedAroundViewCameraPerception
    RPortPrototype1_DdsRequiredServiceInstance148_ToDdsMachineMapping: service-instance=IflytekCameraPerceptionAroundPhmReport_DdsRequiredSocAPhm
    RPortPrototype1_DdsRequiredServiceInstance149_ToDdsMachineMapping: service-instance=IflytekCameraAroundPhmReport_DdsRequiredSocAPhm
    IflytekMegaPhmReport_DdsProvidedServiceInstance43_ToDdsMachineMapping: service-instance=IflytekMegaPhmReport_DdsProvidedMega
    RPortPrototype1_DdsRequiredServiceInstance150_ToDdsMachineMapping: service-instance=IflytekMegaPhmReport_DdsRequiredSocAPhm
    RPortPrototype1_DdsRequiredServiceInstance151_ToDdsMachineMapping: service-instance=IflytekControlPhmReport_DdsRequiredSocAPhm
    RPortPrototype1_DdsRequiredServiceInstance152_ToDdsMachineMapping: service-instance=IflytekFusionStaticPhmReport_DdsRequiredSocAPhm
  4 x someip service instance to machine mapping, all with communication-connector=InnerEthernetCommConnector, tcp-port=0:
    IflytekAlarmInfoPhmA_ProvidedSomeipServiceInstance32_ToSomeIpMachineMapping: service-instance=IflytekAlarmInfoPhmA_ProvidedSomeipFmAService
    RPortPrototype1_RequiredSomeipServiceInstance29_ToSomeIpMachineMapping: service-instance=IflytekAlarmInfoPhmA_RequiredSomeipSocAPhm
    RPortPrototype1_RequiredSomeipServiceInstance30_ToSomeIpMachineMapping: service-instance=IflytekConfigManager_RequiredSomeipServiceInstance30
    RPortPrototype1_RequiredSomeipServiceInstance31_ToSomeIpMachineMapping: service-instance=IflytekStateManager_RequiredSomeipSocAPhm
  5 x dds service instance to machine mapping, all with communication-connector=InnerEthernetCommConnector:
    IflytekCameraPerception3dOccupancyObjects_DdsProvidedServiceInstance44_ToDdsMachineMapping: service-instance=IflytekCameraPerception3dOccupancyObjects_DdsProvidedServiceInstance44
    RPortPrototype1_DdsRequiredServiceInstance153_ToDdsMachineMapping: service-instance=IflytekCameraPerception3dOccupancyObjects_DdsRequiredServiceInstance153
    RPortPrototype1_DdsRequiredServiceInstance154_ToDdsMachineMapping: service-instance=IflytekCameraState_DdsRequiredFmAService
    IflytekFdlUploadState_DdsProvidedServiceInstance45_ToDdsMachineMapping: service-instance=IflytekFdlUploadState_DdsProvidedFunctionDataLoop
    RPortPrototype1_DdsRequiredServiceInstance153_ToDdsMachineMapping: service-instance=IflytekFdlUploadState_DdsRequiredFmAService
  someip service instance to machine mapping IflytekFdlNetStatCheck_ProvidedSomeipServiceInstance33_ToSomeIpMachineMapping: communication-connector=InnerEthernetCommConnector, service-instance=IflytekFdlNetStatCheck_ProvidedSomeipFunctionDataLoop, tcp-port=0
  someip service instance to machine mapping RPortPrototype1_RequiredSomeipServiceInstance32_ToSomeIpMachineMapping: communication-connector=InnerEthernetCommConnector, service-instance=IflytekFdlNetStatCheck_RequiredSomeipFmAService, tcp-port=0
  28 x dds service instance to machine mapping, all with communication-connector=InnerEthernetCommConnector:
    IflytekDiskSpaceInfoPhmAOta_DdsProvidedServiceInstance46_ToDdsMachineMapping: service-instance=IflytekDiskSpaceInfoPhmAOta_DdsProvidedSocAPhm
    RPortPrototype1_DdsRequiredServiceInstance154_ToDdsMachineMapping: service-instance=IflytekDiskSpaceInfoPhmAOta_DdsRequiredOtaNode
    IflytekDiskSpaceInfoPhmBOta_DdsProvidedServiceInstance47_ToDdsMachineMapping: service-instance=IflytekDiskSpaceInfoPhmBOta_DdsProvidedSocBPhm
    RPortPrototype1_DdsRequiredServiceInstance155_ToDdsMachineMapping: service-instance=IflytekDiskSpaceInfoPhmBOta_DdsRequiredOtaNode
    IflytekDiskCleanRequest_DdsProvidedServiceInstance48_ToDdsMachineMapping: service-instance=IflytekDiskCleanRequest_DdsProvidedOtaNode
    RPortPrototype1_DdsRequiredServiceInstance156_ToDdsMachineMapping: service-instance=IflytekDiskCleanRequest_DdsRequiredSocAPhm
    RPortPrototype1_DdsRequiredServiceInstance157_ToDdsMachineMapping: service-instance=IflytekDiskCleanRequest_DdsRequiredSocBPhm
    IflytekDiskStatePhmAFdl_DdsProvidedServiceInstance49_ToDdsMachineMapping: service-instance=IflytekDiskStatePhmAFdl_DdsProvidedSocAPhm
    RPortPrototype1_DdsRequiredServiceInstance158_ToDdsMachineMapping: service-instance=IflytekDiskStatePhmAFdl_DdsRequiredFunctionDataLoop
    IflytekDiskCleanRequestPhmAFdl_DdsProvidedServiceInstance50_ToDdsMachineMapping: service-instance=IflytekDiskCleanRequestPhmAFdl_DdsProvidedSocAPhm
    RPortPrototype1_DdsRequiredServiceInstance159_ToDdsMachineMapping: service-instance=IflytekDiskCleanRequestPhmAFdl_DdsRequiredFunctionDataLoop
    IflytekDiskStatePhmBFdl_DdsProvidedServiceInstance51_ToDdsMachineMapping: service-instance=IflytekDiskStatePhmBFdl_DdsProvidedSocBPhm
    RPortPrototype1_DdsRequiredServiceInstance160_ToDdsMachineMapping: service-instance=IflytekDiskStatePhmBFdl_DdsRequiredFunctionDataLoop
    IflytekDiskCleanRequestPhmBFdl_DdsProvidedServiceInstance52_ToDdsMachineMapping: service-instance=IflytekDiskCleanRequestPhmBFdl_DdsProvidedSocBPhm
    RPortPrototype1_DdsRequiredServiceInstance161_ToDdsMachineMapping: service-instance=IflytekDiskCleanRequestPhmBFdl_DdsRequiredFunctionDataLoop
    IflytekSystemBProcessLoading_DdsProvidedServiceInstance53_ToDdsMachineMapping: service-instance=IflytekSystemBProcessLoading_DdsProvidedSystemMonitorB
    RPortPrototype1_DdsRequiredServiceInstance162_ToDdsMachineMapping: service-instance=IflytekSystemBProcessLoading_DdsRequiredFunctionDataLoop
    IflytekSystemAProcessLoading_DdsProvidedServiceInstance54_ToDdsMachineMapping: service-instance=IflytekSystemAProcessLoading_DdsProvidedSystemMonitorA
    RPortPrototype1_DdsRequiredServiceInstance163_ToDdsMachineMapping: service-instance=IflytekSystemAProcessLoading_DdsRequiredFunctionDataLoopA
    IflytekSystemBProcessLoading_DdsProvidedSystemMonitorB_ToDdsMachineMapping: service-instance=IflytekSystemBProcessLoading_DdsProvidedSystemMonitorB
    RPortPrototype1_DdsRequiredServiceInstance164_ToDdsMachineMapping: service-instance=IflytekCalibrationPhmReport_DdsRequiredSocBPhm
    IflytekFdlPhmReport_DdsProvidedServiceInstance55_ToDdsMachineMapping: service-instance=IflytekFdlPhmReport_DdsProvidedFunctionDataLoop
    RPortPrototype1_DdsRequiredServiceInstance165_ToDdsMachineMapping: service-instance=IflytekFdlPhmReport_DdsRequiredSocBPhm
    IflytekFdlAPhmReport_DdsProvidedServiceInstance56_ToDdsMachineMapping: service-instance=IflytekFdlAPhmReport_DdsProvidedFunctionDataLoopA
    RPortPrototype1_DdsRequiredServiceInstance166_ToDdsMachineMapping: service-instance=IflytekFdlAPhmReport_DdsRequiredSocAPhm
    RPortPrototype1_DdsRequiredServiceInstance167_ToDdsMachineMapping: service-instance=IflytekCalibrationDebugInfo_DdsRequiredFunctionDataLoop
    IflytekEhpPhmReport_DdsProvidedServiceInstance53_ToDdsMachineMapping: service-instance=IflytekEhpPhmReport_DdsProvidedEhp
    RPortPrototype1_DdsRequiredServiceInstance160_ToDdsMachineMapping: service-instance=IflytekEhpPhmReport_DdsRequiredSocAPhm
  someip service instance to machine mapping IflytekAlarmInfoEhp_ProvidedSomeipServiceInstance33_ToSomeIpMachineMapping: communication-connector=InnerEthernetCommConnector, service-instance=IflytekAlarmInfoEhp_ProvidedSomeipFmAService, tcp-port=0
  someip service instance to machine mapping RPortPrototype1_RequiredSomeipServiceInstance32_ToSomeIpMachineMapping: communication-connector=InnerEthernetCommConnector, service-instance=IflytekAlarmInfoEhp_RequiredSomeipEhp, tcp-port=0
  13 x dds service instance to machine mapping, all with communication-connector=InnerEthernetCommConnector:
    IflytekEhpParkingMap_DdsProvidedServiceInstance54_ToDdsMachineMapping: service-instance=IflytekEhpParkingMap_DdsProvidedEhp
    RPortPrototype1_DdsRequiredServiceInstance161_ToDdsMachineMapping: service-instance=IflytekLocalizationSemanticInfo_DdsRequiredEhp
    RPortPrototype1_DdsRequiredServiceInstance162_ToDdsMachineMapping: service-instance=IflytekEhpParkingMap_DdsRequiredFunctionDataLoop
    IflytekEhpParkingMapFileInfo_DdsProvidedServiceInstance55_ToDdsMachineMapping: service-instance=IflytekEhpParkingMapFileInfo_DdsProvidedEhp
    RPortPrototype1_DdsRequiredServiceInstance163_ToDdsMachineMapping: service-instance=IflytekEhpParkingMapFileInfo_DdsRequiredMega
    RPortPrototype1_DdsRequiredServiceInstance164_ToDdsMachineMapping: service-instance=IflytekEhpParkingMapFileInfo_DdsRequiredFunctionDataLoop
    IflytekEhpMapManager_DdsProvidedServiceInstance56_ToDdsMachineMapping: service-instance=IflytekEhpMapManager_DdsProvidedEhp
    RPortPrototype1_DdsRequiredServiceInstance165_ToDdsMachineMapping: service-instance=IflytekEhpMapManager_DdsRequiredFunctionDataLoop
    RPortPrototype1_DdsRequiredServiceInstance166_ToDdsMachineMapping: service-instance=IflytekMegaMappingStatus_DdsRequiredEhp
    RPortPrototype1_DdsRequiredServiceInstance167_ToDdsMachineMapping: service-instance=IflytekSensorGnss_DdsRequiredEhp
    RPortPrototype1_DdsRequiredServiceInstance168_ToDdsMachineMapping: service-instance=IflytekFsmSocState_DdsRequiredEhp
    RPortPrototype1_DdsRequiredServiceInstance169_ToDdsMachineMapping: service-instance=IflytekDiskSpaceInfoPhmAOta_DdsRequiredFmAService
    RPortPrototype1_DdsRequiredServiceInstance170_ToDdsMachineMapping: service-instance=IflytekDiskSpaceInfoPhmBOta_DdsRequiredFmAService
  4 x someip service instance to machine mapping, all with communication-connector=InnerEthernetCommConnector, tcp-port=0:
    IflytekObdUpdateEvent_ProvidedSomeipServiceInstance34_ToSomeIpMachineMapping: service-instance=IflytekObdUpdateEvent_ProvidedSomeipOtaNode
    RPortPrototype1_RequiredSomeipServiceInstance33_ToSomeIpMachineMapping: service-instance=IflytekObdUpdateEvent_RequiredSomeipFmAService
    IflytekOtaLogUploadRequest_ProvidedSomeipServiceInstance35_ToSomeIpMachineMapping: service-instance=IflytekOtaLogUploadRequest_ProvidedSomeipFunctionDataLoop
    RPortPrototype1_RequiredSomeipServiceInstance34_ToSomeIpMachineMapping: service-instance=IflytekOtaLogUploadRequest_RequiredSomeipOtaNode
  13 x dds service instance to machine mapping, all with communication-connector=InnerEthernetCommConnector:
    RPortPrototype1_DdsRequiredServiceInstance171_ToDdsMachineMapping: service-instance=IflytekCalibrationCalibInfo_DdsRequiredFmAService
    RPortPrototype1_DdsRequiredServiceInstance172_ToDdsMachineMapping: service-instance=IflytekSystemAProcessLoading_DdsRequiredFunctionDataLoop
    RPortPrototype1_DdsRequiredServiceInstance172_ToDdsMachineMapping: service-instance=IflytekLocalizationEgomotion_DdsRequiredServiceHmiService
    IflytekCameraPerceptionDrivableSpaceGrid_DdsProvidedServiceInstance56_ToDdsMachineMapping: service-instance=IflytekCameraPerceptionDrivableSpaceGrid_DdsProvidedPanoramaViewCameraPerceptionLaneline
    RPortPrototype1_DdsRequiredServiceInstance171_ToDdsMachineMapping: service-instance=IflytekCameraPerceptionDrivableSpaceGrid_DdsRequiredHmiService
    RPortPrototype1_DdsRequiredServiceInstance172_ToDdsMachineMapping: service-instance=IflytekCameraPerceptionDrivableSpaceGrid_DdsRequiredFunctionDataLoop
    RPortPrototype1_DdsRequiredServiceInstance172_ToDdsMachineMapping: service-instance=IflytekCameraPerceptionObstacleFeature_DdsRequiredPanoramaViewCameraPerceptionLaneline
    RPortPrototype1_DdsRequiredServiceInstance173_ToDdsMachineMapping: service-instance=IflytekCameraPerceptionLaneFeature_DdsRequiredPanoramaViewCameraPerceptionLaneline
    RPortPrototype1_DdsRequiredServiceInstance174_ToDdsMachineMapping: service-instance=IflytekSensorGnss_DdsRequiredSdmap
    IflytekEhpParkingMapToHmi_DdsProvidedServiceInstance57_ToDdsMachineMapping: service-instance=IflytekEhpParkingMapToHmi_DdsProvidedEhp
    RPortPrototype1_DdsRequiredServiceInstance175_ToDdsMachineMapping: service-instance=IflytekEhpParkingMapToHmi_DdsRequiredHmiService
    RPortPrototype1_DdsRequiredServiceInstance176_ToDdsMachineMapping: service-instance=IflytekEhpParkingMapToHmi_DdsRequiredFunctionDataLoop
    RPortPrototype1_DdsRequiredServiceInstance177_ToDdsMachineMapping: service-instance=IflytekCanTxInfo_DdsRequiredFunctionDataLoop
package /HuaweiMDC/instance_manifests/requiredInstances
  4 x dds required service instance, all with service-interface-deployment=CameraStructContainerDdsInterfaceDeployment, qos-profile=small_buffer_qos.xml, domain-id=30, transport-plugins=NDSHM, dds-event-qos-props=DdsEventDeployment:
    IflytekSensorCameraSurroundResizeImageFront_DdsRequiredServiceInstance20: required-service-instance-id=10023
    IflytekSensorCameraSurroundResizeImageLeft_DdsRequiredServiceInstance21: required-service-instance-id=10024
    IflytekSensorCameraSurroundResizeImageRight_DdsRequiredServiceInstance22: required-service-instance-id=10041
    IflytekSensorCameraSurroundResizeImageRear_DdsRequiredServiceInstance23: required-service-instance-id=10042
  5 x required someip service instance, all with service-interface-deployment=FmAlarmReceiveServiceDeployment:
    IflytekAlarmInfoSdmap_RequiredSomeipServiceInstance1: required-service-instance-id=10003
    IflytekAlarmInfoAroundViewCameraPerception_RequiredSomeipServiceInstance2: required-service-instance-id=10004
    IflytekAlarmInfoPanoramaViewCameraPerceptionLaneline_RequiredSomeipServiceInstance3: required-service-instance-id=10006
    IflytekAlarmInfoHmiService_RequiredSomeipHmiService: required-service-instance-id=10023
    IflytekAlarmInfoMdcB_RequiredSomeipServiceInstance8: required-service-instance-id=2
  6 x dds required service instance, all with service-interface-deployment=StructContainerDdsInterfaceDeployment, domain-id=30, transport-plugins=FSHM, dds-event-qos-props=eventDdsDeployment:
    IflytekLocalizationEgomotion_DdsRequiredServiceInstance29: qos-profile=small_buffer_qos.xml, required-service-instance-id=10016
    IflytekCameraPerceptionParkingSlotList_DdsRequiredServiceInstance29: qos-profile=default_qos.xml, required-service-instance-id=10014
    IflytekCameraPerceptionDeceler_DdsRequiredServiceInstance29: qos-profile=small_buffer_qos.xml, required-service-instance-id=10079
    IflytekCameraPerceptionGroundLine_DdsRequiredServiceInstance29: qos-profile=customized_qos.xml, required-service-instance-id=10065
    IflytekCameraPerceptionParkingLaneLine_DdsRequiredServiceInstance29: qos-profile=customized_qos.xml, required-service-instance-id=10074
    IflytekLocalizationEgomotion_DdsRequiredServiceInstance30: qos-profile=small_buffer_qos.xml, required-service-instance-id=10083
  required someip service instance IflytekAlarmInfoMega_RequiredSomeipServiceInstance9: service-interface-deployment=FmAlarmReceiveServiceDeployment, required-service-instance-id=10026
  dds required service instance IflytekLocalizationSemanticInfo_DdsRequiredServiceInstance31: service-interface-deployment=StructContainerDdsInterfaceDeployment, qos-profile=small_buffer_qos.xml, domain-id=30, transport-plugins=FSHM, dds-event-qos-props=eventDdsDeployment, required-service-instance-id=10089
  dds required service instance IflytekCameraPerception3dGeneralObjects_DdsRequiredServiceInstance34: service-interface-deployment=StructContainerDdsInterfaceDeployment, qos-profile=customized_qos.xml, domain-id=30, transport-plugins=FSHM, dds-event-qos-props=eventDdsDeployment, required-service-instance-id=10043
  6 x required someip service instance:
    IflytekSensorGetSurroundCameraIntriParam_RequiredSomeipFmAService: service-interface-deployment=ClientServiceContainerInterfaceDeployment, required-service-instance-id=10032
      someip required event group eventGroup1: event-group=SomeipEventGroup
    IflytekSensorGetPanoramaCameraIntriParam_RequiredSomeipFmAService: service-interface-deployment=ClientServiceContainerInterfaceDeployment, required-service-instance-id=10034
      someip required event group eventGroup1: event-group=SomeipEventGroup
    IflytekSensorWriteFile_RequiredSomeipFmAService: service-interface-deployment=ClientServiceContainerInterfaceDeployment, required-service-instance-id=10035
      someip required event group eventGroup1: event-group=SomeipEventGroup
    IflytekFactoryCalibrationActivation_RequiredSomeipFmAService: service-interface-deployment=ClientServiceContainerInterfaceDeployment, required-service-instance-id=10029
      someip required event group eventGroup1: event-group=SomeipEventGroup
    IflytekFactoryCalibrationResult_RequiredSomeipFmAService: service-interface-deployment=ClientServiceContainerInterfaceDeployment, required-service-instance-id=10030
      someip required event group eventGroup1: event-group=SomeipEventGroup
    IflytekStateManager_RequiredSomeipFmAService: service-interface-deployment=TriggerInOutDeployment, required-service-instance-id=1
      someip required event group eventGroup1: event-group=NotifierSomeipEventGroup
  12 x dds required service instance, all with qos-profile=small_buffer_qos.xml, domain-id=30:
    IflytekLocalizationEgomotion_DdsRequiredServiceInstance47: service-interface-deployment=StructContainerDdsInterfaceDeployment, transport-plugins=FSHM, dds-event-qos-props=eventDdsDeployment, required-service-instance-id=10083
    IflytekAlarmInfoSoc_DdsRequiredFmAService: service-interface-deployment=StructContainerDdsInterfaceDeployment, transport-plugins=FSHM, dds-event-qos-props=eventDdsDeployment, required-service-instance-id=10027
    IflytekSensorCameraSurroundFrontFullResolutionH265_DdsRequiredServiceInstance44: service-interface-deployment=CameraStructContainerDdsInterfaceDeployment, transport-plugins=NDSHM, dds-event-qos-props=DdsEventDeployment, required-service-instance-id=10115
    IflytekSensorCameraSurroundLeftFullResolutionH265_DdsRequiredServiceInstance41: service-interface-deployment=CameraStructContainerDdsInterfaceDeployment, transport-plugins=NDSHM, dds-event-qos-props=DdsEventDeployment, required-service-instance-id=10116
    IflytekSensorCameraSurroundRearFullResolutionH265_DdsRequiredServiceInstance42: service-interface-deployment=CameraStructContainerDdsInterfaceDeployment, transport-plugins=NDSHM, dds-event-qos-props=DdsEventDeployment, required-service-instance-id=10117
    IflytekSensorCameraSurroundRightFullResolutionH265_DdsRequiredServiceInstance43: service-interface-deployment=CameraStructContainerDdsInterfaceDeployment, transport-plugins=NDSHM, dds-event-qos-props=DdsEventDeployment, required-service-instance-id=10118
    IflytekSensorCameraFront30FullResolutionH265_DdsRequiredServiceInstance39: service-interface-deployment=CameraStructContainerDdsInterfaceDeployment, transport-plugins=NDSHM, dds-event-qos-props=DdsEventDeployment, required-service-instance-id=10126
    IflytekSensorCameraFront120FullResolutionH265_DdsRequiredServiceInstance40: service-interface-deployment=CameraStructContainerDdsInterfaceDeployment, transport-plugins=NDSHM, dds-event-qos-props=DdsEventDeployment, required-service-instance-id=10107
    IflytekSensorCameraSideFlFullResolutionH265_DdsRequiredServiceInstance41: service-interface-deployment=CameraStructContainerDdsInterfaceDeployment, transport-plugins=NDSHM, dds-event-qos-props=DdsEventDeployment, required-service-instance-id=10127
    IflytekSensorCameraSideFrFullResolutionH265_DdsRequiredServiceInstance42: service-interface-deployment=CameraStructContainerDdsInterfaceDeployment, transport-plugins=NDSHM, dds-event-qos-props=DdsEventDeployment, required-service-instance-id=10128
    IflytekSensorCameraSideRlFullResolutionH265_DdsRequiredServiceInstance43: service-interface-deployment=CameraStructContainerDdsInterfaceDeployment, transport-plugins=NDSHM, dds-event-qos-props=DdsEventDeployment, required-service-instance-id=10129
    IflytekSensorCameraSideRrFullResolutionH265_DdsRequiredServiceInstance44: service-interface-deployment=CameraStructContainerDdsInterfaceDeployment, transport-plugins=NDSHM, dds-event-qos-props=DdsEventDeployment, required-service-instance-id=10130
  required someip service instance IflytekAlarmInfoRadar4dService_RequiredSomeipServiceInstance18: service-interface-deployment=FmAlarmReceiveServiceDeployment, required-service-instance-id=10012
  dds required service instance IflytekLocalizationEgomotion_DdsRequiredServiceInstance46: service-interface-deployment=StructContainerDdsInterfaceDeployment, qos-profile=small_buffer_qos.xml, domain-id=30, transport-plugins=FSHM, dds-event-qos-props=eventDdsDeployment, required-service-instance-id=10083
  dds required service instance IflytekSensorCameraRearFullResolutionH265MDCA_DdsRequiredServiceInstance49: service-interface-deployment=CameraStructContainerDdsInterfaceDeployment, qos-profile=small_buffer_qos.xml, domain-id=30, transport-plugins=NDSHM, dds-event-qos-props=DdsEventDeployment, required-service-instance-id=10135
  required someip service instance IflytekConfigManager_RequiredSomeipServiceInstance20: service-interface-deployment=ConfigServerSomeipServiceInterfaceDeployment, required-service-instance-id=1
    someip required event group eventGroup1: event-group=ParamUpdateEventGroup
    someip required event group eventGroup2: event-group=ServerNotifyEventGroup
  required someip service instance IflytekConfigManager_RequiredSomeipServiceInstance22: service-interface-deployment=ConfigServerSomeipServiceInterfaceDeployment, required-service-instance-id=1
    someip required event group eventGroup1: event-group=ParamUpdateEventGroup
    someip required event group eventGroup2: event-group=ServerNotifyEventGroup
  required someip service instance IflytekAlarmInfoMdcB_RequiredSomeipServiceInstance24: service-interface-deployment=FmAlarmReceiveServiceDeployment, required-service-instance-id=2
  8 x dds required service instance, all with service-interface-deployment=StructContainerDdsInterfaceDeployment, qos-profile=small_buffer_qos.xml, domain-id=30, transport-plugins=FSHM, dds-event-qos-props=eventDdsDeployment:
    IflytekSensorImu_DdsRequiredServiceInstance40: required-service-instance-id=10008
    IflytekSensorMcuToFmInfo_DdsRequiredFmAService: required-service-instance-id=10019
    IflytekAlarmInfoMcu_DdsRequiredFmAService: required-service-instance-id=10020
    IflytekVehicleService_DdsRequiredHmiService: required-service-instance-id=10034
    IflytekHmiMcuToSocBsw_DdsRequiredHmiService: required-service-instance-id=10035
    IflytekFusionSpatialParkingSlot_DdsRequiredServiceInstance48: required-service-instance-id=10087
    IflytekUssUsswaveInfo_DdsRequiredServiceInstance47: required-service-instance-id=10018
    IflytekVehicleService_DdsRequiredServiceInstance47: required-service-instance-id=10009
  required someip service instance IflytekAlarmInfoOtaNode_RequiredSomeipServiceInstance24: service-interface-deployment=FmAlarmReceiveServiceDeployment, required-service-instance-id=10024
  dds required service instance IflytekVehicleService_DdsRequiredServiceInstance48: service-interface-deployment=StructContainerDdsInterfaceDeployment, qos-profile=small_buffer_qos.xml, domain-id=30, transport-plugins=FSHM, dds-event-qos-props=eventDdsDeployment, required-service-instance-id=10009
  required someip service instance IflytekAlarmInfoMdcA_RequiredSomeipMdcAFm: service-interface-deployment=FmAlarmReceiveServiceDeployment, required-service-instance-id=1
  required someip service instance IflytekConfigManager_RequiredSomeipFmAService: service-interface-deployment=ConfigServerSomeipServiceInterfaceDeployment, required-service-instance-id=1
    someip required event group eventGroup1: event-group=ParamUpdateEventGroup
    someip required event group eventGroup2: event-group=ServerNotifyEventGroup
  64 x dds required service instance, all with domain-id=30:
    IflytekFsmHmiSocOuter_DdsRequiredHmiService: service-interface-deployment=StructContainerDdsInterfaceDeployment, qos-profile=customized_qos.xml, transport-plugins=FSHM, dds-event-qos-props=eventDdsDeployment, required-service-instance-id=10105
    IflytekFsmSocState_DdsRequiredHmiService: service-interface-deployment=StructContainerDdsInterfaceDeployment, qos-profile=small_buffer_qos.xml, transport-plugins=FSHM, dds-event-qos-props=eventDdsDeployment, required-service-instance-id=10104
    IflytekFsmSocState_DdsRequiredServiceInstance{45..47}: service-interface-deployment=StructContainerDdsInterfaceDeployment, qos-profile=small_buffer_qos.xml, transport-plugins=FSHM, dds-event-qos-props=eventDdsDeployment, required-service-instance-id=10110
    IflytekCalibrationCalibInfo_DdsRequiredServiceInstance48: service-interface-deployment=StructContainerDdsInterfaceDeployment, qos-profile=small_buffer_qos.xml, transport-plugins=FSHM, dds-event-qos-props=eventDdsDeployment, required-service-instance-id=10039
    IflytekSensorCameraSurroundFrontFullResolutionH265_DdsRequiredServiceInstance49: service-interface-deployment=CameraStructContainerDdsInterfaceDeployment, qos-profile=small_buffer_qos.xml, transport-plugins=NDSHM, dds-event-qos-props=DdsEventDeployment, required-service-instance-id=10111
    IflytekSensorCameraSurroundLeftFullResolutionH265_DdsRequiredServiceInstance50: service-interface-deployment=CameraStructContainerDdsInterfaceDeployment, qos-profile=small_buffer_qos.xml, transport-plugins=NDSHM, dds-event-qos-props=DdsEventDeployment, required-service-instance-id=10112
    IflytekSensorCameraSurroundRearFullResolutionH265_DdsRequiredServiceInstance51: service-interface-deployment=CameraStructContainerDdsInterfaceDeployment, qos-profile=small_buffer_qos.xml, transport-plugins=NDSHM, dds-event-qos-props=DdsEventDeployment, required-service-instance-id=10113
    IflytekSensorCameraSurroundRightFullResolutionH265_DdsRequiredServiceInstance52: service-interface-deployment=CameraStructContainerDdsInterfaceDeployment, qos-profile=small_buffer_qos.xml, transport-plugins=NDSHM, dds-event-qos-props=DdsEventDeployment, required-service-instance-id=10124
    IflytekSensorCameraFront120FullResolutionH265_DdsRequiredServiceInstance53: service-interface-deployment=CameraStructContainerDdsInterfaceDeployment, qos-profile=small_buffer_qos.xml, transport-plugins=NDSHM, dds-event-qos-props=DdsEventDeployment, required-service-instance-id=10106
    IflytekSensorCameraFront30FullResolutionH265_DdsRequiredServiceInstance54: service-interface-deployment=CameraStructContainerDdsInterfaceDeployment, qos-profile=small_buffer_qos.xml, transport-plugins=NDSHM, dds-event-qos-props=DdsEventDeployment, required-service-instance-id=10119
    IflytekSensorCameraSideFlFullResolutionH265_DdsRequiredServiceInstance55: service-interface-deployment=CameraStructContainerDdsInterfaceDeployment, qos-profile=small_buffer_qos.xml, transport-plugins=NDSHM, dds-event-qos-props=DdsEventDeployment, required-service-instance-id=10120
    IflytekSensorCameraSideFrFullResolutionH265_DdsRequiredServiceInstance56: service-interface-deployment=CameraStructContainerDdsInterfaceDeployment, qos-profile=small_buffer_qos.xml, transport-plugins=NDSHM, dds-event-qos-props=DdsEventDeployment, required-service-instance-id=10121
    IflytekSensorCameraSideRlFullResolutionH265_DdsRequiredServiceInstance57: service-interface-deployment=CameraStructContainerDdsInterfaceDeployment, qos-profile=small_buffer_qos.xml, transport-plugins=NDSHM, dds-event-qos-props=DdsEventDeployment, required-service-instance-id=10122
    IflytekSensorCameraSideRrFullResolutionH265_DdsRequiredServiceInstance58: service-interface-deployment=CameraStructContainerDdsInterfaceDeployment, qos-profile=small_buffer_qos.xml, transport-plugins=NDSHM, dds-event-qos-props=DdsEventDeployment, required-service-instance-id=10123
    IflytekSensorCameraRearFullResolutionH265_DdsRequiredServiceInstance59: service-interface-deployment=CameraStructContainerDdsInterfaceDeployment, qos-profile=small_buffer_qos.xml, transport-plugins=NDSHM, dds-event-qos-props=DdsEventDeployment, required-service-instance-id=10125
    IflytekCameraPerceptionTrafficSignRecognition_DdsRequiredServiceInstance60: service-interface-deployment=StructContainerDdsInterfaceDeployment, qos-profile=small_buffer_qos.xml, transport-plugins=FSHM, dds-event-qos-props=eventDdsDeployment, required-service-instance-id=10067
    IflytekCameraPerceptionOccGrid_DdsRequiredServiceInstance61: service-interface-deployment=StructContainerDdsInterfaceDeployment, qos-profile=default_qos.xml, transport-plugins=FSHM, dds-event-qos-props=eventDdsDeployment, required-service-instance-id=10175
    IflytekCameraPerceptionLaneTopo_DdsRequiredServiceInstance63: service-interface-deployment=StructContainerDdsInterfaceDeployment, qos-profile=customized_qos.xml, transport-plugins=FSHM, dds-event-qos-props=eventDdsDeployment, required-service-instance-id=10131
    IflytekPredictionPredictionResult_DdsRequiredServiceInstance64: service-interface-deployment=StructContainerDdsInterfaceDeployment, qos-profile=customized_qos.xml, transport-plugins=FSHM, dds-event-qos-props=eventDdsDeployment, required-service-instance-id=10132
    IflytekCameraPerceptionLaneLines_DdsRequiredServiceInstance65: service-interface-deployment=StructContainerDdsInterfaceDeployment, qos-profile=customized_qos.xml, transport-plugins=FSHM, dds-event-qos-props=eventDdsDeployment, required-service-instance-id=10031
    IflytekCameraPerceptionObjects_DdsRequiredServiceInstance66: service-interface-deployment=StructContainerDdsInterfaceDeployment, qos-profile=customized_qos.xml, transport-plugins=FSHM, dds-event-qos-props=eventDdsDeployment, required-service-instance-id=10036
    IflytekCameraPerceptionOccupancyObjects_DdsRequiredServiceInstance67: service-interface-deployment=StructContainerDdsInterfaceDeployment, qos-profile=large_buffer_qos.xml, transport-plugins=FSHM, dds-event-qos-props=eventDdsDeployment, required-service-instance-id=10134
    IflytekCameraPerception3dGeneralObjects_DdsRequiredServiceInstance68: service-interface-deployment=StructContainerDdsInterfaceDeployment, qos-profile=customized_qos.xml, transport-plugins=FSHM, dds-event-qos-props=eventDdsDeployment, required-service-instance-id=10003
    IflytekCameraPerceptionParkingSlotList_DdsRequiredServiceInstance69: service-interface-deployment=StructContainerDdsInterfaceDeployment, qos-profile=default_qos.xml, transport-plugins=FSHM, dds-event-qos-props=eventDdsDeployment, required-service-instance-id=10138
    IflytekCameraPerceptionParkingLaneLine_DdsRequiredServiceInstance70: service-interface-deployment=StructContainerDdsInterfaceDeployment, qos-profile=customized_qos.xml, transport-plugins=FSHM, dds-event-qos-props=eventDdsDeployment, required-service-instance-id=10139
    IflytekCameraPerceptionGroundLine_DdsRequiredServiceInstance71: service-interface-deployment=StructContainerDdsInterfaceDeployment, qos-profile=customized_qos.xml, transport-plugins=FSHM, dds-event-qos-props=eventDdsDeployment, required-service-instance-id=10038
    IflytekCameraPerceptionDeceler_DdsRequiredServiceInstance72: service-interface-deployment=StructContainerDdsInterfaceDeployment, qos-profile=small_buffer_qos.xml, transport-plugins=FSHM, dds-event-qos-props=eventDdsDeployment, required-service-instance-id=10070
    IflytekFusionSpatialParkingSlot_DdsRequiredServiceInstance73: service-interface-deployment=StructContainerDdsInterfaceDeployment, qos-profile=small_buffer_qos.xml, transport-plugins=FSHM, dds-event-qos-props=eventDdsDeployment, required-service-instance-id=10082
    IflytekFusionParkingSlot_DdsRequiredServiceInstance74: service-interface-deployment=StructContainerDdsInterfaceDeployment, qos-profile=small_buffer_qos.xml, transport-plugins=FSHM, dds-event-qos-props=eventDdsDeployment, required-service-instance-id=10077
    IflytekFusionRoadFusion_DdsRequiredServiceInstance75: service-interface-deployment=StructContainerDdsInterfaceDeployment, qos-profile=customized_qos.xml, transport-plugins=FSHM, dds-event-qos-props=eventDdsDeployment, required-service-instance-id=10071
    IflytekFusionObjects_DdsRequiredServiceInstance76: service-interface-deployment=StructContainerDdsInterfaceDeployment, qos-profile=customized_qos.xml, transport-plugins=FSHM, dds-event-qos-props=eventDdsDeployment, required-service-instance-id=10037
    IflytekFusionObjectsCompress_DdsRequiredServiceInstance77: service-interface-deployment=StructContainerDdsInterfaceDeployment, qos-profile=small_buffer_qos.xml, transport-plugins=FSHM, dds-event-qos-props=eventDdsDeployment, required-service-instance-id=10140
    IflytekFusionUssPerceptionInfo_DdsRequiredServiceInstance78: service-interface-deployment=StructContainerDdsInterfaceDeployment, qos-profile=customized_qos.xml, transport-plugins=FSHM, dds-event-qos-props=eventDdsDeployment, required-service-instance-id=10141
    IflytekFusionOccupancyObjects_DdsRequiredServiceInstance79: service-interface-deployment=StructContainerDdsInterfaceDeployment, qos-profile=large_buffer_qos.xml, transport-plugins=FSHM, dds-event-qos-props=eventDdsDeployment, required-service-instance-id=10142
    IflytekFusionRoadFusionCompress_DdsRequiredServiceInstance80: service-interface-deployment=StructContainerDdsInterfaceDeployment, qos-profile=small_buffer_qos.xml, transport-plugins=FSHM, dds-event-qos-props=eventDdsDeployment, required-service-instance-id=10143
    IflytekFusionGroundLine_DdsRequiredServiceInstance81: service-interface-deployment=StructContainerDdsInterfaceDeployment, qos-profile=default_qos.xml, transport-plugins=FSHM, dds-event-qos-props=eventDdsDeployment, required-service-instance-id=10144
    IflytekFusionSpeedBump_DdsRequiredServiceInstance82: service-interface-deployment=StructContainerDdsInterfaceDeployment, qos-profile=small_buffer_qos.xml, transport-plugins=FSHM, dds-event-qos-props=eventDdsDeployment, required-service-instance-id=10145
    IflytekMegaLocalMap_DdsRequiredServiceInstance83: service-interface-deployment=StructContainerDdsInterfaceDeployment, qos-profile=customized_qos.xml, transport-plugins=FSHM, dds-event-qos-props=eventDdsDeployment, required-service-instance-id=10092
    IflytekMegaMappingStatus_DdsRequiredServiceInstance84: service-interface-deployment=StructContainerDdsInterfaceDeployment, qos-profile=small_buffer_qos.xml, transport-plugins=FSHM, dds-event-qos-props=eventDdsDeployment, required-service-instance-id=10058
    IflytekUssUsswaveInfo_DdsRequiredServiceInstance85: service-interface-deployment=StructContainerDdsInterfaceDeployment, qos-profile=small_buffer_qos.xml, transport-plugins=FSHM, dds-event-qos-props=eventDdsDeployment, required-service-instance-id=10146
    IflytekRadarFlPerceptionInfo_DdsRequiredServiceInstance86: service-interface-deployment=StructContainerDdsInterfaceDeployment, qos-profile=small_buffer_qos.xml, transport-plugins=FSHM, dds-event-qos-props=eventDdsDeployment, required-service-instance-id=10147
    IflytekRadarFrPerceptionInfo_DdsRequiredServiceInstance87: service-interface-deployment=StructContainerDdsInterfaceDeployment, qos-profile=small_buffer_qos.xml, transport-plugins=FSHM, dds-event-qos-props=eventDdsDeployment, required-service-instance-id=10148
    IflytekRadarRlPerceptionInfo_DdsRequiredServiceInstance88: service-interface-deployment=StructContainerDdsInterfaceDeployment, qos-profile=small_buffer_qos.xml, transport-plugins=FSHM, dds-event-qos-props=eventDdsDeployment, required-service-instance-id=10149
    IflytekRadarRrPerceptionInfo_DdsRequiredServiceInstance89: service-interface-deployment=StructContainerDdsInterfaceDeployment, qos-profile=small_buffer_qos.xml, transport-plugins=FSHM, dds-event-qos-props=eventDdsDeployment, required-service-instance-id=10150
    IflytekRadarFmPerception4dPointCloud_DdsRequiredServiceInstance90: service-interface-deployment=StructContainerDdsInterfaceDeployment, qos-profile=customized_qos.xml, transport-plugins=FSHM, dds-event-qos-props=eventDdsDeployment, required-service-instance-id=10010
    IflytekRadarFmPerception4dTarget_DdsRequiredServiceInstance91: service-interface-deployment=StructContainerDdsInterfaceDeployment, qos-profile=small_buffer_qos.xml, transport-plugins=FSHM, dds-event-qos-props=eventDdsDeployment, required-service-instance-id=10084
    IflytekSensorImu_DdsRequiredServiceInstance92: service-interface-deployment=StructContainerDdsInterfaceDeployment, qos-profile=small_buffer_qos.xml, transport-plugins=FSHM, dds-event-qos-props=eventDdsDeployment, required-service-instance-id=10033
    IflytekVehicleService_DdsRequiredServiceInstance93: service-interface-deployment=StructContainerDdsInterfaceDeployment, qos-profile=small_buffer_qos.xml, transport-plugins=FSHM, dds-event-qos-props=eventDdsDeployment, required-service-instance-id=10034
    IflytekSensorGnss_DdsRequiredServiceInstance94: service-interface-deployment=StructContainerDdsInterfaceDeployment, qos-profile=small_buffer_qos.xml, transport-plugins=FSHM, dds-event-qos-props=eventDdsDeployment, required-service-instance-id=10056
    IflytekLocalizationEgomotion_DdsRequiredServiceInstance95: service-interface-deployment=StructContainerDdsInterfaceDeployment, qos-profile=small_buffer_qos.xml, transport-plugins=FSHM, dds-event-qos-props=eventDdsDeployment, required-service-instance-id=10016
    IflytekLocalizationSemanticInfo_DdsRequiredServiceInstance96: service-interface-deployment=StructContainerDdsInterfaceDeployment, qos-profile=small_buffer_qos.xml, transport-plugins=FSHM, dds-event-qos-props=eventDdsDeployment, required-service-instance-id=10088
    IflytekEhrSdmapInfo_DdsRequiredServiceInstance97: service-interface-deployment=StructContainerDdsInterfaceDeployment, qos-profile=customized_qos.xml, transport-plugins=FSHM, dds-event-qos-props=eventDdsDeployment, required-service-instance-id=10013
    IflytekEhrStaticMap_DdsRequiredServiceInstance98: service-interface-deployment=StructContainerDdsInterfaceDeployment, qos-profile=large_buffer_qos.xml, transport-plugins=FSHM, dds-event-qos-props=eventDdsDeployment, required-service-instance-id=10096
    IflytekEhrSdpromapInfo_DdsRequiredServiceInstance99: service-interface-deployment=StructContainerDdsInterfaceDeployment, qos-profile=customized_qos.xml, transport-plugins=FSHM, dds-event-qos-props=eventDdsDeployment, required-service-instance-id=10173
    IflytekHmiInner_DdsRequiredServiceInstance103: service-interface-deployment=StructContainerDdsInterfaceDeployment, qos-profile=small_buffer_qos.xml, transport-plugins=FSHM, dds-event-qos-props=eventDdsDeployment, required-service-instance-id=10007
    IflytekFsmSocState_DdsRequiredServiceInstance104: service-interface-deployment=StructContainerDdsInterfaceDeployment, qos-profile=small_buffer_qos.xml, transport-plugins=FSHM, dds-event-qos-props=eventDdsDeployment, required-service-instance-id=10104
    IflytekFsmHmiSocOuter_DdsRequiredServiceInstance105: service-interface-deployment=StructContainerDdsInterfaceDeployment, qos-profile=customized_qos.xml, transport-plugins=FSHM, dds-event-qos-props=eventDdsDeployment, required-service-instance-id=10105
    IflytekAdasFunctionAdas_DdsRequiredServiceInstance106: service-interface-deployment=StructContainerDdsInterfaceDeployment, qos-profile=small_buffer_qos.xml, transport-plugins=FSHM, dds-event-qos-props=eventDdsDeployment, required-service-instance-id=10152
    IflytekControlControlCommand_DdsRequiredServiceInstance107: service-interface-deployment=StructContainerDdsInterfaceDeployment, qos-profile=small_buffer_qos.xml, transport-plugins=FSHM, dds-event-qos-props=eventDdsDeployment, required-service-instance-id=10153
    IflytekPlanningPlan_DdsRequiredServiceInstance108: service-interface-deployment=StructContainerDdsInterfaceDeployment, qos-profile=default_qos.xml, transport-plugins=FSHM, dds-event-qos-props=eventDdsDeployment, required-service-instance-id=10103
    IflytekPlanningHmi_DdsRequiredServiceInstance109: service-interface-deployment=StructContainerDdsInterfaceDeployment, qos-profile=default_qos.xml, transport-plugins=FSHM, dds-event-qos-props=eventDdsDeployment, required-service-instance-id=10085
    IflytekSdmapSdmapInfo_DdsRequiredServiceInstance110: service-interface-deployment=StructContainerDdsInterfaceDeployment, qos-profile=large_buffer_qos.xml, transport-plugins=FSHM, dds-event-qos-props=eventDdsDeployment, required-service-instance-id=10012
  required someip service instance IflytekAlarmInfoFdl_RequiredSomeipServiceInstance24: service-interface-deployment=FmAlarmReceiveServiceDeployment, required-service-instance-id=10036
  dds required service instance IflytekDTCInfoFmAService_DdsRequiredServiceInstance112: service-interface-deployment=StructContainerDdsInterfaceDeployment, qos-profile=default_qos.xml, domain-id=30, transport-plugins=FSHM, dds-event-qos-props=eventDdsDeployment, required-service-instance-id=10157
  dds required service instance IflytekAlarmInfoFmAService_DdsRequiredServiceInstance113: service-interface-deployment=StructContainerDdsInterfaceDeployment, qos-profile=small_buffer_qos.xml, domain-id=30, transport-plugins=FSHM, dds-event-qos-props=eventDdsDeployment, required-service-instance-id=10158
  4 x required someip service instance:
    IflytekConfigManager_RequiredSomeipServiceInstance25: service-interface-deployment=ConfigServerSomeipServiceInterfaceDeployment, required-service-instance-id=1
      someip required event group eventGroup1: event-group=ParamUpdateEventGroup
      someip required event group eventGroup2: event-group=ServerNotifyEventGroup
    IflytekPostSaleCalibrationActivation_RequiredSomeipFmAService: service-interface-deployment=ClientServiceContainerInterfaceDeployment, required-service-instance-id=10037
      someip required event group eventGroup1: event-group=SomeipEventGroup
    IflytekPostSaleCalibrationStop_RequiredSomeipFmAService: service-interface-deployment=ClientServiceContainerInterfaceDeployment, required-service-instance-id=10038
      someip required event group eventGroup1: event-group=SomeipEventGroup
    IflytekPostSaleCalibrationResult_RequiredSomeipFmAService: service-interface-deployment=ClientServiceContainerInterfaceDeployment, required-service-instance-id=10039
      someip required event group eventGroup1: event-group=SomeipEventGroup
  20 x dds required service instance, all with domain-id=30:
    IflytekVehicleService_DdsRequiredMega: service-interface-deployment=StructContainerDdsInterfaceDeployment, qos-profile=small_buffer_qos.xml, transport-plugins=FSHM, dds-event-qos-props=eventDdsDeployment, required-service-instance-id=10009
    IflytekVehicleService_DdsRequiredFmAService: service-interface-deployment=StructContainerDdsInterfaceDeployment, qos-profile=small_buffer_qos.xml, transport-plugins=FSHM, dds-event-qos-props=eventDdsDeployment, required-service-instance-id=10009
    IflytekCameraPerceptionOccupancyObjects_DdsRequiredHmiService: service-interface-deployment=StructContainerDdsInterfaceDeployment, qos-profile=large_buffer_qos.xml, transport-plugins=FSHM, dds-event-qos-props=eventDdsDeployment, required-service-instance-id=10134
    IflytekSystemVersion_DdsRequiredFunctionDataLoop: service-interface-deployment=StructContainerDdsInterfaceDeployment, qos-profile=small_buffer_qos.xml, transport-plugins=FSHM, dds-event-qos-props=eventDdsDeployment, required-service-instance-id=10160
    IflytekFdlTriggerAck_DdsRequiredFunctionDataLoopB: service-interface-deployment=StructContainerDdsInterfaceDeployment, qos-profile=small_buffer_qos.xml, transport-plugins=FSHM, dds-event-qos-props=eventDdsDeployment, required-service-instance-id=10162
    IflytekFdlTrigger_DdsRequiredFunctionDataLoopA: service-interface-deployment=StructContainerDdsInterfaceDeployment, qos-profile=small_buffer_qos.xml, transport-plugins=FSHM, dds-event-qos-props=eventDdsDeployment, required-service-instance-id=10164
    IflytekMcuFmASentinel_DdsRequiredFmAService: service-interface-deployment=StructContainerDdsInterfaceDeployment, qos-profile=small_buffer_qos.xml, transport-plugins=FSHM, dds-event-qos-props=eventDdsDeployment, required-service-instance-id=10165
    IflytekPlanningDebugInfo_DdsRequiredFunctionDataLoop: service-interface-deployment=StructContainerDdsInterfaceDeployment, qos-profile=default_qos.xml, transport-plugins=FSHM, dds-event-qos-props=eventDdsDeployment, required-service-instance-id=10171
    IflytekControlDebugInfo_DdsRequiredFunctionDataLoop: service-interface-deployment=StructContainerDdsInterfaceDeployment, qos-profile=customized_qos.xml, transport-plugins=FSHM, dds-event-qos-props=eventDdsDeployment, required-service-instance-id=10172
    IflytekAdasFunctionDebugInfo_DdsRequiredFunctionDataLoop: service-interface-deployment=StructContainerDdsInterfaceDeployment, qos-profile=small_buffer_qos.xml, transport-plugins=FSHM, dds-event-qos-props=eventDdsDeployment, required-service-instance-id=10178
    IflytekEngineerInner_DdsRequiredFmAService: service-interface-deployment=StructContainerDdsInterfaceDeployment, qos-profile=small_buffer_qos.xml, transport-plugins=FSHM, dds-event-qos-props=eventDdsDeployment, required-service-instance-id=10182
    IflytekAlarmInfoFmAService_DdsRequiredHmiService: service-interface-deployment=StructContainerDdsInterfaceDeployment, qos-profile=small_buffer_qos.xml, transport-plugins=FSHM, dds-event-qos-props=eventDdsDeployment, required-service-instance-id=10158
    IflytekSensorCameraRearFullResolutionH265MDCA_DdsRequiredFunctionDataLoop: service-interface-deployment=CameraStructContainerDdsInterfaceDeployment, qos-profile=small_buffer_qos.xml, transport-plugins=NDSHM, dds-event-qos-props=DdsEventDeployment, required-service-instance-id=10190
    IflytekFmAMcuSentinel_DdsRequiredServiceInstance128: service-interface-deployment=StructContainerDdsInterfaceDeployment, qos-profile=small_buffer_qos.xml, transport-plugins=FSHM, dds-event-qos-props=eventDdsDeployment, required-service-instance-id=10191
    IflytekMcuFmASentinel_DdsRequiredServiceInstance129: service-interface-deployment=StructContainerDdsInterfaceDeployment, qos-profile=small_buffer_qos.xml, transport-plugins=FSHM, dds-event-qos-props=eventDdsDeployment, required-service-instance-id=10192
    IflytekFmADegradeFunciton_DdsRequiredServiceInstance130: service-interface-deployment=StructContainerDdsInterfaceDeployment, qos-profile=small_buffer_qos.xml, transport-plugins=FSHM, dds-event-qos-props=eventDdsDeployment, required-service-instance-id=10185
    IflytekEngineerInner_DdsRequiredServiceInstance131: service-interface-deployment=StructContainerDdsInterfaceDeployment, qos-profile=small_buffer_qos.xml, transport-plugins=FSHM, dds-event-qos-props=eventDdsDeployment, required-service-instance-id=10181
    IflytekCameraPerceptionAroundView2DBoundingBoxes_DdsRequiredServiceInstance132: service-interface-deployment=StructContainerDdsInterfaceDeployment, qos-profile=customized_qos.xml, transport-plugins=FSHM, dds-event-qos-props=eventDdsDeployment, required-service-instance-id=10193
    IflytekCameraPerceptionPanoramaView2DBoundingBoxes_DdsRequiredServiceInstance133: service-interface-deployment=StructContainerDdsInterfaceDeployment, qos-profile=default_qos.xml, transport-plugins=FSHM, dds-event-qos-props=eventDdsDeployment, required-service-instance-id=10187
    IflytekCameraPerceptionScene_DdsRequiredServiceInstance134: service-interface-deployment=StructContainerDdsInterfaceDeployment, qos-profile=small_buffer_qos.xml, transport-plugins=FSHM, dds-event-qos-props=eventDdsDeployment, required-service-instance-id=10095
  required someip service instance IflytekAlarmInfoPhmB_RequiredSomeipSocBPhm: service-interface-deployment=FmAlarmReceiveServiceDeployment, required-service-instance-id=10040
  8 x dds required service instance, all with service-interface-deployment=StructContainerDdsInterfaceDeployment, domain-id=30, transport-plugins=FSHM, dds-event-qos-props=eventDdsDeployment:
    IflytekEhrPhmReport_DdsRequiredSocBPhm: qos-profile=default_qos.xml, required-service-instance-id=10194
    IflytekLocalizationPhmReport_DdsRequiredSocBPhm: qos-profile=small_buffer_qos.xml, required-service-instance-id=10196
    IflytekGnssPhmReport_DdsRequiredSocBPhm: qos-profile=small_buffer_qos.xml, required-service-instance-id=10197
    IflytekHmiPhmReport_DdsRequiredSocBPhm: qos-profile=small_buffer_qos.xml, required-service-instance-id=10198
    Iflytek4dRadarPhmReport_DdsRequiredSocBPhm: qos-profile=small_buffer_qos.xml, required-service-instance-id=10199
    IflytekCameraPerceptionPanoramaPhmReport_DdsRequiredSocBPhm: qos-profile=default_qos.xml, required-service-instance-id=10200
    IflytekFsmPhmReport_DdsRequiredSocBPhm: qos-profile=small_buffer_qos.xml, required-service-instance-id=10201
    IflytekCameraPanoramaPhmReport_DdsRequiredSocBPhm: qos-profile=small_buffer_qos.xml, required-service-instance-id=10202
  required someip service instance IflytekConfigManager_RequiredSomeipSocBPhm: service-interface-deployment=ConfigServerSomeipServiceInterfaceDeployment, required-service-instance-id=1
    someip required event group eventGroup1: event-group=ParamUpdateEventGroup
    someip required event group eventGroup2: event-group=ServerNotifyEventGroup
  required someip service instance IflytekStateManager_RequiredSomeipSocBPhm: service-interface-deployment=TriggerInOutDeployment, required-service-instance-id=1
    someip required event group eventGroup1: event-group=NotifierSomeipEventGroup
  9 x dds required service instance, all with service-interface-deployment=StructContainerDdsInterfaceDeployment, qos-profile=small_buffer_qos.xml, domain-id=30, transport-plugins=FSHM, dds-event-qos-props=eventDdsDeployment:
    IflytekCameraPerceptionPanoramaLanelinePhmReport_DdsRequiredSocAPhm: required-service-instance-id=10203
    IflytekFusionObstaclePhmReport_DdsRequiredSocAPhm: required-service-instance-id=10204
    IflytekPlanningPhmReport_DdsRequiredSocAPhm: required-service-instance-id=10205
    IflytekComPncPhmReport_DdsRequiredSocAPhm: required-service-instance-id=10206
    IflytekCameraPerceptionAroundPhmReport_DdsRequiredSocAPhm: required-service-instance-id=10207
    IflytekCameraAroundPhmReport_DdsRequiredSocAPhm: required-service-instance-id=10208
    IflytekMegaPhmReport_DdsRequiredSocAPhm: required-service-instance-id=10209
    IflytekControlPhmReport_DdsRequiredSocAPhm: required-service-instance-id=10210
    IflytekFusionStaticPhmReport_DdsRequiredSocAPhm: required-service-instance-id=10211
  required someip service instance IflytekAlarmInfoPhmA_RequiredSomeipSocAPhm: service-interface-deployment=FmAlarmReceiveServiceDeployment, required-service-instance-id=10041
  required someip service instance IflytekConfigManager_RequiredSomeipServiceInstance30: service-interface-deployment=ConfigServerSomeipServiceInterfaceDeployment, required-service-instance-id=1
    someip required event group eventGroup1: event-group=ParamUpdateEventGroup
    someip required event group eventGroup2: event-group=ServerNotifyEventGroup
  required someip service instance IflytekStateManager_RequiredSomeipSocAPhm: service-interface-deployment=TriggerInOutDeployment, required-service-instance-id=1
    someip required event group eventGroup1: event-group=NotifierSomeipEventGroup
  dds required service instance IflytekCameraPerception3dOccupancyObjects_DdsRequiredServiceInstance153: service-interface-deployment=StructContainerDdsInterfaceDeployment, qos-profile=large_buffer_qos.xml, domain-id=30, transport-plugins=FSHM, dds-event-qos-props=eventDdsDeployment, required-service-instance-id=10213
  dds required service instance IflytekCameraState_DdsRequiredFmAService: service-interface-deployment=StructContainerDdsInterfaceDeployment, qos-profile=small_buffer_qos.xml, domain-id=30, transport-plugins=FSHM, dds-event-qos-props=eventDdsDeployment, required-service-instance-id=10214
  dds required service instance IflytekFdlUploadState_DdsRequiredFmAService: service-interface-deployment=StructContainerDdsInterfaceDeployment, qos-profile=small_buffer_qos.xml, domain-id=30, transport-plugins=FSHM, dds-event-qos-props=eventDdsDeployment, required-service-instance-id=10217
  required someip service instance IflytekFdlNetStatCheck_RequiredSomeipFmAService: service-interface-deployment=ClientServiceContainerInterfaceDeployment, required-service-instance-id=10043
    someip required event group eventGroup1: event-group=SomeipEventGroup
  15 x dds required service instance, all with service-interface-deployment=StructContainerDdsInterfaceDeployment, domain-id=30, transport-plugins=FSHM, dds-event-qos-props=eventDdsDeployment:
    IflytekDiskSpaceInfoPhmAOta_DdsRequiredOtaNode: qos-profile=small_buffer_qos.xml, required-service-instance-id=10218
    IflytekDiskSpaceInfoPhmBOta_DdsRequiredOtaNode: qos-profile=small_buffer_qos.xml, required-service-instance-id=10220
    IflytekDiskCleanRequest_DdsRequiredSocAPhm: qos-profile=small_buffer_qos.xml, required-service-instance-id=10221
    IflytekDiskCleanRequest_DdsRequiredSocBPhm: qos-profile=small_buffer_qos.xml, required-service-instance-id=10222
    IflytekDiskStatePhmAFdl_DdsRequiredFunctionDataLoop: qos-profile=small_buffer_qos.xml, required-service-instance-id=10224
    IflytekDiskCleanRequestPhmAFdl_DdsRequiredFunctionDataLoop: qos-profile=small_buffer_qos.xml, required-service-instance-id=10226
    IflytekDiskStatePhmBFdl_DdsRequiredFunctionDataLoop: qos-profile=small_buffer_qos.xml, required-service-instance-id=10227
    IflytekDiskCleanRequestPhmBFdl_DdsRequiredFunctionDataLoop: qos-profile=small_buffer_qos.xml, required-service-instance-id=10228
    IflytekSystemBProcessLoading_DdsRequiredFunctionDataLoop: qos-profile=default_qos.xml, required-service-instance-id=10229
    IflytekSystemAProcessLoading_DdsRequiredFunctionDataLoopA: qos-profile=default_qos.xml, required-service-instance-id=10230
    IflytekCalibrationPhmReport_DdsRequiredSocBPhm: qos-profile=small_buffer_qos.xml, required-service-instance-id=10231
    IflytekFdlPhmReport_DdsRequiredSocBPhm: qos-profile=small_buffer_qos.xml, required-service-instance-id=10232
    IflytekFdlAPhmReport_DdsRequiredSocAPhm: qos-profile=small_buffer_qos.xml, required-service-instance-id=10233
    IflytekCalibrationDebugInfo_DdsRequiredFunctionDataLoop: qos-profile=default_qos.xml, required-service-instance-id=10234
    IflytekEhpPhmReport_DdsRequiredSocAPhm: qos-profile=small_buffer_qos.xml, required-service-instance-id=10040
  required someip service instance IflytekAlarmInfoEhp_RequiredSomeipEhp: service-interface-deployment=FmAlarmReceiveServiceDeployment, required-service-instance-id=10019
  10 x dds required service instance, all with service-interface-deployment=StructContainerDdsInterfaceDeployment, domain-id=30, transport-plugins=FSHM, dds-event-qos-props=eventDdsDeployment:
    IflytekLocalizationSemanticInfo_DdsRequiredEhp: qos-profile=small_buffer_qos.xml, required-service-instance-id=10089
    IflytekEhpParkingMap_DdsRequiredFunctionDataLoop: qos-profile=customized_qos.xml, required-service-instance-id=10047
    IflytekEhpParkingMapFileInfo_DdsRequiredMega: qos-profile=small_buffer_qos.xml, required-service-instance-id=10114
    IflytekEhpParkingMapFileInfo_DdsRequiredFunctionDataLoop: qos-profile=small_buffer_qos.xml, required-service-instance-id=10195
    IflytekEhpMapManager_DdsRequiredFunctionDataLoop: qos-profile=small_buffer_qos.xml, required-service-instance-id=10236
    IflytekMegaMappingStatus_DdsRequiredEhp: qos-profile=small_buffer_qos.xml, required-service-instance-id=10090
    IflytekSensorGnss_DdsRequiredEhp: qos-profile=small_buffer_qos.xml, required-service-instance-id=10237
    IflytekFsmSocState_DdsRequiredEhp: qos-profile=small_buffer_qos.xml, required-service-instance-id=10110
    IflytekDiskSpaceInfoPhmAOta_DdsRequiredFmAService: qos-profile=small_buffer_qos.xml, required-service-instance-id=10218
    IflytekDiskSpaceInfoPhmBOta_DdsRequiredFmAService: qos-profile=small_buffer_qos.xml, required-service-instance-id=10220
  required someip service instance IflytekObdUpdateEvent_RequiredSomeipFmAService: service-interface-deployment=ClientServiceContainerInterfaceDeployment, required-service-instance-id=10044
    someip required event group eventGroup1: event-group=SomeipEventGroup
  required someip service instance IflytekOtaLogUploadRequest_RequiredSomeipOtaNode: service-interface-deployment=ClientServiceContainerInterfaceDeployment, required-service-instance-id=10046
    someip required event group eventGroup1: event-group=SomeipEventGroup
  11 x dds required service instance, all with domain-id=30:
    IflytekCalibrationCalibInfo_DdsRequiredFmAService: service-interface-deployment=StructContainerDdsInterfaceDeployment, qos-profile=small_buffer_qos.xml, transport-plugins=FSHM, dds-event-qos-props=eventDdsDeployment, required-service-instance-id=10239
    IflytekSystemAProcessLoading_DdsRequiredFunctionDataLoop: service-interface-deployment=StructContainerDdsInterfaceDeployment, qos-profile=default_qos.xml, transport-plugins=FSHM, dds-event-qos-props=eventDdsDeployment, required-service-instance-id=10240
    IflytekLocalizationEgomotion_DdsRequiredServiceHmiService: service-interface-deployment=StructContainerDdsInterfaceDeployment, qos-profile=small_buffer_qos.xml, transport-plugins=FSHM, dds-event-qos-props=eventDdsDeployment, required-service-instance-id=10016
    IflytekCameraPerceptionDrivableSpaceGrid_DdsRequiredHmiService: service-interface-deployment=StructContainerDdsInterfaceDeployment, qos-profile=default_qos.xml, transport-plugins=FSHM, dds-event-qos-props=eventDdsDeployment, required-service-instance-id=10167
    IflytekCameraPerceptionDrivableSpaceGrid_DdsRequiredFunctionDataLoop: service-interface-deployment=StructContainerDdsInterfaceDeployment, qos-profile=default_qos.xml, transport-plugins=FSHM, dds-event-qos-props=eventDdsDeployment, required-service-instance-id=10167
    IflytekCameraPerceptionObstacleFeature_DdsRequiredPanoramaViewCameraPerceptionLaneline: service-interface-deployment=CameraStructContainerDdsInterfaceDeployment, qos-profile=small_buffer_qos.xml, transport-plugins=NDSHM, dds-event-qos-props=DdsEventDeployment, required-service-instance-id=10176
    IflytekCameraPerceptionLaneFeature_DdsRequiredPanoramaViewCameraPerceptionLaneline: service-interface-deployment=CameraStructContainerDdsInterfaceDeployment, qos-profile=small_buffer_qos.xml, transport-plugins=NDSHM, dds-event-qos-props=DdsEventDeployment, required-service-instance-id=10215
    IflytekSensorGnss_DdsRequiredSdmap: service-interface-deployment=StructContainerDdsInterfaceDeployment, qos-profile=small_buffer_qos.xml, transport-plugins=FSHM, dds-event-qos-props=eventDdsDeployment, required-service-instance-id=10056
    IflytekEhpParkingMapToHmi_DdsRequiredHmiService: service-interface-deployment=StructContainerDdsInterfaceDeployment, qos-profile=customized_qos.xml, transport-plugins=FSHM, dds-event-qos-props=eventDdsDeployment, required-service-instance-id=10241
    IflytekEhpParkingMapToHmi_DdsRequiredFunctionDataLoop: service-interface-deployment=StructContainerDdsInterfaceDeployment, qos-profile=customized_qos.xml, transport-plugins=FSHM, dds-event-qos-props=eventDdsDeployment, required-service-instance-id=10241
    IflytekCanTxInfo_DdsRequiredFunctionDataLoop: service-interface-deployment=StructContainerDdsInterfaceDeployment, qos-profile=small_buffer_qos.xml, transport-plugins=FSHM, dds-event-qos-props=eventDdsDeployment, required-service-instance-id=10243
