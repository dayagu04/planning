[part 1 of 2: packages /HuaweiMDC/process_manifests/processes to /HuaweiMDC/instance_manifests/providedInstances]
AUTOSAR XML (schema 00048)
package /HuaweiMDC/process_manifests/processes
  19 x process, all with log-trace-default-log-level=INFO, log-trace-log-modes=NETWORK:
    hmi_service_libProcess1: design=hmi_service_libProcessDesign1, executable=hmi_service_exec
    radar_4d_service_libProcess2: design=radar_4d_service_libProcessDesign2, executable=radar_4d_service_exec
    sdmap_libProcess3: design=sdmap_libProcessDesign3, executable=sdmap_exec
    mega_libProcess5: design=mega_libProcessDesign6, executable=mega_exec
    panorama_view_camera_perception_laneline_libProcess6: design=panorama_view_camera_perception_laneline_libProcessDesign7, executable=panorama_view_camera_perception_laneline_exec
    around_view_camera_perception_libProcess7: design=around_view_camera_perception_libProcessDesign8, executable=around_view_camera_perception_exec
    fm_a_service_libProcess9: design=fm_a_service_libProcessDesign10, executable=fm_a_service_exec
    fm_b_service_libProcess9: design=fm_b_service_libProcessDesign10, executable=fm_b_service_exec
    mdc_a_fm_libProcess11: design=mdc_a_fm_libProcessDesign12, executable=mdc_a_fm_exec
    mdc_b_fm_libProcess12: design=mdc_b_fm_libProcessDesign13, executable=mdc_b_fm_exec
    ehp_libProcess12: design=ehp_libProcessDesign13, executable=ehp_exec
    factory_calibration_libProcess13: design=factory_calibration_libProcessDesign14, executable=factory_calibration_exec
    ota_node_libProcess15: design=ota_node_libProcessDesign16, executable=ota_node_exec
    function_data_loop_libProcess15: design=function_data_loop_libProcessDesign16, executable=function_data_loop_exec
    function_data_loop_a_libProcess15: design=function_data_loop_a_libProcessDesign16, executable=function_data_loop_a_exec
    soc_b_phm_libProcess16: design=soc_b_phm_libProcessDesign17, executable=soc_b_phm_exec
    soc_a_phm_libProcess17: design=soc_a_phm_libProcessDesign18, executable=soc_a_phm_exec
    system_monitor_b_libProcess18: design=system_monitor_b_libProcessDesign19, executable=system_monitor_b_exec
    system_monitor_a_libProcess20: design=system_monitor_a_libProcessDesign21, executable=system_monitor_a_exec
package /HuaweiMDC/process_manifests/processDesigns
  20 x process design:
    hmi_service_libProcessDesign1: executable=hmi_service_exec
    radar_4d_service_libProcessDesign2: executable=radar_4d_service_exec
    sdmap_libProcessDesign3: executable=sdmap_exec
    mega_libProcessDesign5: executable=mega_libExecutable5
    mega_libProcessDesign6: executable=mega_exec
    panorama_view_camera_perception_laneline_libProcessDesign7: executable=panorama_view_camera_perception_laneline_exec
    around_view_camera_perception_libProcessDesign8: executable=around_view_camera_perception_exec
    fm_a_service_libProcessDesign10: executable=fm_a_service_exec
    fm_b_service_libProcessDesign10: executable=fm_b_service_exec
    mdc_a_fm_libProcessDesign12: executable=mdc_a_fm_exec
    mdc_b_fm_libProcessDesign13: executable=mdc_b_fm_exec
    ehp_libProcessDesign13: executable=ehp_exec
    factory_calibration_libProcessDesign14: executable=factory_calibration_exec
    ota_node_libProcessDesign16: executable=ota_node_exec
    function_data_loop_libProcessDesign16: executable=function_data_loop_exec
    function_data_loop_a_libProcessDesign16: executable=function_data_loop_a_exec
    soc_b_phm_libProcessDesign17: executable=soc_b_phm_exec
    soc_a_phm_libProcessDesign18: executable=soc_a_phm_exec
    system_monitor_b_libProcessDesign19: executable=system_monitor_b_exec
    system_monitor_a_libProcessDesign21: executable=system_monitor_a_exec
package /HuaweiMDC/process_manifests/processToMachineMappingSets
  20 x process to machine mapping set:
    ProcessToMachineMappingSet_hmi_service_libProcess1
      process to machine mapping processToMachineMapping24: machine=MdcSocBMachine, process=hmi_service_libProcess1
    ProcessToMachineMappingSet_sdmap_libProcess3
      process to machine mapping processToMachineMapping25: machine=MdcSocBMachine, process=sdmap_libProcess3
    ProcessToMachineMappingSet_mega_libProcess5
      process to machine mapping processToMachineMapping27: machine=MdcSocAMachine
    ProcessToMachineMappingSet_panorama_view_camera_perception_laneline_libProcess6
      process to machine mapping processToMachineMapping29: machine=MdcSocAMachine, process=panorama_view_camera_perception_laneline_libProcess6
    ProcessToMachineMappingSet_around_view_camera_perception_libProcess7
      process to machine mapping processToMachineMapping30: machine=MdcSocAMachine, process=around_view_camera_perception_libProcess7
    ProcessToMachineMappingSet_fm_a_service_libProcess9
      process to machine mapping processToMachineMapping32: machine=MdcSocAMachine, process=fm_a_service_libProcess9
    ProcessToMachineMappingSet_mdc_a_fm_libProcess11
      process to machine mapping processToMachineMapping33: machine=MdcSocAMachine, process=mdc_a_fm_libProcess11
    ProcessToMachineMappingSet_mdc_b_fm_libProcess12
      process to machine mapping processToMachineMapping33: machine=MdcSocBMachine, process=mdc_b_fm_libProcess12
    ProcessToMachineMappingSet_fm_b_service_libProcess9
      process to machine mapping processToMachineMapping33: machine=MdcSocBMachine, process=fm_b_service_libProcess9
    ProcessToMachineMappingSet_mega_libProcess5
      process to machine mapping processToMachineMapping30: machine=MdcSocAMachine, process=mega_libProcess5
    ProcessToMachineMappingSet_radar_4d_service_libProcess2
      process to machine mapping processToMachineMapping30: machine=MdcSocBMachine, process=radar_4d_service_libProcess2
    ProcessToMachineMappingSet_factory_calibration_libProcess13
      process to machine mapping processToMachineMapping32: machine=MdcSocAMachine, process=factory_calibration_libProcess13
    ProcessToMachineMappingSet_ota_node_libProcess15
      process to machine mapping processToMachineMapping34: machine=MdcSocAMachine, process=ota_node_libProcess15
    ProcessToMachineMappingSet_function_data_loop_libProcess15
      process to machine mapping processToMachineMapping31: machine=MdcSocBMachine, process=function_data_loop_libProcess15
    ProcessToMachineMappingSet_function_data_loop_a_libProcess15
      process to machine mapping processToMachineMapping32: machine=MdcSocAMachine, process=function_data_loop_a_libProcess15
    ProcessToMachineMappingSet_soc_b_phm_libProcess16
      process to machine mapping processToMachineMapping33: machine=MdcSocBMachine, process=soc_b_phm_libProcess16
    ProcessToMachineMappingSet_soc_a_phm_libProcess17
      process to machine mapping processToMachineMapping34: machine=MdcSocAMachine, process=soc_a_phm_libProcess17
    ProcessToMachineMappingSet_system_monitor_a_libProcess20
      process to machine mapping processToMachineMapping37: machine=MdcSocAMachine, process=system_monitor_a_libProcess20
    ProcessToMachineMappingSet_system_monitor_b_libProcess18
      process to machine mapping processToMachineMapping36: machine=MdcSocBMachine, process=system_monitor_b_libProcess18
    ProcessToMachineMappingSet_ehp_libProcess12
      process to machine mapping processToMachineMapping36: machine=MdcSocAMachine, process=ehp_libProcess12
package /HuaweiMDC/exe_manifests/exes
  20 x executable, all with logging-behavior=USES-LOGGING, reporting-behavior=REPORTS-EXECUTION-STATE:
    hmi_service_exec
      root sw component prototype hmi_service_libExecutable1Prototype: application-type=hmi_service_libCompositionSwComponentType1
    radar_4d_service_exec
      root sw component prototype radar_4d_service_libExecutable2Prototype: application-type=radar_4d_service_libCompositionSwComponentType2
    sdmap_exec
      root sw component prototype sdmap_libExecutable3Prototype: application-type=sdmap_libCompositionSwComponentType3
    mega_libExecutable5
      root sw component prototype mega_libExecutable5Prototype
    mega_exec
      root sw component prototype mega_libExecutable6Prototype: application-type=mega_libCompositionSwComponentType5
    panorama_view_camera_perception_laneline_exec
      root sw component prototype panorama_view_camera_perception_laneline_libExecutable7Prototype: application-type=panorama_view_camera_perception_laneline_libCompositionSwComponentType6
    around_view_camera_perception_exec
      root sw component prototype around_view_camera_perception_libExecutable8Prototype: application-type=around_view_camera_perception_libCompositionSwComponentType7
    fm_a_service_exec
      root sw component prototype fm_a_service_libExecutable10Prototype: application-type=fm_a_service_libCompositionSwComponentType9
    fm_b_service_exec
      root sw component prototype fm_b_service_libExecutable10Prototype: application-type=fm_b_service_libCompositionSwComponentType9
    mdc_a_fm_exec
      root sw component prototype mdc_a_fm_libExecutable12Prototype: application-type=mdc_a_fm_libCompositionSwComponentType11
    mdc_b_fm_exec
      root sw component prototype mdc_b_fm_libExecutable13Prototype: application-type=mdc_b_fm_libCompositionSwComponentType12
    ehp_exec
      root sw component prototype ehp_libExecutable13Prototype: application-type=ehp_libCompositionSwComponentType12
    factory_calibration_exec
      root sw component prototype factory_calibration_libExecutable14Prototype: application-type=factory_calibration_libCompositionSwComponentType13
    ota_node_exec
      root sw component prototype ota_node_libExecutable16Prototype: application-type=ota_node_libCompositionSwComponentType15
    function_data_loop_exec
      root sw component prototype function_data_loop_libExecutable16Prototype: application-type=function_data_loop_libCompositionSwComponentType15
    function_data_loop_a_exec
      root sw component prototype function_data_loop_a_libExecutable16Prototype: application-type=function_data_loop_a_libCompositionSwComponentType15
    soc_b_phm_exec
      root sw component prototype soc_b_phm_libExecutable17Prototype: application-type=soc_b_phm_libCompositionSwComponentType16
    soc_a_phm_exec
      root sw component prototype soc_a_phm_libExecutable18Prototype: application-type=soc_a_phm_libCompositionSwComponentType17
    system_monitor_b_exec
      root sw component prototype system_monitor_b_libExecutable19Prototype: application-type=system_monitor_b_libCompositionSwComponentType18
    system_monitor_a_exec
      root sw component prototype system_monitor_a_libExecutable21Prototype: application-type=system_monitor_a_libCompositionSwComponentType20
package /HuaweiMDC/exe_manifests/InstanceToPortMappings
  306 x service instance to port prototype mapping:
    IflytekSdmapInfo_DdsProvidedServiceInstance4_PortMapping: port-prototype=sdmap_libExecutable3Prototype.IflytekSdmapSdmapInfo, process=sdmap_libProcessDesign3, service-instance=IflytekSdmapSdmapInfo_DdsProvidedServiceInstance4
    IflytekMegaLocalMap_DdsProvidedServiceInstance5_PortMapping: port-prototype=mega_libExecutable6Prototype.IflytekMegaLocalMap, process=mega_libProcessDesign6, service-instance=IflytekMegaLocalMap_DdsProvidedServiceInstance5
    IflytekCameraPerceptionLaneLines_DdsProvidedServiceInstance7_PortMapping: port-prototype=panorama_view_camera_perception_laneline_libExecutable7Prototype.IflytekCameraPerceptionLaneLines, process=panorama_view_camera_perception_laneline_libProcessDesign7, service-instance=IflytekCameraPerceptionLaneLines_DdsProvidedServiceInstance7
    RPortPrototype1_DdsRequiredServiceInstance20_PortMapping: port-prototype=around_view_camera_perception_libExecutable8Prototype.IflytekSensorCameraSurroundResizeImageFront, process=around_view_camera_perception_libProcessDesign8, service-instance=IflytekSensorCameraSurroundResizeImageFront_DdsRequiredServiceInstance20
    RPortPrototype1_DdsRequiredServiceInstance21_PortMapping: port-prototype=around_view_camera_perception_libExecutable8Prototype.IflytekSensorCameraSurroundResizeImageLeft, process=around_view_camera_perception_libProcessDesign8, service-instance=IflytekSensorCameraSurroundResizeImageLeft_DdsRequiredServiceInstance21
    RPortPrototype1_DdsRequiredServiceInstance22_PortMapping: port-prototype=around_view_camera_perception_libExecutable8Prototype.IflytekSensorCameraSurroundResizeImageRight, process=around_view_camera_perception_libProcessDesign8, service-instance=IflytekSensorCameraSurroundResizeImageRight_DdsRequiredServiceInstance22
    RPortPrototype2_DdsRequiredServiceInstance23_PortMapping: port-prototype=around_view_camera_perception_libExecutable8Prototype.IflytekSensorCameraSurroundResizeImageRear, process=around_view_camera_perception_libProcessDesign8, service-instance=IflytekSensorCameraSurroundResizeImageRear_DdsRequiredServiceInstance23
    IflytekCameraPerception3dGeneralObjects_DdsProvidedServiceInstance8_PortMapping: port-prototype=around_view_camera_perception_libExecutable8Prototype.IflytekCameraPerception3dGeneralObjects, process=around_view_camera_perception_libProcessDesign8, service-instance=IflytekCameraPerception3dGeneralObjects_DdsProvidedServiceInstance8
    IflytekCameraPerceptionOccupancyObjects_DdsProvidedServiceInstance9_PortMapping: port-prototype=around_view_camera_perception_libExecutable8Prototype.IflytekCameraPerceptionOccupancyObjects, process=around_view_camera_perception_libProcessDesign8, service-instance=IflytekCameraPerceptionOccupancyObjects_DdsProvidedServiceInstance9
    IflytekCameraPerceptionLaneTopo_DdsProvidedServiceInstance10_PortMapping: port-prototype=panorama_view_camera_perception_laneline_libExecutable7Prototype.IflytekCameraPerceptionLaneTopo, process=panorama_view_camera_perception_laneline_libProcessDesign7, service-instance=IflytekCameraPerceptionLaneTopo_DdsProvidedServiceInstance10
    PPortPrototype1_ProvidedSomeipServiceInstance1_PortMapping: port-prototype=fm_a_service_libExecutable10Prototype.IflytekAlarmInfoCameraNodeAroundView, process=fm_a_service_libProcessDesign10, service-instance=IflytekAlarmInfoCameraNodeAroundView_ProvidedSomeipFmAService
    IflytekSdmapAlarmInfo_ProvidedSomeipServiceInstance2_PortMapping: port-prototype=fm_b_service_libExecutable10Prototype.IflytekAlarmInfoSdmap, process=fm_b_service_libProcessDesign10, service-instance=IflytekAlarmInfoSdmap_ProvidedSomeipServiceInstance2
    RPortPrototype1_RequiredSomeipServiceInstance1_PortMapping: port-prototype=sdmap_libExecutable3Prototype.IflytekAlarmInfoSdmap, process=sdmap_libProcessDesign3, service-instance=IflytekAlarmInfoSdmap_RequiredSomeipServiceInstance1
    AroundViewCameraPerceptionAlarmInfo_ProvidedSomeipServiceInstance3_PortMapping: port-prototype=fm_a_service_libExecutable10Prototype.IflytekAlarmInfoAroundViewCameraPerception, process=fm_a_service_libProcessDesign10, service-instance=IflytekAlarmInfoAroundViewCameraPerception_ProvidedSomeipFmAService
    RPortPrototype1_RequiredSomeipServiceInstance2_PortMapping: port-prototype=around_view_camera_perception_libExecutable8Prototype.IflytekAlarmInfoAroundViewCameraPerception, process=around_view_camera_perception_libProcessDesign8, service-instance=IflytekAlarmInfoAroundViewCameraPerception_RequiredSomeipServiceInstance2
    SocACommunicationAlarmInfo_ProvidedSomeipServiceInstance4_PortMapping: port-prototype=fm_a_service_libExecutable10Prototype.IflytekAlarmInfoSocACommunication, process=fm_a_service_libProcessDesign10, service-instance=IflytekAlarmInfoSocACommunication_ProvidedSomeipFmAService
    PanoramaViewCameraPerceptionLanelineAlarmInfo_ProvidedSomeipServiceInstance5_PortMapping: port-prototype=fm_a_service_libExecutable10Prototype.IflytekAlarmInfoPanoramaViewCameraPerceptionLaneline, process=fm_a_service_libProcessDesign10, service-instance=IflytekAlarmInfoPanoramaViewCameraPerceptionLaneline_ProvidedSomeipFmAService
    RPortPrototype1_RequiredSomeipServiceInstance3_PortMapping: port-prototype=panorama_view_camera_perception_laneline_libExecutable7Prototype.IflytekAlarmInfoPanoramaViewCameraPerceptionLaneline, process=panorama_view_camera_perception_laneline_libProcessDesign7, service-instance=IflytekAlarmInfoPanoramaViewCameraPerceptionLaneline_RequiredSomeipServiceInstance3
    GnssServiceNodeAlarmInfo_ProvidedSomeipServiceInstance6_PortMapping: port-prototype=fm_b_service_libExecutable10Prototype.IflytekAlarmInfoGnssServiceNode, process=fm_b_service_libProcessDesign10, service-instance=IflytekAlarmInfoGnssServiceNode_ProvidedSomeipServiceInstance6
    EhrAlarmInfo_ProvidedSomeipServiceInstance7_PortMapping: port-prototype=fm_b_service_libExecutable10Prototype.IflytekAlarmInfoEhr, process=fm_b_service_libProcessDesign10, service-instance=IflytekAlarmInfoEhr_ProvidedSomeipServiceInstance7
    IflytekAlarmInfoLocalization_ProvidedSomeipServiceInstance9_PortMapping: port-prototype=fm_b_service_libExecutable10Prototype.IflytekAlarmInfoLocalization, process=fm_b_service_libProcessDesign10, service-instance=IflytekAlarmInfoLocalization_ProvidedSomeipServiceInstance9
    IflytekAlarmInfoSocBCommunication_ProvidedSomeipServiceInstance10_PortMapping: port-prototype=fm_b_service_libExecutable10Prototype.IflytekAlarmInfoSocBCommunication, process=fm_b_service_libProcessDesign10, service-instance=IflytekAlarmInfoSocBCommunication_ProvidedSomeipServiceInstance10
    IflytekAlarmInfoPanoramaViewCameraNode_ProvidedSomeipServiceInstance16_PortMapping: port-prototype=fm_b_service_libExecutable10Prototype.IflytekAlarmInfoCameraNodePanoramaView, process=fm_b_service_libProcessDesign10, service-instance=IflytekAlarmInfoCameraNodePanoramaView_ProvidedSomeipServiceInstance16
    IflytekAlarmInfoPanoramaViewCameraPerception_ProvidedSomeipServiceInstance17_PortMapping: port-prototype=fm_b_service_libExecutable10Prototype.IflytekAlarmInfoPanoramaViewCameraPerception, process=fm_b_service_libProcessDesign10, service-instance=IflytekAlarmInfoPanoramaViewCameraPerception_ProvidedSomeipServiceInstance17
    IflytekAlarmInfoHmiService_ProvidedSomeipServiceInstance22_PortMapping: port-prototype=fm_b_service_libExecutable10Prototype.IflytekAlarmInfoHmiService, process=fm_b_service_libProcessDesign10, service-instance=IflytekAlarmInfoHmiService_ProvidedSomeipServiceInstance22
    RPortPrototype1_RequiredSomeipServiceInstance6_PortMapping: port-prototype=hmi_service_libExecutable1Prototype.IflytekAlarmInfoHmiService, process=hmi_service_libProcessDesign1, service-instance=IflytekAlarmInfoHmiService_RequiredSomeipHmiService
    IflytekAlarmInfoMdcB_ProvidedSomeipServiceInstance27_PortMapping: port-prototype=fm_b_service_libExecutable10Prototype.IflytekAlarmInfoMdcB, process=fm_b_service_libProcessDesign10, service-instance=IflytekAlarmInfoMdcB_ProvidedSomeipServiceInstance27
    RPortPrototype1_RequiredSomeipServiceInstance8_PortMapping: port-prototype=mdc_b_fm_libExecutable13Prototype.IflytekAlarmInfoMdcB, process=mdc_b_fm_libProcessDesign13, service-instance=IflytekAlarmInfoMdcB_RequiredSomeipServiceInstance8
    IflytekHmiInner_DdsProvidedServiceInstance9_PortMapping: port-prototype=hmi_service_libExecutable1Prototype.IflytekHmiInner, process=hmi_service_libProcessDesign1, service-instance=IflytekHmiInner_DdsProvidedHmiService
    RPortPrototype1_DdsRequiredServiceInstance29_PortMapping: port-prototype=sdmap_libExecutable3Prototype.IflytekLocalizationEgomotion, process=sdmap_libProcessDesign3, service-instance=IflytekLocalizationEgomotion_DdsRequiredServiceInstance29
    IflytekCameraPerceptionParkingSlotList_DdsProvidedServiceInstance11_PortMapping: port-prototype=around_view_camera_perception_libExecutable8Prototype.IflytekCameraPerceptionParkingSlotList, process=around_view_camera_perception_libProcessDesign8, service-instance=IflytekCameraPerceptionParkingSlotList_DdsProvidedServiceInstance11
    IflytekCameraPerceptionGroundLine_DdsProvidedServiceInstance12_PortMapping: port-prototype=around_view_camera_perception_libExecutable8Prototype.IflytekCameraPerceptionGroundLine, process=around_view_camera_perception_libProcessDesign8, service-instance=IflytekCameraPerceptionGroundLine_DdsProvidedServiceInstance12
    IflytekCameraPerceptionParkingLaneLine_DdsProvidedServiceInstance13_PortMapping: port-prototype=around_view_camera_perception_libExecutable8Prototype.IflytekCameraPerceptionParkingLaneLine, process=around_view_camera_perception_libProcessDesign8, service-instance=IflytekCameraPerceptionParkingLaneLine_DdsProvidedServiceInstance13
    IflytekCameraPerceptionDeceler_DdsProvidedServiceInstance14_PortMapping: port-prototype=around_view_camera_perception_libExecutable8Prototype.IflytekCameraPerceptionDeceler, process=around_view_camera_perception_libProcessDesign8, service-instance=IflytekCameraPerceptionDeceler_DdsProvidedServiceInstance14
    RPortPrototype1_DdsRequiredServiceInstance29_PortMapping: port-prototype=mega_libExecutable6Prototype.IflytekCameraPerceptionParkingSlotList, process=mega_libProcessDesign6, service-instance=IflytekCameraPerceptionParkingSlotList_DdsRequiredServiceInstance29
    RPortPrototype1_DdsRequiredServiceInstance29_PortMapping: port-prototype=mega_libExecutable6Prototype.IflytekCameraPerceptionDeceler, process=mega_libProcessDesign6, service-instance=IflytekCameraPerceptionDeceler_DdsRequiredServiceInstance29
    RPortPrototype1_DdsRequiredServiceInstance29_PortMapping: port-prototype=mega_libExecutable6Prototype.IflytekCameraPerceptionGroundLine, process=mega_libProcessDesign6, service-instance=IflytekCameraPerceptionGroundLine_DdsRequiredServiceInstance29
    RPortPrototype1_DdsRequiredServiceInstance29_PortMapping: port-prototype=mega_libExecutable6Prototype.IflytekCameraPerceptionParkingLaneLine, process=mega_libProcessDesign6, service-instance=IflytekCameraPerceptionParkingLaneLine_DdsRequiredServiceInstance29
    RPortPrototype1_DdsRequiredServiceInstance29_PortMapping: port-prototype=mega_libExecutable6Prototype.IflytekLocalizationEgomotion, process=mega_libProcessDesign6, service-instance=IflytekLocalizationEgomotion_DdsRequiredServiceInstance30
    IflytekAlarmInfoMega_ProvidedSomeipServiceInstance27_PortMapping: port-prototype=fm_a_service_libExecutable10Prototype.IflytekAlarmInfoMega, process=fm_a_service_libProcessDesign10, service-instance=IflytekAlarmInfoMega_ProvidedSomeipFmAService
    RPortPrototype1_RequiredSomeipServiceInstance9_PortMapping: port-prototype=mega_libExecutable6Prototype.IflytekAlarmInfoMega, process=mega_libProcessDesign6, service-instance=IflytekAlarmInfoMega_RequiredSomeipServiceInstance9
    IflytekAlarmInfoStaticFusion_ProvidedSomeipServiceInstance26_PortMapping: port-prototype=fm_a_service_libExecutable10Prototype.IflytekAlarmInfoStaticFusion, process=fm_a_service_libProcessDesign10, service-instance=IflytekAlarmInfoStaticFusion_ProvidedSomeipFmAService
    RPortPrototype1_DdsRequiredServiceInstance31_PortMapping: port-prototype=mega_libExecutable6Prototype.IflytekLocalizationSemanticInfo, process=mega_libProcessDesign6, service-instance=IflytekLocalizationSemanticInfo_DdsRequiredServiceInstance31
    IflytekMegaMappingStatus_DdsProvidedServiceInstance15_PortMapping: port-prototype=mega_libExecutable6Prototype.IflytekMegaMappingStatus, process=mega_libProcessDesign6, service-instance=IflytekMegaMappingStatus_DdsProvidedMega
    RPortPrototype1_DdsRequiredServiceInstance34_PortMapping: port-prototype=mega_libExecutable6Prototype.IflytekCameraPerception3dGeneralObjects, process=mega_libProcessDesign6, service-instance=IflytekCameraPerception3dGeneralObjects_DdsRequiredServiceInstance34
    IflytekSinproRadarPerceptionTarget_DdsProvidedServiceInstance19_PortMapping: port-prototype=radar_4d_service_libExecutable2Prototype.IflytekRadarFmPerception4dTarget, process=radar_4d_service_libProcessDesign2, service-instance=IflytekRadarFmPerception4dTarget_DdsProvidedServiceInstance19
    RPortPrototype1_RequiredSomeipServiceInstance12_PortMapping: port-prototype=fm_a_service_libExecutable10Prototype.IflytekSensorGetSurroundCameraIntriParam, process=fm_a_service_libProcessDesign10, service-instance=IflytekSensorGetSurroundCameraIntriParam_RequiredSomeipFmAService
    RPortPrototype1_RequiredSomeipServiceInstance13_PortMapping: port-prototype=fm_a_service_libExecutable10Prototype.IflytekSensorGetPanoramaCameraIntriParam, process=fm_a_service_libProcessDesign10, service-instance=IflytekSensorGetPanoramaCameraIntriParam_RequiredSomeipFmAService
    RPortPrototype1_RequiredSomeipServiceInstance14_PortMapping: port-prototype=fm_a_service_libExecutable10Prototype.IflytekSensorWriteFile, process=fm_a_service_libProcessDesign10, service-instance=IflytekSensorWriteFile_RequiredSomeipFmAService
    IflytekFactoryCalibrationActivation_ProvidedSomeipServiceInstance28_PortMapping: port-prototype=factory_calibration_libExecutable14Prototype.IflytekFactoryCalibrationActivation, process=factory_calibration_libProcessDesign14, service-instance=IflytekFactoryCalibrationActivation_ProvidedSomeipServiceInstance28
    RPortPrototype1_RequiredSomeipServiceInstance13_PortMapping: port-prototype=fm_a_service_libExecutable10Prototype.IflytekFactoryCalibrationActivation, process=fm_a_service_libProcessDesign10, service-instance=IflytekFactoryCalibrationActivation_RequiredSomeipFmAService
    IflytekFactoryCalibrationResult_ProvidedSomeipServiceInstance29_PortMapping: port-prototype=factory_calibration_libExecutable14Prototype.IflytekFactoryCalibrationResult, process=factory_calibration_libProcessDesign14, service-instance=IflytekFactoryCalibrationResult_ProvidedSomeipServiceInstance29
    RPortPrototype1_RequiredSomeipServiceInstance14_PortMapping: port-prototype=fm_a_service_libExecutable10Prototype.IflytekFactoryCalibrationResult, process=fm_a_service_libProcessDesign10, service-instance=IflytekFactoryCalibrationResult_RequiredSomeipFmAService
    IflytekStateManager_ProvidedSomeipServiceInstance31_PortMapping: port-prototype=mdc_a_fm_libExecutable12Prototype.IflytekStateManager, process=mdc_a_fm_libProcessDesign12, service-instance=IflytekStateManager_ProvidedSomeipMdcAFm
    RPortPrototype1_RequiredSomeipServiceInstance16_PortMapping: port-prototype=fm_a_service_libExecutable10Prototype.IflytekStateManager, process=fm_a_service_libProcessDesign10, service-instance=IflytekStateManager_RequiredSomeipFmAService
    RPortPrototype1_DdsRequiredServiceInstance47_PortMapping: port-prototype=around_view_camera_perception_libExecutable8Prototype.IflytekLocalizationEgomotion, process=around_view_camera_perception_libProcessDesign8, service-instance=IflytekLocalizationEgomotion_DdsRequiredServiceInstance47
    RPortPrototype1_DdsRequiredServiceInstance44_PortMapping: port-prototype=fm_a_service_libExecutable10Prototype.IflytekAlarmInfoSoc, process=fm_a_service_libProcessDesign10, service-instance=IflytekAlarmInfoSoc_DdsRequiredFmAService
    IflytekAlarmInfoSoc_DdsProvidedServiceInstance23_PortMapping: port-prototype=fm_b_service_libExecutable10Prototype.IflytekAlarmInfoSoc, process=fm_b_service_libProcessDesign10, service-instance=IflytekAlarmInfoSoc_DdsProvidedServiceInstance23
    RPortPrototype1_DdsRequiredServiceInstance44_PortMapping: port-prototype=factory_calibration_libExecutable14Prototype.IflytekSensorCameraSurroundFrontFullResolutionH265, process=factory_calibration_libProcessDesign14, service-instance=IflytekSensorCameraSurroundFrontFullResolutionH265_DdsRequiredServiceInstance44
    RPortPrototype1_DdsRequiredServiceInstance41_PortMapping: port-prototype=factory_calibration_libExecutable14Prototype.IflytekSensorCameraSurroundLeftFullResolutionH265, process=factory_calibration_libProcessDesign14, service-instance=IflytekSensorCameraSurroundLeftFullResolutionH265_DdsRequiredServiceInstance41
    RPortPrototype1_DdsRequiredServiceInstance42_PortMapping: port-prototype=factory_calibration_libExecutable14Prototype.IflytekSensorCameraSurroundRearFullResolutionH265, process=factory_calibration_libProcessDesign14, service-instance=IflytekSensorCameraSurroundRearFullResolutionH265_DdsRequiredServiceInstance42
    RPortPrototype1_DdsRequiredServiceInstance43_PortMapping: port-prototype=factory_calibration_libExecutable14Prototype.IflytekSensorCameraSurroundRightFullResolutionH265, process=factory_calibration_libProcessDesign14, service-instance=IflytekSensorCameraSurroundRightFullResolutionH265_DdsRequiredServiceInstance43
    RPortPrototype1_DdsRequiredServiceInstance39_PortMapping: port-prototype=factory_calibration_libExecutable14Prototype.IflytekSensorCameraFront30FullResolutionH265, process=factory_calibration_libProcessDesign14, service-instance=IflytekSensorCameraFront30FullResolutionH265_DdsRequiredServiceInstance39
    RPortPrototype1_DdsRequiredServiceInstance40_PortMapping: port-prototype=factory_calibration_libExecutable14Prototype.IflytekSensorCameraFront120FullResolutionH265, process=factory_calibration_libProcessDesign14, service-instance=IflytekSensorCameraFront120FullResolutionH265_DdsRequiredServiceInstance40
    RPortPrototype1_DdsRequiredServiceInstance41_PortMapping: port-prototype=factory_calibration_libExecutable14Prototype.IflytekSensorCameraSideFlFullResolutionH265, process=factory_calibration_libProcessDesign14, service-instance=IflytekSensorCameraSideFlFullResolutionH265_DdsRequiredServiceInstance41
    RPortPrototype1_DdsRequiredServiceInstance42_PortMapping: port-prototype=factory_calibration_libExecutable14Prototype.IflytekSensorCameraSideFrFullResolutionH265, process=factory_calibration_libProcessDesign14, service-instance=IflytekSensorCameraSideFrFullResolutionH265_DdsRequiredServiceInstance42
    RPortPrototype1_DdsRequiredServiceInstance43_PortMapping: port-prototype=factory_calibration_libExecutable14Prototype.IflytekSensorCameraSideRlFullResolutionH265, process=factory_calibration_libProcessDesign14, service-instance=IflytekSensorCameraSideRlFullResolutionH265_DdsRequiredServiceInstance43
    RPortPrototype1_DdsRequiredServiceInstance44_PortMapping: port-prototype=factory_calibration_libExecutable14Prototype.IflytekSensorCameraSideRrFullResolutionH265, process=factory_calibration_libProcessDesign14, service-instance=IflytekSensorCameraSideRrFullResolutionH265_DdsRequiredServiceInstance44
    IflytekRadarFmPerception4dPointCloud_DdsProvidedServiceInstance24_PortMapping: port-prototype=radar_4d_service_libExecutable2Prototype.IflytekRadarFmPerception4dPointCloud, process=radar_4d_service_libProcessDesign2, service-instance=IflytekRadarFmPerception4dPointCloud_DdsProvidedServiceInstance24
    IflytekAlarmInfoRadar4dService_ProvidedSomeipServiceInstance32_PortMapping: port-prototype=fm_b_service_libExecutable10Prototype.IflytekAlarmInfoRadar4dService, process=fm_b_service_libProcessDesign10, service-instance=IflytekAlarmInfoRadar4dService_ProvidedSomeipServiceInstance32
    RPortPrototype1_RequiredSomeipServiceInstance18_PortMapping: port-prototype=radar_4d_service_libExecutable2Prototype.IflytekAlarmInfoRadar4dService, process=radar_4d_service_libProcessDesign2, service-instance=IflytekAlarmInfoRadar4dService_RequiredSomeipServiceInstance18
    RPortPrototype1_DdsRequiredServiceInstance46_PortMapping: port-prototype=panorama_view_camera_perception_laneline_libExecutable7Prototype.IflytekLocalizationEgomotion, process=panorama_view_camera_perception_laneline_libProcessDesign7, service-instance=IflytekLocalizationEgomotion_DdsRequiredServiceInstance46
    IflytekCameraPerceptionObjects_DdsProvidedServiceInstance26_PortMapping: port-prototype=panorama_view_camera_perception_laneline_libExecutable7Prototype.IflytekCameraPerceptionObjects, process=panorama_view_camera_perception_laneline_libProcessDesign7, service-instance=IflytekCameraPerceptionObjects_DdsProvidedServiceInstance26
    RPortPrototype1_DdsRequiredServiceInstance49_PortMapping: port-prototype=factory_calibration_libExecutable14Prototype.IflytekSensorCameraRearFullResolutionH265MDCA, process=factory_calibration_libProcessDesign14, service-instance=IflytekSensorCameraRearFullResolutionH265MDCA_DdsRequiredServiceInstance49
    RPortPrototype1_DdsRequiredServiceInstance104_PortMapping: port-prototype=function_data_loop_libExecutable16Prototype, process=function_data_loop_libProcessDesign16
    IflytekConfigManager_ProvidedSomeipServiceInstance29_PortMapping: port-prototype=mdc_a_fm_libExecutable12Prototype.IflytekConfigManager, process=mdc_a_fm_libProcessDesign12, service-instance=IflytekConfigManager_ProvidedSomeipMdcAFm
    RPortPrototype1_RequiredSomeipServiceInstance20_PortMapping: port-prototype=ota_node_libExecutable16Prototype.IflytekConfigManager, process=ota_node_libProcessDesign16, service-instance=IflytekConfigManager_RequiredSomeipServiceInstance20
    IflytekAlarmInfoMdcB_RequiredSomeipServiceInstance24_PortMapping: port-prototype=mdc_b_fm_libExecutable13Prototype.IflytekAlarmInfoMdcB, process=mdc_b_fm_libProcessDesign13, service-instance=IflytekAlarmInfoMdcB_RequiredSomeipServiceInstance24
    IflytekAlarmInfoCalibration_ProvidedSomeipServiceInstance22_PortMapping: port-prototype=fm_b_service_libExecutable10Prototype.IflytekAlarmInfoCalibration, process=fm_b_service_libProcessDesign10, service-instance=IflytekAlarmInfoCalibration_ProvidedSomeipServiceInstance22
    RPortPrototype1_DdsRequiredServiceInstance40_PortMapping: port-prototype=factory_calibration_libExecutable14Prototype.IflytekSensorImu, process=factory_calibration_libProcessDesign14, service-instance=IflytekSensorImu_DdsRequiredServiceInstance40
    RPortPrototype1_DdsRequiredServiceInstance41_PortMapping: port-prototype=fm_a_service_libExecutable10Prototype.IflytekSensorMcuToFmInfo, process=fm_a_service_libProcessDesign10, service-instance=IflytekSensorMcuToFmInfo_DdsRequiredFmAService
    RPortPrototype1_DdsRequiredServiceInstance42_PortMapping: port-prototype=fm_a_service_libExecutable10Prototype.IflytekAlarmInfoMcu, process=fm_a_service_libProcessDesign10, service-instance=IflytekAlarmInfoMcu_DdsRequiredFmAService
    RPortPrototype1_DdsRequiredServiceInstance43_PortMapping: port-prototype=hmi_service_libExecutable1Prototype.IflytekVehicleService, process=hmi_service_libProcessDesign1, service-instance=IflytekVehicleService_DdsRequiredHmiService
    RPortPrototype1_DdsRequiredServiceInstance44_PortMapping: port-prototype=hmi_service_libExecutable1Prototype.IflytekHmiMcuToSocBsw, process=hmi_service_libProcessDesign1, service-instance=IflytekHmiMcuToSocBsw_DdsRequiredHmiService
    IflytekFmMcuInfo_DdsProvidedServiceInstance23_PortMapping: port-prototype=fm_a_service_libExecutable10Prototype.IflytekFmMcuInfo, process=fm_a_service_libProcessDesign10, service-instance=IflytekFmMcuInfo_DdsProvidedFmAService
    IflytekHmiSocToMcuBsw_DdsProvidedServiceInstance24_PortMapping: port-prototype=hmi_service_libExecutable1Prototype.IflytekHmiSocToMcuBsw, process=hmi_service_libProcessDesign1, service-instance=IflytekHmiSocToMcuBsw_DdsProvidedHmiService
    IflytekAlarmInfoComServicePncNode_ProvidedSomeipServiceInstance24_PortMapping: port-prototype=fm_a_service_libExecutable10Prototype.IflytekAlarmInfoComServicePncNode, process=fm_a_service_libProcessDesign10, service-instance=IflytekAlarmInfoComServicePncNode_ProvidedSomeipFmAService
    IflytekPredictionPredictionResult_DdsProvidedServiceInstance24_PortMapping: port-prototype=panorama_view_camera_perception_laneline_libExecutable7Prototype.IflytekPredictionPredictionResult, process=panorama_view_camera_perception_laneline_libProcessDesign7, service-instance=IflytekPredictionPredictionResult_DdsProvidedServiceInstance24
    RPortPrototype1_DdsRequiredServiceInstance48_PortMapping: port-prototype=mega_libExecutable6Prototype.IflytekFusionSpatialParkingSlot, process=mega_libProcessDesign6, service-instance=IflytekFusionSpatialParkingSlot_DdsRequiredServiceInstance48
    IflytekAlarmInfoObstacleFusion_ProvidedSomeipServiceInstance25_PortMapping: port-prototype=fm_a_service_libExecutable10Prototype.IflytekAlarmInfoObstacleFusion, process=fm_a_service_libProcessDesign10, service-instance=IflytekAlarmInfoObstacleFusion_ProvidedSomeipFmAService
    RPortPrototype1_DdsRequiredServiceInstance47_PortMapping: port-prototype=around_view_camera_perception_libExecutable8Prototype.IflytekUssUsswaveInfo, process=around_view_camera_perception_libProcessDesign8, service-instance=IflytekUssUsswaveInfo_DdsRequiredServiceInstance47
    RPortPrototype1_DdsRequiredServiceInstance47_PortMapping: port-prototype=around_view_camera_perception_libExecutable8Prototype.IflytekVehicleService, process=around_view_camera_perception_libProcessDesign8, service-instance=IflytekVehicleService_DdsRequiredServiceInstance47
    IflytekAlarmPlanning_ProvidedSomeipServiceInstance26_PortMapping: port-prototype=fm_a_service_libExecutable10Prototype.IflytekAlarmInfoPlanning, process=fm_a_service_libProcessDesign10, service-instance=IflytekAlarmInfoPlanning_ProvidedSomeipFmAService
    IflytekAlarmInfoOtaNode_ProvidedSomeipServiceInstance27_PortMapping: port-prototype=fm_a_service_libExecutable10Prototype.IflytekAlarmInfoOtaNode, process=fm_a_service_libProcessDesign10, service-instance=IflytekAlarmInfoOtaNode_ProvidedSomeipFmAService
    RPortPrototype1_RequiredSomeipServiceInstance24_PortMapping: port-prototype=ota_node_libExecutable16Prototype.IflytekAlarmInfoOtaNode, process=ota_node_libProcessDesign16, service-instance=IflytekAlarmInfoOtaNode_RequiredSomeipServiceInstance24
    IflytekAlarmInfoControl_ProvidedSomeipServiceInstance28_PortMapping: port-prototype=fm_a_service_libExecutable10Prototype.IflytekAlarmInfoControl, process=fm_a_service_libProcessDesign10, service-instance=IflytekAlarmInfoControl_ProvidedSomeipFmAService
    RPortPrototype1_DdsRequiredServiceInstance48_PortMapping: port-prototype=panorama_view_camera_perception_laneline_libExecutable7Prototype.IflytekVehicleService, process=panorama_view_camera_perception_laneline_libProcessDesign7, service-instance=IflytekVehicleService_DdsRequiredServiceInstance48
    RPortPrototype1_DdsRequiredServiceInstance48_PortMapping: port-prototype=fm_a_service_libExecutable10Prototype, process=fm_a_service_libProcessDesign10
    RPortPrototype1_RequiredSomeipServiceInstance23_PortMapping: port-prototype=mdc_a_fm_libExecutable12Prototype.IflytekAlarmInfoMdcA, process=mdc_a_fm_libProcessDesign12, service-instance=IflytekAlarmInfoMdcA_RequiredSomeipMdcAFm
    RPortPrototype1_RequiredSomeipServiceInstance23_PortMapping: port-prototype=fm_a_service_libExecutable10Prototype, process=fm_a_service_libProcessDesign10
    RPortPrototype1_RequiredSomeipServiceInstance23_PortMapping: port-prototype=fm_a_service_libExecutable10Prototype.IflytekConfigManager, process=fm_a_service_libProcessDesign10, service-instance=IflytekConfigManager_RequiredSomeipFmAService
    IflytekAlarmInfoMdcA_ProvidedSomeipServiceInstance29_PortMapping: port-prototype=fm_a_service_libExecutable10Prototype.IflytekAlarmInfoMdcA, process=fm_a_service_libProcessDesign10, service-instance=IflytekAlarmInfoMdcA_ProvidedSomeipFmAService
    IflytekAlarmInfoMdcA_RequiredSomeipServiceInstance24_PortMapping: port-prototype=mdc_a_fm_libExecutable12Prototype.IflytekAlarmInfoMdcA, process=mdc_a_fm_libProcessDesign12
    IflytekAlarmInfoFiniteStateManager_ProvidedSomeipServiceInstance29_PortMapping: port-prototype=fm_b_service_libExecutable10Prototype.IflytekAlarmInfoFiniteStateManager, process=fm_b_service_libProcessDesign10, service-instance=IflytekAlarmInfoFiniteStateManager_ProvidedSomeipServiceInstance29
    RPortPrototype1_DdsRequiredServiceInstance43_PortMapping: port-prototype=hmi_service_libExecutable1Prototype.IflytekFsmHmiSocOuter, process=hmi_service_libProcessDesign1, service-instance=IflytekFsmHmiSocOuter_DdsRequiredHmiService
    RPortPrototype2_DdsRequiredServiceInstance44_PortMapping: port-prototype=hmi_service_libExecutable1Prototype.IflytekFsmSocState, process=hmi_service_libProcessDesign1, service-instance=IflytekFsmSocState_DdsRequiredHmiService
    RPortPrototype1_DdsRequiredServiceInstance45_PortMapping: port-prototype=mega_libExecutable6Prototype.IflytekFsmSocState, process=mega_libProcessDesign6, service-instance=IflytekFsmSocState_DdsRequiredServiceInstance45
    RPortPrototype1_DdsRequiredServiceInstance46_PortMapping: port-prototype=panorama_view_camera_perception_laneline_libExecutable7Prototype.IflytekFsmSocState, process=panorama_view_camera_perception_laneline_libProcessDesign7, service-instance=IflytekFsmSocState_DdsRequiredServiceInstance46
    RPortPrototype1_DdsRequiredServiceInstance47_PortMapping: port-prototype=around_view_camera_perception_libExecutable8Prototype.IflytekFsmSocState, process=around_view_camera_perception_libProcessDesign8, service-instance=IflytekFsmSocState_DdsRequiredServiceInstance47
    RPortPrototype1_DdsRequiredServiceInstance48_PortMapping: port-prototype=function_data_loop_libExecutable16Prototype.IflytekCalibrationCalibInfo, process=function_data_loop_libProcessDesign16, service-instance=IflytekCalibrationCalibInfo_DdsRequiredServiceInstance48
    RPortPrototype1_DdsRequiredServiceInstance49_PortMapping: port-prototype=function_data_loop_libExecutable16Prototype.IflytekSensorCameraSurroundFrontFullResolutionH265, process=function_data_loop_libProcessDesign16, service-instance=IflytekSensorCameraSurroundFrontFullResolutionH265_DdsRequiredServiceInstance49
    RPortPrototype1_DdsRequiredServiceInstance50_PortMapping: port-prototype=function_data_loop_libExecutable16Prototype.IflytekSensorCameraSurroundLeftFullResolutionH265, process=function_data_loop_libProcessDesign16, service-instance=IflytekSensorCameraSurroundLeftFullResolutionH265_DdsRequiredServiceInstance50
    RPortPrototype1_DdsRequiredServiceInstance51_PortMapping: port-prototype=function_data_loop_libExecutable16Prototype.IflytekSensorCameraSurroundRearFullResolutionH265, process=function_data_loop_libProcessDesign16, service-instance=IflytekSensorCameraSurroundRearFullResolutionH265_DdsRequiredServiceInstance51
    RPortPrototype1_DdsRequiredServiceInstance52_PortMapping: port-prototype=function_data_loop_libExecutable16Prototype.IflytekSensorCameraSurroundRightFullResolutionH265, process=function_data_loop_libProcessDesign16, service-instance=IflytekSensorCameraSurroundRightFullResolutionH265_DdsRequiredServiceInstance52
    RPortPrototype1_DdsRequiredServiceInstance53_PortMapping: port-prototype=function_data_loop_libExecutable16Prototype.IflytekSensorCameraFront120FullResolutionH265, process=function_data_loop_libProcessDesign16, service-instance=IflytekSensorCameraFront120FullResolutionH265_DdsRequiredServiceInstance53
    RPortPrototype1_DdsRequiredServiceInstance54_PortMapping: port-prototype=function_data_loop_libExecutable16Prototype.IflytekSensorCameraFront30FullResolutionH265, process=function_data_loop_libProcessDesign16, service-instance=IflytekSensorCameraFront30FullResolutionH265_DdsRequiredServiceInstance54
    RPortPrototype1_DdsRequiredServiceInstance55_PortMapping: port-prototype=function_data_loop_libExecutable16Prototype.IflytekSensorCameraSideFlFullResolutionH265, process=function_data_loop_libProcessDesign16, service-instance=IflytekSensorCameraSideFlFullResolutionH265_DdsRequiredServiceInstance55
    RPortPrototype1_DdsRequiredServiceInstance56_PortMapping: port-prototype=function_data_loop_libExecutable16Prototype.IflytekSensorCameraSideFrFullResolutionH265, process=function_data_loop_libProcessDesign16, service-instance=IflytekSensorCameraSideFrFullResolutionH265_DdsRequiredServiceInstance56
    RPortPrototype1_DdsRequiredServiceInstance57_PortMapping: port-prototype=function_data_loop_libExecutable16Prototype.IflytekSensorCameraSideRlFullResolutionH265, process=function_data_loop_libProcessDesign16, service-instance=IflytekSensorCameraSideRlFullResolutionH265_DdsRequiredServiceInstance57
    RPortPrototype1_DdsRequiredServiceInstance58_PortMapping: port-prototype=function_data_loop_libExecutable16Prototype.IflytekSensorCameraSideRrFullResolutionH265, process=function_data_loop_libProcessDesign16, service-instance=IflytekSensorCameraSideRrFullResolutionH265_DdsRequiredServiceInstance58
    RPortPrototype1_DdsRequiredServiceInstance59_PortMapping: port-prototype=function_data_loop_libExecutable16Prototype.IflytekSensorCameraRearFullResolutionH265, process=function_data_loop_libProcessDesign16, service-instance=IflytekSensorCameraRearFullResolutionH265_DdsRequiredServiceInstance59
    RPortPrototype1_DdsRequiredServiceInstance60_PortMapping: port-prototype=function_data_loop_libExecutable16Prototype.IflytekCameraPerceptionTrafficSignRecognition, process=function_data_loop_libProcessDesign16, service-instance=IflytekCameraPerceptionTrafficSignRecognition_DdsRequiredServiceInstance60
    RPortPrototype1_DdsRequiredServiceInstance61_PortMapping: port-prototype=function_data_loop_libExecutable16Prototype.IflytekCameraPerceptionOccGrid, process=function_data_loop_libProcessDesign16, service-instance=IflytekCameraPerceptionOccGrid_DdsRequiredServiceInstance61
    RPortPrototype1_DdsRequiredServiceInstance63_PortMapping: port-prototype=function_data_loop_libExecutable16Prototype.IflytekCameraPerceptionLaneTopo, process=function_data_loop_libProcessDesign16, service-instance=IflytekCameraPerceptionLaneTopo_DdsRequiredServiceInstance63
    RPortPrototype1_DdsRequiredServiceInstance64_PortMapping: port-prototype=function_data_loop_libExecutable16Prototype.IflytekPredictionPredictionResult, process=function_data_loop_libProcessDesign16, service-instance=IflytekPredictionPredictionResult_DdsRequiredServiceInstance64
    RPortPrototype1_DdsRequiredServiceInstance65_PortMapping: port-prototype=function_data_loop_libExecutable16Prototype.IflytekCameraPerceptionLaneLines, process=function_data_loop_libProcessDesign16, service-instance=IflytekCameraPerceptionLaneLines_DdsRequiredServiceInstance65
    RPortPrototype1_DdsRequiredServiceInstance66_PortMapping: port-prototype=function_data_loop_libExecutable16Prototype.IflytekCameraPerceptionObjects, process=function_data_loop_libProcessDesign16, service-instance=IflytekCameraPerceptionObjects_DdsRequiredServiceInstance66
    RPortPrototype1_DdsRequiredServiceInstance67_PortMapping: port-prototype=function_data_loop_libExecutable16Prototype.IflytekCameraPerceptionOccupancyObjects, process=function_data_loop_libProcessDesign16, service-instance=IflytekCameraPerceptionOccupancyObjects_DdsRequiredServiceInstance67
    RPortPrototype1_DdsRequiredServiceInstance68_PortMapping: port-prototype=function_data_loop_libExecutable16Prototype.IflytekCameraPerception3dGeneralObjects, process=function_data_loop_libProcessDesign16, service-instance=IflytekCameraPerception3dGeneralObjects_DdsRequiredServiceInstance68
    RPortPrototype1_DdsRequiredServiceInstance69_PortMapping: port-prototype=function_data_loop_libExecutable16Prototype.IflytekCameraPerceptionParkingSlotList, process=function_data_loop_libProcessDesign16, service-instance=IflytekCameraPerceptionParkingSlotList_DdsRequiredServiceInstance69
    RPortPrototype1_DdsRequiredServiceInstance70_PortMapping: port-prototype=function_data_loop_libExecutable16Prototype.IflytekCameraPerceptionParkingLaneLine, process=function_data_loop_libProcessDesign16, service-instance=IflytekCameraPerceptionParkingLaneLine_DdsRequiredServiceInstance70
    RPortPrototype1_DdsRequiredServiceInstance71_PortMapping: port-prototype=function_data_loop_libExecutable16Prototype.IflytekCameraPerceptionGroundLine, process=function_data_loop_libProcessDesign16, service-instance=IflytekCameraPerceptionGroundLine_DdsRequiredServiceInstance71
    RPortPrototype1_DdsRequiredServiceInstance72_PortMapping: port-prototype=function_data_loop_libExecutable16Prototype.IflytekCameraPerceptionDeceler, process=function_data_loop_libProcessDesign16, service-instance=IflytekCameraPerceptionDeceler_DdsRequiredServiceInstance72
    RPortPrototype1_DdsRequiredServiceInstance73_PortMapping: port-prototype=function_data_loop_libExecutable16Prototype.IflytekFusionSpatialParkingSlot, process=function_data_loop_libProcessDesign16, service-instance=IflytekFusionSpatialParkingSlot_DdsRequiredServiceInstance73
    RPortPrototype1_DdsRequiredServiceInstance74_PortMapping: port-prototype=function_data_loop_libExecutable16Prototype.IflytekFusionParkingSlot, process=function_data_loop_libProcessDesign16, service-instance=IflytekFusionParkingSlot_DdsRequiredServiceInstance74
    RPortPrototype1_DdsRequiredServiceInstance75_PortMapping: port-prototype=function_data_loop_libExecutable16Prototype.IflytekFusionRoadFusion, process=function_data_loop_libProcessDesign16, service-instance=IflytekFusionRoadFusion_DdsRequiredServiceInstance75
    RPortPrototype2_DdsRequiredServiceInstance76_PortMapping: port-prototype=function_data_loop_libExecutable16Prototype.IflytekFusionObjects, process=function_data_loop_libProcessDesign16, service-instance=IflytekFusionObjects_DdsRequiredServiceInstance76
    RPortPrototype1_DdsRequiredServiceInstance77_PortMapping: port-prototype=function_data_loop_libExecutable16Prototype.IflytekFusionObjectsCompress, process=function_data_loop_libProcessDesign16, service-instance=IflytekFusionObjectsCompress_DdsRequiredServiceInstance77
    RPortPrototype1_DdsRequiredServiceInstance78_PortMapping: port-prototype=function_data_loop_libExecutable16Prototype.IflytekFusionUssPerceptionInfo, process=function_data_loop_libProcessDesign16, service-instance=IflytekFusionUssPerceptionInfo_DdsRequiredServiceInstance78
    RPortPrototype1_DdsRequiredServiceInstance79_PortMapping: port-prototype=function_data_loop_libExecutable16Prototype.IflytekFusionOccupancyObjects, process=function_data_loop_libProcessDesign16, service-instance=IflytekFusionOccupancyObjects_DdsRequiredServiceInstance79
    RPortPrototype1_DdsRequiredServiceInstance80_PortMapping: port-prototype=function_data_loop_libExecutable16Prototype.IflytekFusionRoadFusionCompress, process=function_data_loop_libProcessDesign16, service-instance=IflytekFusionRoadFusionCompress_DdsRequiredServiceInstance80
    RPortPrototype1_DdsRequiredServiceInstance81_PortMapping: port-prototype=function_data_loop_libExecutable16Prototype.IflytekFusionGroundLine, process=function_data_loop_libProcessDesign16, service-instance=IflytekFusionGroundLine_DdsRequiredServiceInstance81
    RPortPrototype1_DdsRequiredServiceInstance82_PortMapping: port-prototype=function_data_loop_libExecutable16Prototype.IflytekFusionSpeedBump, process=function_data_loop_libProcessDesign16, service-instance=IflytekFusionSpeedBump_DdsRequiredServiceInstance82
    RPortPrototype1_DdsRequiredServiceInstance83_PortMapping: port-prototype=function_data_loop_libExecutable16Prototype.IflytekMegaLocalMap, process=function_data_loop_libProcessDesign16, service-instance=IflytekMegaLocalMap_DdsRequiredServiceInstance83
    RPortPrototype1_DdsRequiredServiceInstance84_PortMapping: port-prototype=function_data_loop_libExecutable16Prototype.IflytekMegaMappingStatus, process=function_data_loop_libProcessDesign16, service-instance=IflytekMegaMappingStatus_DdsRequiredServiceInstance84
    RPortPrototype1_DdsRequiredServiceInstance85_PortMapping: port-prototype=function_data_loop_libExecutable16Prototype.IflytekUssUsswaveInfo, process=function_data_loop_libProcessDesign16, service-instance=IflytekUssUsswaveInfo_DdsRequiredServiceInstance85
    RPortPrototype1_DdsRequiredServiceInstance86_PortMapping: port-prototype=function_data_loop_libExecutable16Prototype.IflytekRadarFlPerceptionInfo, process=function_data_loop_libProcessDesign16, service-instance=IflytekRadarFlPerceptionInfo_DdsRequiredServiceInstance86
    RPortPrototype1_DdsRequiredServiceInstance87_PortMapping: port-prototype=function_data_loop_libExecutable16Prototype.IflytekRadarFrPerceptionInfo, process=function_data_loop_libProcessDesign16, service-instance=IflytekRadarFrPerceptionInfo_DdsRequiredServiceInstance87
    RPortPrototype1_DdsRequiredServiceInstance88_PortMapping: port-prototype=function_data_loop_libExecutable16Prototype.IflytekRadarRlPerceptionInfo, process=function_data_loop_libProcessDesign16, service-instance=IflytekRadarRlPerceptionInfo_DdsRequiredServiceInstance88
    RPortPrototype1_DdsRequiredServiceInstance89_PortMapping: port-prototype=function_data_loop_libExecutable16Prototype.IflytekRadarRrPerceptionInfo, process=function_data_loop_libProcessDesign16, service-instance=IflytekRadarRrPerceptionInfo_DdsRequiredServiceInstance89
    RPortPrototype1_DdsRequiredServiceInstance90_PortMapping: port-prototype=function_data_loop_libExecutable16Prototype.IflytekRadarFmPerception4dPointCloud, process=function_data_loop_libProcessDesign16, service-instance=IflytekRadarFmPerception4dPointCloud_DdsRequiredServiceInstance90
    RPortPrototype1_DdsRequiredServiceInstance91_PortMapping: port-prototype=function_data_loop_libExecutable16Prototype.IflytekRadarFmPerception4dTarget, process=function_data_loop_libProcessDesign16, service-instance=IflytekRadarFmPerception4dTarget_DdsRequiredServiceInstance91
    RPortPrototype1_DdsRequiredServiceInstance92_PortMapping: port-prototype=function_data_loop_libExecutable16Prototype.IflytekSensorImu, process=function_data_loop_libProcessDesign16, service-instance=IflytekSensorImu_DdsRequiredServiceInstance92
    RPortPrototype1_DdsRequiredServiceInstance93_PortMapping: port-prototype=function_data_loop_libExecutable16Prototype.IflytekVehicleService, process=function_data_loop_libProcessDesign16, service-instance=IflytekVehicleService_DdsRequiredServiceInstance93
    RPortPrototype1_DdsRequiredServiceInstance94_PortMapping: port-prototype=function_data_loop_libExecutable16Prototype.IflytekSensorGnss, process=function_data_loop_libProcessDesign16, service-instance=IflytekSensorGnss_DdsRequiredServiceInstance94
    RPortPrototype1_DdsRequiredServiceInstance95_PortMapping: port-prototype=function_data_loop_libExecutable16Prototype.IflytekLocalizationEgomotion, process=function_data_loop_libProcessDesign16, service-instance=IflytekLocalizationEgomotion_DdsRequiredServiceInstance95
    RPortPrototype1_DdsRequiredServiceInstance96_PortMapping: port-prototype=function_data_loop_libExecutable16Prototype.IflytekLocalizationSemanticInfo, process=function_data_loop_libProcessDesign16, service-instance=IflytekLocalizationSemanticInfo_DdsRequiredServiceInstance96
    RPortPrototype1_DdsRequiredServiceInstance97_PortMapping: port-prototype=function_data_loop_libExecutable16Prototype.IflytekEhrSdmapInfo, process=function_data_loop_libProcessDesign16, service-instance=IflytekEhrSdmapInfo_DdsRequiredServiceInstance97
    RPortPrototype1_DdsRequiredServiceInstance98_PortMapping: port-prototype=function_data_loop_libExecutable16Prototype.IflytekEhrStaticMap, process=function_data_loop_libProcessDesign16, service-instance=IflytekEhrStaticMap_DdsRequiredServiceInstance98
    RPortPrototype1_DdsRequiredServiceInstance99_PortMapping: port-prototype=function_data_loop_libExecutable16Prototype.IflytekEhrSdpromapInfo, process=function_data_loop_libProcessDesign16, service-instance=IflytekEhrSdpromapInfo_DdsRequiredServiceInstance99
    RPortPrototype1_DdsRequiredServiceInstance103_PortMapping: port-prototype=function_data_loop_libExecutable16Prototype.IflytekHmiInner, process=function_data_loop_libProcessDesign16, service-instance=IflytekHmiInner_DdsRequiredServiceInstance103
    RPortPrototype1_DdsRequiredServiceInstance104_PortMapping: port-prototype=function_data_loop_libExecutable16Prototype.IflytekFsmSocState, process=function_data_loop_libProcessDesign16, service-instance=IflytekFsmSocState_DdsRequiredServiceInstance104
    RPortPrototype1_DdsRequiredServiceInstance105_PortMapping: port-prototype=function_data_loop_libExecutable16Prototype.IflytekFsmHmiSocOuter, process=function_data_loop_libProcessDesign16, service-instance=IflytekFsmHmiSocOuter_DdsRequiredServiceInstance105
    RPortPrototype1_DdsRequiredServiceInstance106_PortMapping: port-prototype=function_data_loop_libExecutable16Prototype.IflytekAdasFunctionAdas, process=function_data_loop_libProcessDesign16, service-instance=IflytekAdasFunctionAdas_DdsRequiredServiceInstance106
    RPortPrototype1_DdsRequiredServiceInstance107_PortMapping: port-prototype=function_data_loop_libExecutable16Prototype.IflytekControlControlCommand, process=function_data_loop_libProcessDesign16, service-instance=IflytekControlControlCommand_DdsRequiredServiceInstance107
    RPortPrototype1_DdsRequiredServiceInstance108_PortMapping: port-prototype=function_data_loop_libExecutable16Prototype.IflytekPlanningPlan, process=function_data_loop_libProcessDesign16, service-instance=IflytekPlanningPlan_DdsRequiredServiceInstance108
    RPortPrototype1_DdsRequiredServiceInstance109_PortMapping: port-prototype=function_data_loop_libExecutable16Prototype.IflytekPlanningHmi, process=function_data_loop_libProcessDesign16, service-instance=IflytekPlanningHmi_DdsRequiredServiceInstance109
    RPortPrototype1_DdsRequiredServiceInstance110_PortMapping: port-prototype=function_data_loop_libExecutable16Prototype.IflytekSdmapSdmapInfo, process=function_data_loop_libProcessDesign16, service-instance=IflytekSdmapSdmapInfo_DdsRequiredServiceInstance110
    IflytekAlarmInfoFdl_ProvidedSomeipServiceInstance30_PortMapping: port-prototype=fm_b_service_libExecutable10Prototype.IflytekAlarmInfoFdl, process=fm_b_service_libProcessDesign10, service-instance=IflytekAlarmInfoFdl_ProvidedSomeipServiceInstance30
    RPortPrototype1_RequiredSomeipServiceInstance24_PortMapping: port-prototype=function_data_loop_libExecutable16Prototype.IflytekAlarmInfoFdl, process=function_data_loop_libProcessDesign16, service-instance=IflytekAlarmInfoFdl_RequiredSomeipServiceInstance24
    IflytekAlarmInfoFmAService_DdsProvidedServiceInstance25_PortMapping: port-prototype=fm_a_service_libExecutable10Prototype.IflytekAlarmInfoFmAService, process=fm_a_service_libProcessDesign10, service-instance=IflytekAlarmInfoFmAService_DdsProvidedFmAService
    IflytekDTCInfoFmAService_DdsProvidedServiceInstance26_PortMapping: port-prototype=fm_a_service_libExecutable10Prototype.IflytekDTCInfoFmAService, process=fm_a_service_libProcessDesign10, service-instance=IflytekDTCInfoFmAService_DdsProvidedFmAService
    RPortPrototype1_DdsRequiredServiceInstance112_PortMapping: port-prototype=function_data_loop_libExecutable16Prototype.IflytekDTCInfoFmAService, process=function_data_loop_libProcessDesign16, service-instance=IflytekDTCInfoFmAService_DdsRequiredServiceInstance112
    RPortPrototype1_DdsRequiredServiceInstance113_PortMapping: port-prototype=function_data_loop_libExecutable16Prototype.IflytekAlarmInfoFmAService, process=function_data_loop_libProcessDesign16, service-instance=IflytekAlarmInfoFmAService_DdsRequiredServiceInstance113
    RPortPrototype1_RequiredSomeipServiceInstance25_PortMapping: port-prototype=function_data_loop_libExecutable16Prototype.IflytekConfigManager, process=function_data_loop_libProcessDesign16, service-instance=IflytekConfigManager_RequiredSomeipServiceInstance25
    RPortPrototype1_RequiredSomeipServiceInstance23_PortMapping: port-prototype=fm_a_service_libExecutable10Prototype.IflytekPostSaleCalibrationActivation, process=fm_a_service_libProcessDesign10, service-instance=IflytekPostSaleCalibrationActivation_RequiredSomeipFmAService
    RPortPrototype1_RequiredSomeipServiceInstance24_PortMapping: port-prototype=fm_a_service_libExecutable10Prototype.IflytekPostSaleCalibrationStop, process=fm_a_service_libProcessDesign10, service-instance=IflytekPostSaleCalibrationStop_RequiredSomeipFmAService
    RPortPrototype1_RequiredSomeipServiceInstance25_PortMapping: port-prototype=fm_a_service_libExecutable10Prototype.IflytekPostSaleCalibrationResult, process=fm_a_service_libProcessDesign10, service-instance=IflytekPostSaleCalibrationResult_RequiredSomeipFmAService
    RPortPrototype1_DdsRequiredServiceInstance114_PortMapping: port-prototype=mega_libExecutable6Prototype.IflytekVehicleService, process=mega_libProcessDesign6, service-instance=IflytekVehicleService_DdsRequiredMega
    RPortPrototype1_DdsRequiredServiceInstance115_PortMapping: port-prototype=fm_a_service_libExecutable10Prototype.IflytekVehicleService, process=fm_a_service_libProcessDesign10, service-instance=IflytekVehicleService_DdsRequiredFmAService
    IflytekAlarmInfoToBCamera_DdsProvidedServiceInstance26_PortMapping: port-prototype=fm_b_service_libExecutable10Prototype.IflytekAlarmInfoToBCamera, process=fm_b_service_libProcessDesign10, service-instance=IflytekAlarmInfoToBCamera_DdsProvidedFmBService
    IflytekAlarmInfoToACamera_DdsProvidedServiceInstance27_PortMapping: port-prototype=fm_a_service_libExecutable10Prototype.IflytekAlarmInfoToACamera, process=fm_a_service_libProcessDesign10, service-instance=IflytekAlarmInfoToACamera_DdsProvidedFmAService
    RPortPrototype1_DdsRequiredServiceInstance116_PortMapping: port-prototype=hmi_service_libExecutable1Prototype.IflytekCameraPerceptionOccupancyObjects, process=hmi_service_libProcessDesign1, service-instance=IflytekCameraPerceptionOccupancyObjects_DdsRequiredHmiService
    RPortPrototype1_DdsRequiredServiceInstance117_PortMapping: port-prototype=function_data_loop_libExecutable16Prototype.IflytekSystemVersion, process=function_data_loop_libProcessDesign16, service-instance=IflytekSystemVersion_DdsRequiredFunctionDataLoop
    IflytekFdlTrigger_DdsProvidedServiceInstance28_PortMapping: port-prototype=function_data_loop_libExecutable16Prototype.IflytekFdlTrigger, process=function_data_loop_libProcessDesign16, service-instance=IflytekFdlTrigger_DdsProvidedFunctionDataLoopB
    RPortPrototype1_DdsRequiredServiceInstance118_PortMapping: port-prototype=function_data_loop_libExecutable16Prototype.IflytekFdlTriggerAck, process=function_data_loop_libProcessDesign16, service-instance=IflytekFdlTriggerAck_DdsRequiredFunctionDataLoopB
    IflytekFdlTriggerAck_DdsProvidedServiceInstance29_PortMapping: port-prototype=function_data_loop_a_libExecutable16Prototype.IflytekFdlTriggerAck, process=function_data_loop_a_libProcessDesign16, service-instance=IflytekFdlTriggerAck_DdsProvidedFunctionDataLoopA
    RPortPrototype1_DdsRequiredServiceInstance119_PortMapping: port-prototype=function_data_loop_a_libExecutable16Prototype.IflytekFdlTrigger, process=function_data_loop_a_libProcessDesign16, service-instance=IflytekFdlTrigger_DdsRequiredFunctionDataLoopA
    RPortPrototype1_DdsRequiredServiceInstance120_PortMapping: port-prototype=fm_a_service_libExecutable10Prototype.IflytekMcuFmASentinel, process=fm_a_service_libProcessDesign10, service-instance=IflytekMcuFmASentinel_DdsRequiredFmAService
    IflytekFmAMcuSentinel_DdsProvidedServiceInstance30_PortMapping: port-prototype=fm_a_service_libExecutable10Prototype.IflytekFmAMcuSentinel, process=fm_a_service_libProcessDesign10, service-instance=IflytekFmAMcuSentinel_DdsProvidedFmAService
    IflytekFmACameraSentinel_DdsProvidedServiceInstance31_PortMapping: port-prototype=fm_a_service_libExecutable10Prototype.IflytekFmACameraSentinel, process=fm_a_service_libProcessDesign10, service-instance=IflytekFmACameraSentinel_DdsProvidedFmAService
    RPortPrototype1_DdsRequiredServiceInstance122_PortMapping: port-prototype=function_data_loop_libExecutable16Prototype.IflytekPlanningDebugInfo, process=function_data_loop_libProcessDesign16, service-instance=IflytekPlanningDebugInfo_DdsRequiredFunctionDataLoop
    RPortPrototype1_DdsRequiredServiceInstance123_PortMapping: port-prototype=function_data_loop_libExecutable16Prototype.IflytekControlDebugInfo, process=function_data_loop_libProcessDesign16, service-instance=IflytekControlDebugInfo_DdsRequiredFunctionDataLoop
    RPortPrototype1_DdsRequiredServiceInstance124_PortMapping: port-prototype=function_data_loop_libExecutable16Prototype.IflytekAdasFunctionDebugInfo, process=function_data_loop_libProcessDesign16, service-instance=IflytekAdasFunctionDebugInfo_DdsRequiredFunctionDataLoop
    IflytekRadarPerception4dTargetMcu_DdsProvidedServiceInstance32_PortMapping: port-prototype=radar_4d_service_libExecutable2Prototype.IflytekRadarPerception4dTargetMcu, process=radar_4d_service_libProcessDesign2, service-instance=IflytekRadarPerception4dTargetMcu_DdsProvidedServiceInstance32
    IflytekEngineerInner_DdsProvidedServiceInstance33_PortMapping: port-prototype=hmi_service_libExecutable1Prototype.IflytekEngineerInner, process=hmi_service_libProcessDesign1, service-instance=IflytekEngineerInner_DdsProvidedHmiService
    RPortPrototype1_DdsRequiredServiceInstance125_PortMapping: port-prototype=fm_a_service_libExecutable10Prototype.IflytekEngineerInner, process=fm_a_service_libProcessDesign10, service-instance=IflytekEngineerInner_DdsRequiredFmAService
    RPortPrototype1_DdsRequiredServiceInstance126_PortMapping: port-prototype=hmi_service_libExecutable1Prototype.IflytekAlarmInfoFmAService, process=hmi_service_libProcessDesign1, service-instance=IflytekAlarmInfoFmAService_DdsRequiredHmiService
    IflytekFmAMcuDegradeFunciton_DdsProvidedServiceInstance34_PortMapping: port-prototype=fm_a_service_libExecutable10Prototype.IflytekFmAMcuDegradeFunciton, process=fm_a_service_libProcessDesign10, service-instance=IflytekFmAMcuDegradeFunciton_DdsProvidedServiceInstance34
    IflytekFmADegradeFunciton_DdsProvidedServiceInstance35_PortMapping: port-prototype=fm_a_service_libExecutable10Prototype.IflytekFmADegradeFunciton, process=fm_a_service_libProcessDesign10, service-instance=IflytekFmADegradeFunciton_DdsProvidedServiceInstance35
    IflytekCameraPerceptionPanoramaView2DBoundingBoxes_DdsProvidedServiceInstance36_PortMapping: port-prototype=panorama_view_camera_perception_laneline_libExecutable7Prototype.IflytekCameraPerceptionPanoramaView2DBoundingBoxes, process=panorama_view_camera_perception_laneline_libProcessDesign7, service-instance=IflytekCameraPerceptionPanoramaView2DBoundingBoxes_DdsProvidedServiceInstance36
    IflytekCameraPerceptionAroundView2DBoundingBoxes_DdsProvidedServiceInstance37_PortMapping: port-prototype=around_view_camera_perception_libExecutable8Prototype.IflytekCameraPerceptionAroundView2DBoundingBoxes, process=around_view_camera_perception_libProcessDesign8, service-instance=IflytekCameraPerceptionAroundView2DBoundingBoxes_DdsProvidedServiceInstance37
    RPortPrototype1_DdsRequiredServiceInstance127_PortMapping: port-prototype=function_data_loop_libExecutable16Prototype.IflytekSensorCameraRearFullResolutionH265MDCA, process=function_data_loop_libProcessDesign16, service-instance=IflytekSensorCameraRearFullResolutionH265MDCA_DdsRequiredFunctionDataLoop
    RPortPrototype1_DdsRequiredServiceInstance128_PortMapping: port-prototype=function_data_loop_libExecutable16Prototype.IflytekFmAMcuSentinel, process=function_data_loop_libProcessDesign16, service-instance=IflytekFmAMcuSentinel_DdsRequiredServiceInstance128
    RPortPrototype1_DdsRequiredServiceInstance129_PortMapping: port-prototype=function_data_loop_libExecutable16Prototype.IflytekMcuFmASentinel, process=function_data_loop_libProcessDesign16, service-instance=IflytekMcuFmASentinel_DdsRequiredServiceInstance129
    RPortPrototype1_DdsRequiredServiceInstance130_PortMapping: port-prototype=function_data_loop_libExecutable16Prototype.IflytekFmADegradeFunciton, process=function_data_loop_libProcessDesign16, service-instance=IflytekFmADegradeFunciton_DdsRequiredServiceInstance130
    RPortPrototype1_DdsRequiredServiceInstance131_PortMapping: port-prototype=function_data_loop_libExecutable16Prototype.IflytekEngineerInner, process=function_data_loop_libProcessDesign16, service-instance=IflytekEngineerInner_DdsRequiredServiceInstance131
    RPortPrototype1_DdsRequiredServiceInstance132_PortMapping: port-prototype=function_data_loop_libExecutable16Prototype.IflytekCameraPerceptionAroundView2DBoundingBoxes, process=function_data_loop_libProcessDesign16, service-instance=IflytekCameraPerceptionAroundView2DBoundingBoxes_DdsRequiredServiceInstance132
    RPortPrototype1_DdsRequiredServiceInstance133_PortMapping: port-prototype=function_data_loop_libExecutable16Prototype.IflytekCameraPerceptionPanoramaView2DBoundingBoxes, process=function_data_loop_libProcessDesign16, service-instance=IflytekCameraPerceptionPanoramaView2DBoundingBoxes_DdsRequiredServiceInstance133
    RPortPrototype1_DdsRequiredServiceInstance134_PortMapping: port-prototype=function_data_loop_libExecutable16Prototype.IflytekCameraPerceptionScene, process=function_data_loop_libProcessDesign16, service-instance=IflytekCameraPerceptionScene_DdsRequiredServiceInstance134
    IflytekAlarmInfoPhmB_ProvidedSomeipServiceInstance31_PortMapping: port-prototype=fm_b_service_libExecutable10Prototype.IflytekAlarmInfoPhmB, process=fm_b_service_libProcessDesign10, service-instance=IflytekAlarmInfoPhmB_ProvidedSomeipFmBService
    RPortPrototype1_RequiredSomeipServiceInstance26_PortMapping: port-prototype=soc_b_phm_libExecutable17Prototype.IflytekAlarmInfoPhmB, process=soc_b_phm_libProcessDesign17, service-instance=IflytekAlarmInfoPhmB_RequiredSomeipSocBPhm
    RPortPrototype1_DdsRequiredServiceInstance135_PortMapping: port-prototype=soc_b_phm_libExecutable17Prototype.IflytekEhrPhmReport, process=soc_b_phm_libProcessDesign17, service-instance=IflytekEhrPhmReport_DdsRequiredSocBPhm
    RPortPrototype1_DdsRequiredServiceInstance137_PortMapping: port-prototype=soc_b_phm_libExecutable17Prototype.IflytekLocalizationPhmReport, process=soc_b_phm_libProcessDesign17, service-instance=IflytekLocalizationPhmReport_DdsRequiredSocBPhm
    RPortPrototype1_DdsRequiredServiceInstance138_PortMapping: port-prototype=soc_b_phm_libExecutable17Prototype.IflytekGnssPhmReport, process=soc_b_phm_libProcessDesign17, service-instance=IflytekGnssPhmReport_DdsRequiredSocBPhm
    IflytekHmiPhmReport_DdsProvidedServiceInstance39_PortMapping: port-prototype=hmi_service_libExecutable1Prototype.IflytekHmiPhmReport, process=hmi_service_libProcessDesign1, service-instance=IflytekHmiPhmReport_DdsProvidedHmiService
    RPortPrototype1_DdsRequiredServiceInstance139_PortMapping: port-prototype=soc_b_phm_libExecutable17Prototype.IflytekHmiPhmReport, process=soc_b_phm_libProcessDesign17, service-instance=IflytekHmiPhmReport_DdsRequiredSocBPhm
    Iflytek4dRadarPhmReport_DdsProvidedServiceInstance40_PortMapping: port-prototype=radar_4d_service_libExecutable2Prototype.Iflytek4dRadarPhmReport, process=radar_4d_service_libProcessDesign2, service-instance=Iflytek4dRadarPhmReport_DdsProvidedRadar4dService
    RPortPrototype1_DdsRequiredServiceInstance140_PortMapping: port-prototype=soc_b_phm_libExecutable17Prototype.Iflytek4dRadarPhmReport, process=soc_b_phm_libProcessDesign17, service-instance=Iflytek4dRadarPhmReport_DdsRequiredSocBPhm
    RPortPrototype1_DdsRequiredServiceInstance141_PortMapping: port-prototype=soc_b_phm_libExecutable17Prototype.IflytekCameraPerceptionPanoramaPhmReport, process=soc_b_phm_libProcessDesign17, service-instance=IflytekCameraPerceptionPanoramaPhmReport_DdsRequiredSocBPhm
    RPortPrototype1_DdsRequiredServiceInstance142_PortMapping: port-prototype=soc_b_phm_libExecutable17Prototype.IflytekFsmPhmReport, process=soc_b_phm_libProcessDesign17, service-instance=IflytekFsmPhmReport_DdsRequiredSocBPhm
    RPortPrototype1_DdsRequiredServiceInstance143_PortMapping: port-prototype=soc_b_phm_libExecutable17Prototype.IflytekCameraPanoramaPhmReport, process=soc_b_phm_libProcessDesign17, service-instance=IflytekCameraPanoramaPhmReport_DdsRequiredSocBPhm
    RPortPrototype1_RequiredSomeipServiceInstance27_PortMapping: port-prototype=soc_b_phm_libExecutable17Prototype.IflytekConfigManager, process=soc_b_phm_libProcessDesign17, service-instance=IflytekConfigManager_RequiredSomeipSocBPhm
    RPortPrototype1_RequiredSomeipServiceInstance28_PortMapping: port-prototype=soc_b_phm_libExecutable17Prototype.IflytekStateManager, process=soc_b_phm_libProcessDesign17, service-instance=IflytekStateManager_RequiredSomeipSocBPhm
    IflytekCameraPerceptionPanoramaLanelinePhmReport_DdsProvidedServiceInstance41_PortMapping: port-prototype=panorama_view_camera_perception_laneline_libExecutable7Prototype.IflytekCameraPerceptionPanoramaLanelinePhmReport, process=panorama_view_camera_perception_laneline_libProcessDesign7, service-instance=IflytekCameraPerceptionPanoramaLanelinePhmReport_DdsProvidedPanoramaViewCameraPerceptionLaneline
    RPortPrototype1_DdsRequiredServiceInstance144_PortMapping: port-prototype=soc_a_phm_libExecutable18Prototype.IflytekCameraPerceptionPanoramaLanelinePhmReport, process=soc_a_phm_libProcessDesign18, service-instance=IflytekCameraPerceptionPanoramaLanelinePhmReport_DdsRequiredSocAPhm
    RPortPrototype1_DdsRequiredServiceInstance145_PortMapping: port-prototype=soc_a_phm_libExecutable18Prototype.IflytekFusionObstaclePhmReport, process=soc_a_phm_libProcessDesign18, service-instance=IflytekFusionObstaclePhmReport_DdsRequiredSocAPhm
    RPortPrototype1_DdsRequiredServiceInstance146_PortMapping: port-prototype=soc_a_phm_libExecutable18Prototype.IflytekPlanningPhmReport, process=soc_a_phm_libProcessDesign18, service-instance=IflytekPlanningPhmReport_DdsRequiredSocAPhm
    RPortPrototype1_DdsRequiredServiceInstance147_PortMapping: port-prototype=soc_a_phm_libExecutable18Prototype.IflytekComPncPhmReport, process=soc_a_phm_libProcessDesign18, service-instance=IflytekComPncPhmReport_DdsRequiredSocAPhm
    IflytekCameraPerceptionAroundPhmReport_DdsProvidedServiceInstance42_PortMapping: port-prototype=around_view_camera_perception_libExecutable8Prototype.IflytekCameraPerceptionAroundPhmReport, process=around_view_camera_perception_libProcessDesign8, service-instance=IflytekCameraPerceptionAroundPhmReport_DdsProvidedAroundViewCameraPerception
    RPortPrototype1_DdsRequiredServiceInstance148_PortMapping: port-prototype=soc_a_phm_libExecutable18Prototype.IflytekCameraPerceptionAroundPhmReport, process=soc_a_phm_libProcessDesign18, service-instance=IflytekCameraPerceptionAroundPhmReport_DdsRequiredSocAPhm
    RPortPrototype1_DdsRequiredServiceInstance149_PortMapping: port-prototype=soc_a_phm_libExecutable18Prototype.IflytekCameraAroundPhmReport, process=soc_a_phm_libProcessDesign18, service-instance=IflytekCameraAroundPhmReport_DdsRequiredSocAPhm
    IflytekMegaPhmReport_DdsProvidedServiceInstance43_PortMapping: port-prototype=mega_libExecutable6Prototype.IflytekMegaPhmReport, process=mega_libProcessDesign6, service-instance=IflytekMegaPhmReport_DdsProvidedMega
    RPortPrototype1_DdsRequiredServiceInstance150_PortMapping: port-prototype=soc_a_phm_libExecutable18Prototype.IflytekMegaPhmReport, process=soc_a_phm_libProcessDesign18, service-instance=IflytekMegaPhmReport_DdsRequiredSocAPhm
    RPortPrototype1_DdsRequiredServiceInstance151_PortMapping: port-prototype=soc_a_phm_libExecutable18Prototype.IflytekControlPhmReport, process=soc_a_phm_libProcessDesign18, service-instance=IflytekControlPhmReport_DdsRequiredSocAPhm
    RPortPrototype1_DdsRequiredServiceInstance152_PortMapping: port-prototype=soc_a_phm_libExecutable18Prototype.IflytekFusionStaticPhmReport, process=soc_a_phm_libProcessDesign18, service-instance=IflytekFusionStaticPhmReport_DdsRequiredSocAPhm
    IflytekAlarmInfoPhmA_ProvidedSomeipServiceInstance32_PortMapping: port-prototype=fm_a_service_libExecutable10Prototype.IflytekAlarmInfoPhmA, process=fm_a_service_libProcessDesign10, service-instance=IflytekAlarmInfoPhmA_ProvidedSomeipFmAService
    RPortPrototype1_RequiredSomeipServiceInstance29_PortMapping: port-prototype=soc_a_phm_libExecutable18Prototype.IflytekAlarmInfoPhmA, process=soc_a_phm_libProcessDesign18, service-instance=IflytekAlarmInfoPhmA_RequiredSomeipSocAPhm
    RPortPrototype1_RequiredSomeipServiceInstance30_PortMapping: port-prototype=soc_a_phm_libExecutable18Prototype.IflytekConfigManager, process=soc_a_phm_libProcessDesign18, service-instance=IflytekConfigManager_RequiredSomeipServiceInstance30
    RPortPrototype1_RequiredSomeipServiceInstance31_PortMapping: port-prototype=soc_a_phm_libExecutable18Prototype.IflytekStateManager, process=soc_a_phm_libProcessDesign18, service-instance=IflytekStateManager_RequiredSomeipSocAPhm
    IflytekCameraPerception3dOccupancyObjects_DdsProvidedServiceInstance44_PortMapping: port-prototype=around_view_camera_perception_libExecutable8Prototype.IflytekCameraPerception3dOccupancyObjects, process=around_view_camera_perception_libProcessDesign8, service-instance=IflytekCameraPerception3dOccupancyObjects_DdsProvidedServiceInstance44
    RPortPrototype1_DdsRequiredServiceInstance153_PortMapping: port-prototype=hmi_service_libExecutable1Prototype.IflytekCameraPerception3dOccupancyObjects, process=hmi_service_libProcessDesign1, service-instance=IflytekCameraPerception3dOccupancyObjects_DdsRequiredServiceInstance153
    RPortPrototype1_DdsRequiredServiceInstance154_PortMapping: port-prototype=fm_a_service_libExecutable10Prototype.IflytekCameraState, process=fm_a_service_libProcessDesign10, service-instance=IflytekCameraState_DdsRequiredFmAService
    IflytekFdlUploadState_DdsProvidedServiceInstance45_PortMapping: port-prototype=function_data_loop_libExecutable16Prototype.IflytekFdlUploadState, process=function_data_loop_libProcessDesign16, service-instance=IflytekFdlUploadState_DdsProvidedFunctionDataLoop
    RPortPrototype1_DdsRequiredServiceInstance153_PortMapping: port-prototype=fm_a_service_libExecutable10Prototype.IflytekFdlUploadState, process=fm_a_service_libProcessDesign10, service-instance=IflytekFdlUploadState_DdsRequiredFmAService
    IflytekFdlNetStatCheck_ProvidedSomeipServiceInstance33_PortMapping: port-prototype=function_data_loop_libExecutable16Prototype.IflytekFdlNetStatCheck, process=function_data_loop_libProcessDesign16, service-instance=IflytekFdlNetStatCheck_ProvidedSomeipFunctionDataLoop
    RPortPrototype1_RequiredSomeipServiceInstance32_PortMapping: port-prototype=fm_a_service_libExecutable10Prototype.IflytekFdlNetStatCheck, process=fm_a_service_libProcessDesign10, service-instance=IflytekFdlNetStatCheck_RequiredSomeipFmAService
    IflytekDiskSpaceInfoPhmAOta_DdsProvidedServiceInstance46_PortMapping: port-prototype=soc_a_phm_libExecutable18Prototype.IflytekDiskSpaceInfoPhmAOta, process=soc_a_phm_libProcessDesign18, service-instance=IflytekDiskSpaceInfoPhmAOta_DdsProvidedSocAPhm
    RPortPrototype1_DdsRequiredServiceInstance154_PortMapping: port-prototype=ota_node_libExecutable16Prototype.IflytekDiskSpaceInfoPhmAOta, process=ota_node_libProcessDesign16, service-instance=IflytekDiskSpaceInfoPhmAOta_DdsRequiredOtaNode
    IflytekDiskSpaceInfoPhmBOta_DdsProvidedServiceInstance47_PortMapping: port-prototype=soc_b_phm_libExecutable17Prototype.IflytekDiskSpaceInfoPhmBOta, process=soc_b_phm_libProcessDesign17, service-instance=IflytekDiskSpaceInfoPhmBOta_DdsProvidedSocBPhm
    RPortPrototype1_DdsRequiredServiceInstance155_PortMapping: port-prototype=ota_node_libExecutable16Prototype.IflytekDiskSpaceInfoPhmBOta, process=ota_node_libProcessDesign16, service-instance=IflytekDiskSpaceInfoPhmBOta_DdsRequiredOtaNode
    IflytekDiskCleanRequest_DdsProvidedServiceInstance48_PortMapping: port-prototype=ota_node_libExecutable16Prototype.IflytekDiskCleanRequest, process=ota_node_libProcessDesign16, service-instance=IflytekDiskCleanRequest_DdsProvidedOtaNode
    RPortPrototype1_DdsRequiredServiceInstance156_PortMapping: port-prototype=soc_a_phm_libExecutable18Prototype.IflytekDiskCleanRequest, process=soc_a_phm_libProcessDesign18, service-instance=IflytekDiskCleanRequest_DdsRequiredSocAPhm
    RPortPrototype1_DdsRequiredServiceInstance157_PortMapping: port-prototype=soc_b_phm_libExecutable17Prototype.IflytekDiskCleanRequest, process=soc_b_phm_libProcessDesign17, service-instance=IflytekDiskCleanRequest_DdsRequiredSocBPhm
    IflytekDiskStatePhmAFdl_DdsProvidedServiceInstance49_PortMapping: port-prototype=soc_a_phm_libExecutable18Prototype.IflytekDiskStatePhmAFdl, process=soc_a_phm_libProcessDesign18, service-instance=IflytekDiskStatePhmAFdl_DdsProvidedSocAPhm
    RPortPrototype1_DdsRequiredServiceInstance158_PortMapping: port-prototype=function_data_loop_libExecutable16Prototype.IflytekDiskStatePhmAFdl, process=function_data_loop_libProcessDesign16, service-instance=IflytekDiskStatePhmAFdl_DdsRequiredFunctionDataLoop
    IflytekDiskCleanRequestPhmAFdl_DdsProvidedServiceInstance50_PortMapping: port-prototype=soc_a_phm_libExecutable18Prototype.IflytekDiskCleanRequestPhmAFdl, process=soc_a_phm_libProcessDesign18, service-instance=IflytekDiskCleanRequestPhmAFdl_DdsProvidedSocAPhm
    RPortPrototype1_DdsRequiredServiceInstance159_PortMapping: port-prototype=function_data_loop_libExecutable16Prototype.IflytekDiskCleanRequestPhmAFdl, process=function_data_loop_libProcessDesign16, service-instance=IflytekDiskCleanRequestPhmAFdl_DdsRequiredFunctionDataLoop
    IflytekDiskStatePhmBFdl_DdsProvidedServiceInstance51_PortMapping: port-prototype=soc_b_phm_libExecutable17Prototype.IflytekDiskStatePhmBFdl, process=soc_b_phm_libProcessDesign17, service-instance=IflytekDiskStatePhmBFdl_DdsProvidedSocBPhm
    RPortPrototype1_DdsRequiredServiceInstance160_PortMapping: port-prototype=function_data_loop_libExecutable16Prototype.IflytekDiskStatePhmBFdl, process=function_data_loop_libProcessDesign16, service-instance=IflytekDiskStatePhmBFdl_DdsRequiredFunctionDataLoop
    IflytekDiskCleanRequestPhmBFdl_DdsProvidedServiceInstance52_PortMapping: port-prototype=soc_b_phm_libExecutable17Prototype.IflytekDiskCleanRequestPhmBFdl, process=soc_b_phm_libProcessDesign17, service-instance=IflytekDiskCleanRequestPhmBFdl_DdsProvidedSocBPhm
    RPortPrototype1_DdsRequiredServiceInstance161_PortMapping: port-prototype=function_data_loop_libExecutable16Prototype.IflytekDiskCleanRequestPhmBFdl, process=function_data_loop_libProcessDesign16, service-instance=IflytekDiskCleanRequestPhmBFdl_DdsRequiredFunctionDataLoop
    IflytekSystemBProcessLoading_DdsProvidedServiceInstance53_PortMapping: port-prototype=system_monitor_b_libExecutable19Prototype.IflytekSystemBProcessLoading, process=system_monitor_b_libProcessDesign19, service-instance=IflytekSystemBProcessLoading_DdsProvidedSystemMonitorB
    RPortPrototype1_DdsRequiredServiceInstance162_PortMapping: port-prototype=function_data_loop_libExecutable16Prototype.IflytekSystemBProcessLoading, process=function_data_loop_libProcessDesign16, service-instance=IflytekSystemBProcessLoading_DdsRequiredFunctionDataLoop
    IflytekSystemAProcessLoading_DdsProvidedServiceInstance54_PortMapping: port-prototype=system_monitor_a_libExecutable21Prototype.IflytekSystemAProcessLoading, process=system_monitor_a_libProcessDesign21, service-instance=IflytekSystemAProcessLoading_DdsProvidedSystemMonitorA
    RPortPrototype1_DdsRequiredServiceInstance163_PortMapping: port-prototype=function_data_loop_a_libExecutable16Prototype.IflytekSystemAProcessLoading, process=function_data_loop_a_libProcessDesign16, service-instance=IflytekSystemAProcessLoading_DdsRequiredFunctionDataLoopA
    RPortPrototype1_DdsRequiredServiceInstance164_PortMapping: port-prototype=soc_b_phm_libExecutable17Prototype.IflytekCalibrationPhmReport, process=soc_b_phm_libProcessDesign17, service-instance=IflytekCalibrationPhmReport_DdsRequiredSocBPhm
    IflytekFdlPhmReport_DdsProvidedServiceInstance55_PortMapping: port-prototype=function_data_loop_libExecutable16Prototype.IflytekFdlPhmReport, process=function_data_loop_libProcessDesign16, service-instance=IflytekFdlPhmReport_DdsProvidedFunctionDataLoop
    RPortPrototype1_DdsRequiredServiceInstance165_PortMapping: port-prototype=soc_b_phm_libExecutable17Prototype.IflytekFdlPhmReport, process=soc_b_phm_libProcessDesign17, service-instance=IflytekFdlPhmReport_DdsRequiredSocBPhm
    IflytekFdlAPhmReport_DdsProvidedServiceInstance56_PortMapping: port-prototype=function_data_loop_a_libExecutable16Prototype.IflytekFdlAPhmReport, process=function_data_loop_a_libProcessDesign16, service-instance=IflytekFdlAPhmReport_DdsProvidedFunctionDataLoopA
    RPortPrototype1_DdsRequiredServiceInstance166_PortMapping: port-prototype=soc_a_phm_libExecutable18Prototype.IflytekFdlAPhmReport, process=soc_a_phm_libProcessDesign18, service-instance=IflytekFdlAPhmReport_DdsRequiredSocAPhm
    RPortPrototype1_DdsRequiredServiceInstance167_PortMapping: port-prototype=function_data_loop_libExecutable16Prototype.IflytekCalibrationDebugInfo, process=function_data_loop_libProcessDesign16, service-instance=IflytekCalibrationDebugInfo_DdsRequiredFunctionDataLoop
    IflytekEhpPhmReport_DdsProvidedServiceInstance53_PortMapping: port-prototype=ehp_libExecutable13Prototype.IflytekEhpPhmReport, process=ehp_libProcessDesign13, service-instance=IflytekEhpPhmReport_DdsProvidedEhp
    RPortPrototype1_DdsRequiredServiceInstance160_PortMapping: port-prototype=soc_a_phm_libExecutable18Prototype.IflytekEhpPhmReport, process=soc_a_phm_libProcessDesign18, service-instance=IflytekEhpPhmReport_DdsRequiredSocAPhm
    IflytekAlarmInfoEhp_ProvidedSomeipServiceInstance33_PortMapping: port-prototype=fm_a_service_libExecutable10Prototype.IflytekAlarmInfoEhp, process=fm_a_service_libProcessDesign10, service-instance=IflytekAlarmInfoEhp_ProvidedSomeipFmAService
    RPortPrototype1_RequiredSomeipServiceInstance32_PortMapping: port-prototype=ehp_libExecutable13Prototype.IflytekAlarmInfoEhp, process=ehp_libProcessDesign13, service-instance=IflytekAlarmInfoEhp_RequiredSomeipEhp
    IflytekEhpParkingMap_DdsProvidedServiceInstance54_PortMapping: port-prototype=ehp_libExecutable13Prototype.IflytekEhpParkingMap, process=ehp_libProcessDesign13, service-instance=IflytekEhpParkingMap_DdsProvidedEhp
    RPortPrototype1_DdsRequiredServiceInstance161_PortMapping: port-prototype=ehp_libExecutable13Prototype.IflytekLocalizationSemanticInfo, process=ehp_libProcessDesign13, service-instance=IflytekLocalizationSemanticInfo_DdsRequiredEhp
    RPortPrototype1_DdsRequiredServiceInstance162_PortMapping: port-prototype=function_data_loop_libExecutable16Prototype.IflytekEhpParkingMap, process=function_data_loop_libProcessDesign16, service-instance=IflytekEhpParkingMap_DdsRequiredFunctionDataLoop
    IflytekEhpParkingMapFileInfo_DdsProvidedServiceInstance55_PortMapping: port-prototype=ehp_libExecutable13Prototype.IflytekEhpParkingMapFileInfo, process=ehp_libProcessDesign13, service-instance=IflytekEhpParkingMapFileInfo_DdsProvidedEhp
    RPortPrototype1_DdsRequiredServiceInstance163_PortMapping: port-prototype=mega_libExecutable6Prototype.IflytekEhpParkingMapFileInfo, process=mega_libProcessDesign6, service-instance=IflytekEhpParkingMapFileInfo_DdsRequiredMega
    RPortPrototype1_DdsRequiredServiceInstance164_PortMapping: port-prototype=function_data_loop_libExecutable16Prototype.IflytekEhpParkingMapFileInfo, process=function_data_loop_libProcessDesign16, service-instance=IflytekEhpParkingMapFileInfo_DdsRequiredFunctionDataLoop
    IflytekEhpMapManager_DdsProvidedServiceInstance56_PortMapping: port-prototype=ehp_libExecutable13Prototype.IflytekEhpMapManager, process=ehp_libProcessDesign13, service-instance=IflytekEhpMapManager_DdsProvidedEhp
    RPortPrototype1_DdsRequiredServiceInstance165_PortMapping: port-prototype=function_data_loop_libExecutable16Prototype.IflytekEhpMapManager, process=function_data_loop_libProcessDesign16, service-instance=IflytekEhpMapManager_DdsRequiredFunctionDataLoop
    RPortPrototype1_DdsRequiredServiceInstance166_PortMapping: port-prototype=ehp_libExecutable13Prototype.IflytekMegaMappingStatus, process=ehp_libProcessDesign13, service-instance=IflytekMegaMappingStatus_DdsRequiredEhp
    RPortPrototype1_DdsRequiredServiceInstance167_PortMapping: port-prototype=ehp_libExecutable13Prototype.IflytekSensorGnss, process=ehp_libProcessDesign13, service-instance=IflytekSensorGnss_DdsRequiredEhp
    RPortPrototype1_DdsRequiredServiceInstance168_PortMapping: port-prototype=ehp_libExecutable13Prototype.IflytekFsmSocState, process=ehp_libProcessDesign13, service-instance=IflytekFsmSocState_DdsRequiredEhp
    RPortPrototype1_DdsRequiredServiceInstance169_PortMapping: port-prototype=fm_a_service_libExecutable10Prototype.IflytekDiskSpaceInfoPhmAOta, process=fm_a_service_libProcessDesign10, service-instance=IflytekDiskSpaceInfoPhmAOta_DdsRequiredFmAService
    RPortPrototype1_DdsRequiredServiceInstance170_PortMapping: port-prototype=fm_a_service_libExecutable10Prototype.IflytekDiskSpaceInfoPhmBOta, process=fm_a_service_libProcessDesign10, service-instance=IflytekDiskSpaceInfoPhmBOta_DdsRequiredFmAService
    IflytekObdUpdateEvent_ProvidedSomeipServiceInstance34_PortMapping: port-prototype=ota_node_libExecutable16Prototype.IflytekObdUpdateEvent, process=ota_node_libProcessDesign16, service-instance=IflytekObdUpdateEvent_ProvidedSomeipOtaNode
    RPortPrototype1_RequiredSomeipServiceInstance33_PortMapping: port-prototype=fm_a_service_libExecutable10Prototype.IflytekObdUpdateEvent, process=fm_a_service_libProcessDesign10, service-instance=IflytekObdUpdateEvent_RequiredSomeipFmAService
    IflytekOtaLogUploadRequest_ProvidedSomeipServiceInstance35_PortMapping: port-prototype=function_data_loop_libExecutable16Prototype.IflytekOtaLogUploadRequest, process=function_data_loop_libProcessDesign16, service-instance=IflytekOtaLogUploadRequest_ProvidedSomeipFunctionDataLoop
    RPortPrototype1_RequiredSomeipServiceInstance34_PortMapping: port-prototype=ota_node_libExecutable16Prototype.IflytekOtaLogUploadRequest, process=ota_node_libProcessDesign16, service-instance=IflytekOtaLogUploadRequest_RequiredSomeipOtaNode
    RPortPrototype1_DdsRequiredServiceInstance171_PortMapping: port-prototype=fm_a_service_libExecutable10Prototype.IflytekCalibrationCalibInfo, process=fm_a_service_libProcessDesign10, service-instance=IflytekCalibrationCalibInfo_DdsRequiredFmAService
    RPortPrototype1_DdsRequiredServiceInstance172_PortMapping: port-prototype=function_data_loop_libExecutable16Prototype.IflytekSystemAProcessLoading, process=function_data_loop_libProcessDesign16, service-instance=IflytekSystemAProcessLoading_DdsRequiredFunctionDataLoop
    RPortPrototype1_DdsRequiredServiceInstance172_PortMapping: port-prototype=hmi_service_libExecutable1Prototype.IflytekLocalizationEgomotion, process=hmi_service_libProcessDesign1, service-instance=IflytekLocalizationEgomotion_DdsRequiredServiceHmiService
    IflytekCameraPerceptionDrivableSpaceGrid_DdsProvidedServiceInstance56_PortMapping: port-prototype=panorama_view_camera_perception_laneline_libExecutable7Prototype.IflytekCameraPerceptionDrivableSpaceGrid, process=panorama_view_camera_perception_laneline_libProcessDesign7, service-instance=IflytekCameraPerceptionDrivableSpaceGrid_DdsProvidedPanoramaViewCameraPerceptionLaneline
    RPortPrototype1_DdsRequiredServiceInstance171_PortMapping: port-prototype=hmi_service_libExecutable1Prototype.IflytekCameraPerceptionDrivableSpaceGrid, process=hmi_service_libProcessDesign1, service-instance=IflytekCameraPerceptionDrivableSpaceGrid_DdsRequiredHmiService
    RPortPrototype1_DdsRequiredServiceInstance172_PortMapping: port-prototype=function_data_loop_libExecutable16Prototype.IflytekCameraPerceptionDrivableSpaceGrid, process=function_data_loop_libProcessDesign16, service-instance=IflytekCameraPerceptionDrivableSpaceGrid_DdsRequiredFunctionDataLoop
    RPortPrototype1_DdsRequiredServiceInstance172_PortMapping: port-prototype=panorama_view_camera_perception_laneline_libExecutable7Prototype.IflytekCameraPerceptionObstacleFeature, process=panorama_view_camera_perception_laneline_libProcessDesign7, service-instance=IflytekCameraPerceptionObstacleFeature_DdsRequiredPanoramaViewCameraPerceptionLaneline
    RPortPrototype1_DdsRequiredServiceInstance173_PortMapping: port-prototype=panorama_view_camera_perception_laneline_libExecutable7Prototype.IflytekCameraPerceptionLaneFeature, process=panorama_view_camera_perception_laneline_libProcessDesign7, service-instance=IflytekCameraPerceptionLaneFeature_DdsRequiredPanoramaViewCameraPerceptionLaneline
    RPortPrototype1_DdsRequiredServiceInstance174_PortMapping: port-prototype=sdmap_libExecutable3Prototype.IflytekSensorGnss, process=sdmap_libProcessDesign3, service-instance=IflytekSensorGnss_DdsRequiredSdmap
    IflytekEhpParkingMapToHmi_DdsProvidedServiceInstance57_PortMapping: port-prototype=ehp_libExecutable13Prototype.IflytekEhpParkingMapToHmi, process=ehp_libProcessDesign13, service-instance=IflytekEhpParkingMapToHmi_DdsProvidedEhp
    RPortPrototype1_DdsRequiredServiceInstance175_PortMapping: port-prototype=hmi_service_libExecutable1Prototype.IflytekEhpParkingMapToHmi, process=hmi_service_libProcessDesign1, service-instance=IflytekEhpParkingMapToHmi_DdsRequiredHmiService
    RPortPrototype1_DdsRequiredServiceInstance176_PortMapping: port-prototype=function_data_loop_libExecutable16Prototype.IflytekEhpParkingMapToHmi, process=function_data_loop_libProcessDesign16, service-instance=IflytekEhpParkingMapToHmi_DdsRequiredFunctionDataLoop
    RPortPrototype1_DdsRequiredServiceInstance177_PortMapping: port-prototype=function_data_loop_libExecutable16Prototype.IflytekCanTxInfo, process=function_data_loop_libProcessDesign16, service-instance=IflytekCanTxInfo_DdsRequiredFunctionDataLoop
package /HuaweiMDC/Common/Common
  composition sw component type hmi_service_libCompositionSwComponentType1
    component hmi_service_libPrototype: type=hmi_service_lib
  composition sw component type radar_4d_service_libCompositionSwComponentType2
    component radar_4d_service_libPrototype: type=radar_4d_service_lib
  composition sw component type sdmap_libCompositionSwComponentType3
    component sdmap_libPrototype: type=sdmap_lib
  composition sw component type mega_libCompositionSwComponentType5
    component mega_libPrototype: type=mega_lib
  composition sw component type panorama_view_camera_perception_laneline_libCompositionSwComponentType6
    component panorama_view_camera_perception_laneline_libPrototype: type=panorama_view_camera_perception_laneline_lib
  composition sw component type around_view_camera_perception_libCompositionSwComponentType7
    component around_view_camera_perception_libPrototype: type=around_view_camera_perception_lib
  composition sw component type fm_a_service_libCompositionSwComponentType9
    component fm_a_service_libPrototype: type=fm_a_service_lib
  composition sw component type fm_b_service_libCompositionSwComponentType9
    component fm_b_service_libPrototype: type=fm_b_service_lib
  composition sw component type mdc_a_fm_libCompositionSwComponentType11
    component mdc_a_fm_libPrototype: type=mdc_a_fm_lib
  composition sw component type mdc_b_fm_libCompositionSwComponentType12
    component mdc_b_fm_libPrototype: type=mdc_b_fm_lib
  composition sw component type ehp_libCompositionSwComponentType12
    component ehp_libPrototype: type=ehp_lib
  composition sw component type factory_calibration_libCompositionSwComponentType13
    component factory_calibration_libPrototype: type=factory_calibration_lib
  composition sw component type ota_node_libCompositionSwComponentType15
    component ota_node_libPrototype: type=ota_node_lib
  composition sw component type function_data_loop_libCompositionSwComponentType15
    component function_data_loop_libPrototype: type=function_data_loop_lib
  composition sw component type function_data_loop_a_libCompositionSwComponentType15
    component function_data_loop_a_libPrototype: type=function_data_loop_a_lib
  composition sw component type soc_b_phm_libCompositionSwComponentType16
    component soc_b_phm_libPrototype: type=soc_b_phm_lib
  composition sw component type soc_a_phm_libCompositionSwComponentType17
    component soc_a_phm_libPrototype: type=soc_a_phm_lib
  composition sw component type system_monitor_b_libCompositionSwComponentType18
    component system_monitor_b_libPrototype: type=system_monitor_b_lib
  composition sw component type system_monitor_a_libCompositionSwComponentType20
    component system_monitor_a_libPrototype: type=system_monitor_a_lib
package /HuaweiMDC/instance_manifests/providedInstances
  6 x dds provided service instance, all with service-interface-deployment=StructContainerDdsInterfaceDeployment, domain-id=30, transport-plugins=FSHM, dds-event-qos-props=eventDdsDeployment:
    IflytekSdmapSdmapInfo_DdsProvidedServiceInstance4: qos-profile=large_buffer_qos.xml, service-instance-id=10012
    IflytekMegaLocalMap_DdsProvidedServiceInstance5: qos-profile=customized_qos.xml, service-instance-id=10015
    IflytekCameraPerceptionLaneLines_DdsProvidedServiceInstance7: qos-profile=customized_qos.xml, service-instance-id=10069
    IflytekCameraPerception3dGeneralObjects_DdsProvidedServiceInstance8: qos-profile=customized_qos.xml, service-instance-id=10043
    IflytekCameraPerceptionOccupancyObjects_DdsProvidedServiceInstance9: qos-profile=large_buffer_qos.xml, service-instance-id=10044
    IflytekCameraPerceptionLaneTopo_DdsProvidedServiceInstance10: qos-profile=customized_qos.xml, service-instance-id=10073
  13 x provided someip service instance, all with service-interface-deployment=FmAlarmReceiveServiceDeployment:
    IflytekAlarmInfoCameraNodeAroundView_ProvidedSomeipFmAService: service-instance-id=10002
    IflytekAlarmInfoSdmap_ProvidedSomeipServiceInstance2: service-instance-id=10003
    IflytekAlarmInfoAroundViewCameraPerception_ProvidedSomeipFmAService: service-instance-id=10004
    IflytekAlarmInfoSocACommunication_ProvidedSomeipFmAService: service-instance-id=10005
    IflytekAlarmInfoPanoramaViewCameraPerceptionLaneline_ProvidedSomeipFmAService: service-instance-id=10006
    IflytekAlarmInfoGnssServiceNode_ProvidedSomeipServiceInstance6: service-instance-id=10007
    IflytekAlarmInfoEhr_ProvidedSomeipServiceInstance7: service-instance-id=10008
    IflytekAlarmInfoLocalization_ProvidedSomeipServiceInstance9: service-instance-id=10010
    IflytekAlarmInfoSocBCommunication_ProvidedSomeipServiceInstance10: service-instance-id=10011
    IflytekAlarmInfoCameraNodePanoramaView_ProvidedSomeipServiceInstance16: service-instance-id=10017
    IflytekAlarmInfoPanoramaViewCameraPerception_ProvidedSomeipServiceInstance17: service-instance-id=10018
    IflytekAlarmInfoHmiService_ProvidedSomeipServiceInstance22: service-instance-id=10023
    IflytekAlarmInfoMdcB_ProvidedSomeipServiceInstance27: service-instance-id=2
  5 x dds provided service instance, all with service-interface-deployment=StructContainerDdsInterfaceDeployment, domain-id=30, transport-plugins=FSHM, dds-event-qos-props=eventDdsDeployment:
    IflytekHmiInner_DdsProvidedHmiService: qos-profile=small_buffer_qos.xml, service-instance-id=10007
    IflytekCameraPerceptionParkingSlotList_DdsProvidedServiceInstance11: qos-profile=default_qos.xml, service-instance-id=10014
    IflytekCameraPerceptionGroundLine_DdsProvidedServiceInstance12: qos-profile=customized_qos.xml, service-instance-id=10065
    IflytekCameraPerceptionParkingLaneLine_DdsProvidedServiceInstance13: qos-profile=customized_qos.xml, service-instance-id=10074
    IflytekCameraPerceptionDeceler_DdsProvidedServiceInstance14: qos-profile=small_buffer_qos.xml, service-instance-id=10079
  provided someip service instance IflytekAlarmInfoMega_ProvidedSomeipFmAService: service-interface-deployment=FmAlarmReceiveServiceDeployment, service-instance-id=10026
  provided someip service instance IflytekAlarmInfoStaticFusion_ProvidedSomeipFmAService: service-interface-deployment=FmAlarmReceiveServiceDeployment, service-instance-id=10015
  dds provided service instance IflytekMegaMappingStatus_DdsProvidedMega: service-interface-deployment=StructContainerDdsInterfaceDeployment, qos-profile=small_buffer_qos.xml, domain-id=30, transport-plugins=FSHM, dds-event-qos-props=eventDdsDeployment, service-instance-id=10090
  dds provided service instance IflytekRadarFmPerception4dTarget_DdsProvidedServiceInstance19: service-interface-deployment=StructContainerDdsInterfaceDeployment, qos-profile=small_buffer_qos.xml, domain-id=30, transport-plugins=FSHM, dds-event-qos-props=eventDdsDeployment, service-instance-id=10084
  provided someip service instance IflytekFactoryCalibrationActivation_ProvidedSomeipServiceInstance28: service-interface-deployment=ClientServiceContainerInterfaceDeployment, service-instance-id=10029
    someip provided event group eventGroup1: event-group=SomeipEventGroup
  provided someip service instance IflytekFactoryCalibrationResult_ProvidedSomeipServiceInstance29: service-interface-deployment=ClientServiceContainerInterfaceDeployment, service-instance-id=10030
    someip provided event group eventGroup1: event-group=SomeipEventGroup
  provided someip service instance IflytekStateManager_ProvidedSomeipMdcAFm: service-interface-deployment=TriggerInOutDeployment, service-instance-id=1
    someip provided event group eventGroup1: event-group=NotifierSomeipEventGroup
  dds provided service instance IflytekAlarmInfoSoc_DdsProvidedServiceInstance23: service-interface-deployment=StructContainerDdsInterfaceDeployment, qos-profile=small_buffer_qos.xml, domain-id=30, transport-plugins=FSHM, dds-event-qos-props=eventDdsDeployment, service-instance-id=10057
  dds provided service instance IflytekRadarFmPerception4dPointCloud_DdsProvidedServiceInstance24: service-interface-deployment=StructContainerDdsInterfaceDeployment, qos-profile=customized_qos.xml, domain-id=30, transport-plugins=FSHM, dds-event-qos-props=eventDdsDeployment, service-instance-id=10010
  provided someip service instance IflytekAlarmInfoRadar4dService_ProvidedSomeipServiceInstance32: service-interface-deployment=FmAlarmReceiveServiceDeployment, service-instance-id=10012
  dds provided service instance IflytekCameraPerceptionObjects_DdsProvidedServiceInstance26: service-interface-deployment=StructContainerDdsInterfaceDeployment, qos-profile=customized_qos.xml, domain-id=30, transport-plugins=FSHM, dds-event-qos-props=eventDdsDeployment, service-instance-id=10025
  provided someip service instance IflytekConfigManager_ProvidedSomeipMdcAFm: service-interface-deployment=ConfigServerSomeipServiceInterfaceDeployment, service-instance-id=1
    someip provided event group eventGroup1: event-group=ParamUpdateEventGroup
    someip provided event group eventGroup2: event-group=ServerNotifyEventGroup
  provided someip service instance IflytekAlarmInfoCalibration_ProvidedSomeipServiceInstance22: service-interface-deployment=FmAlarmReceiveServiceDeployment, service-instance-id=10009
  dds provided service instance IflytekFmMcuInfo_DdsProvidedFmAService: service-interface-deployment=StructContainerDdsInterfaceDeployment, qos-profile=small_buffer_qos.xml, domain-id=30, transport-plugins=FSHM, dds-event-qos-props=eventDdsDeployment, service-instance-id=10060
  dds provided service instance IflytekHmiSocToMcuBsw_DdsProvidedHmiService: service-interface-deployment=StructContainerDdsInterfaceDeployment, qos-profile=default_qos.xml, domain-id=30, transport-plugins=FSHM, dds-event-qos-props=eventDdsDeployment, service-instance-id=10075
  provided someip service instance IflytekAlarmInfoComServicePncNode_ProvidedSomeipFmAService: service-interface-deployment=FmAlarmReceiveServiceDeployment, service-instance-id=10020
  dds provided service instance IflytekPredictionPredictionResult_DdsProvidedServiceInstance24: service-interface-deployment=StructContainerDdsInterfaceDeployment, qos-profile=customized_qos.xml, domain-id=30, transport-plugins=FSHM, dds-event-qos-props=eventDdsDeployment, service-instance-id=10029
  7 x provided someip service instance, all with service-interface-deployment=FmAlarmReceiveServiceDeployment:
    IflytekAlarmInfoObstacleFusion_ProvidedSomeipFmAService: service-instance-id=10021
    IflytekAlarmInfoPlanning_ProvidedSomeipFmAService: service-instance-id=10022
    IflytekAlarmInfoOtaNode_ProvidedSomeipFmAService: service-instance-id=10024
    IflytekAlarmInfoControl_ProvidedSomeipFmAService: service-instance-id=10025
    IflytekAlarmInfoMdcA_ProvidedSomeipFmAService: service-instance-id=1
    IflytekAlarmInfoFiniteStateManager_ProvidedSomeipServiceInstance29: service-instance-id=10031
    IflytekAlarmInfoFdl_ProvidedSomeipServiceInstance30: service-instance-id=10036
  14 x dds provided service instance, all with service-interface-deployment=StructContainerDdsInterfaceDeployment, domain-id=30, transport-plugins=FSHM, dds-event-qos-props=eventDdsDeployment:
    IflytekAlarmInfoFmAService_DdsProvidedFmAService: qos-profile=small_buffer_qos.xml, service-instance-id=10155
    IflytekDTCInfoFmAService_DdsProvidedFmAService: qos-profile=default_qos.xml, service-instance-id=10156
    IflytekAlarmInfoToBCamera_DdsProvidedFmBService: qos-profile=small_buffer_qos.xml, service-instance-id=10108
    IflytekAlarmInfoToACamera_DdsProvidedFmAService: qos-profile=small_buffer_qos.xml, service-instance-id=10109
    IflytekFdlTrigger_DdsProvidedFunctionDataLoopB: qos-profile=small_buffer_qos.xml, service-instance-id=10161
    IflytekFdlTriggerAck_DdsProvidedFunctionDataLoopA: qos-profile=small_buffer_qos.xml, service-instance-id=10163
    IflytekFmAMcuSentinel_DdsProvidedFmAService: qos-profile=small_buffer_qos.xml, service-instance-id=10166
    IflytekFmACameraSentinel_DdsProvidedFmAService: qos-profile=default_qos.xml, service-instance-id=10168
    IflytekRadarPerception4dTargetMcu_DdsProvidedServiceInstance32: qos-profile=default_qos.xml, service-instance-id=10179
    IflytekEngineerInner_DdsProvidedHmiService: qos-profile=small_buffer_qos.xml, service-instance-id=10181
    IflytekFmAMcuDegradeFunciton_DdsProvidedServiceInstance34: qos-profile=default_qos.xml, service-instance-id=10183
    IflytekFmADegradeFunciton_DdsProvidedServiceInstance35: qos-profile=small_buffer_qos.xml, service-instance-id=10184
    IflytekCameraPerceptionPanoramaView2DBoundingBoxes_DdsProvidedServiceInstance36: qos-profile=default_qos.xml, service-instance-id=10186
    IflytekCameraPerceptionAroundView2DBoundingBoxes_DdsProvidedServiceInstance37: qos-profile=customized_qos.xml, service-instance-id=10188
  provided someip service instance IflytekAlarmInfoPhmB_ProvidedSomeipFmBService: service-interface-deployment=FmAlarmReceiveServiceDeployment, service-instance-id=10040
  5 x dds provided service instance, all with service-interface-deployment=StructContainerDdsInterfaceDeployment, qos-profile=small_buffer_qos.xml, domain-id=30, transport-plugins=FSHM, dds-event-qos-props=eventDdsDeployment:
    IflytekHmiPhmReport_DdsProvidedHmiService: service-instance-id=10198
    Iflytek4dRadarPhmReport_DdsProvidedRadar4dService: service-instance-id=10199
    IflytekCameraPerceptionPanoramaLanelinePhmReport_DdsProvidedPanoramaViewCameraPerceptionLaneline: service-instance-id=10203
    IflytekCameraPerceptionAroundPhmReport_DdsProvidedAroundViewCameraPerception: service-instance-id=10207
    IflytekMegaPhmReport_DdsProvidedMega: service-instance-id=10209
  provided someip service instance IflytekAlarmInfoPhmA_ProvidedSomeipFmAService: service-interface-deployment=FmAlarmReceiveServiceDeployment, service-instance-id=10041
  dds provided service instance IflytekCameraPerception3dOccupancyObjects_DdsProvidedServiceInstance44: service-interface-deployment=StructContainerDdsInterfaceDeployment, qos-profile=large_buffer_qos.xml, domain-id=30, transport-plugins=FSHM, dds-event-qos-props=eventDdsDeployment, service-instance-id=10212
  dds provided service instance IflytekFdlUploadState_DdsProvidedFunctionDataLoop: service-interface-deployment=StructContainerDdsInterfaceDeployment, qos-profile=small_buffer_qos.xml, domain-id=30, transport-plugins=FSHM, dds-event-qos-props=eventDdsDeployment, service-instance-id=10154
  provided someip service instance IflytekFdlNetStatCheck_ProvidedSomeipFunctionDataLoop: service-interface-deployment=ClientServiceContainerInterfaceDeployment, service-instance-id=10042
    someip provided event group eventGroup1: event-group=SomeipEventGroup
  12 x dds provided service instance, all with service-interface-deployment=StructContainerDdsInterfaceDeployment, domain-id=30, transport-plugins=FSHM, dds-event-qos-props=eventDdsDeployment:
    IflytekDiskSpaceInfoPhmAOta_DdsProvidedSocAPhm: qos-profile=small_buffer_qos.xml, service-instance-id=10218
    IflytekDiskSpaceInfoPhmBOta_DdsProvidedSocBPhm: qos-profile=default_qos.xml, service-instance-id=10219
    IflytekDiskCleanRequest_DdsProvidedOtaNode: qos-profile=small_buffer_qos.xml, service-instance-id=10221
    IflytekDiskStatePhmAFdl_DdsProvidedSocAPhm: qos-profile=default_qos.xml, service-instance-id=10223
    IflytekDiskCleanRequestPhmAFdl_DdsProvidedSocAPhm: qos-profile=small_buffer_qos.xml, service-instance-id=10225
    IflytekDiskStatePhmBFdl_DdsProvidedSocBPhm: qos-profile=small_buffer_qos.xml, service-instance-id=10227
    IflytekDiskCleanRequestPhmBFdl_DdsProvidedSocBPhm: qos-profile=small_buffer_qos.xml, service-instance-id=10228
    IflytekSystemBProcessLoading_DdsProvidedSystemMonitorB: qos-profile=default_qos.xml, service-instance-id=10229
    IflytekSystemAProcessLoading_DdsProvidedSystemMonitorA: qos-profile=default_qos.xml, service-instance-id=10230
    IflytekFdlPhmReport_DdsProvidedFunctionDataLoop: qos-profile=small_buffer_qos.xml, service-instance-id=10232
    IflytekFdlAPhmReport_DdsProvidedFunctionDataLoopA: qos-profile=small_buffer_qos.xml, service-instance-id=10233
    IflytekEhpPhmReport_DdsProvidedEhp: qos-profile=small_buffer_qos.xml, service-instance-id=10040
  provided someip service instance IflytekAlarmInfoEhp_ProvidedSomeipFmAService: service-interface-deployment=FmAlarmReceiveServiceDeployment, service-instance-id=10019
  dds provided service instance IflytekEhpParkingMap_DdsProvidedEhp: service-interface-deployment=StructContainerDdsInterfaceDeployment, qos-profile=customized_qos.xml, domain-id=30, transport-plugins=FSHM, dds-event-qos-props=eventDdsDeployment, service-instance-id=10046
  dds provided service instance IflytekEhpParkingMapFileInfo_DdsProvidedEhp: service-interface-deployment=StructContainerDdsInterfaceDeployment, qos-profile=small_buffer_qos.xml, domain-id=30, transport-plugins=FSHM, dds-event-qos-props=eventDdsDeployment, service-instance-id=10114
  dds provided service instance IflytekEhpMapManager_DdsProvidedEhp: service-interface-deployment=StructContainerDdsInterfaceDeployment, qos-profile=small_buffer_qos.xml, domain-id=30, transport-plugins=FSHM, dds-event-qos-props=eventDdsDeployment, service-instance-id=10235
  provided someip service instance IflytekObdUpdateEvent_ProvidedSomeipOtaNode: service-interface-deployment=ClientServiceContainerInterfaceDeployment, service-instance-id=10044
    someip provided event group eventGroup1: event-group=SomeipEventGroup
  provided someip service instance IflytekOtaLogUploadRequest_ProvidedSomeipFunctionDataLoop: service-interface-deployment=ClientServiceContainerInterfaceDeployment, service-instance-id=10045
    someip provided event group eventGroup1: event-group=SomeipEventGroup
  dds provided service instance IflytekCameraPerceptionDrivableSpaceGrid_DdsProvidedPanoramaViewCameraPerceptionLaneline: service-interface-deployment=StructContainerDdsInterfaceDeployment, qos-profile=default_qos.xml, domain-id=30, transport-plugins=FSHM, dds-event-qos-props=eventDdsDeployment, service-instance-id=10101
  dds provided service instance IflytekEhpParkingMapToHmi_DdsProvidedEhp: service-interface-deployment=StructContainerDdsInterfaceDeployment, qos-profile=customized_qos.xml, domain-id=30, transport-plugins=FSHM, dds-event-qos-props=eventDdsDeployment, service-instance-id=10216
