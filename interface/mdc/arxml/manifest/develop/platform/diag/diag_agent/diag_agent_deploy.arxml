AUTOSAR XML (schema 00048)
package /HuaweiMDC/PlatformApplication/DiagAgentApplication/Process
  startup config set ProcessStartupConfigSet
    startup config DiagAgentProcessStartupConfig: scheduling-policy=SCHEDULING-POLICY-ROUND-ROBIN, scheduling-priority=12
