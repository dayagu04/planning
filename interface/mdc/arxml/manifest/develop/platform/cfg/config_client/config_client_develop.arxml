AUTOSAR XML (schema 00048)
package /HuaweiMDC/PlatformApplication/ConfigClientApplication/Execution
  executable config_client
    root sw component prototype config_client: application-type=config_client
package /HuaweiMDC/PlatformApplication/ConfigClientApplication/SwComponent
  adaptive application sw component type config_client
    require port ConfigAppFromServerRPort
