AUTOSAR XML (schema 00048)
package /HuaweiMDC/FunctionalSoftware/NavigationApplication/SwComponent
  adaptive application sw component type navigation
    require port NavigationLocationPointRPort
    provide port NavigationNavigationResultPPort
    require port NavigationSelectPointRPort
