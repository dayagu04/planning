[part 3 of 3: packages /HuaweiMDC/instance_manifests/providedInstances to /serviceInterface]
AUTOSAR XML (schema 00048)
package /HuaweiMDC/instance_manifests/providedInstances
  22 x dds provided service instance, all with domain-id=30:
    IflytekFusionRoadFusion_compress_DdsProvidedServiceInstance5: service-interface-deployment=StructContainerDdsInterfaceDeployment, qos-profile=small_buffer_qos.xml, transport-plugins=FSHM, dds-event-qos-props=eventDdsDeployment, service-instance-id=10004
    IflytekFusionParkingSlot_DdsProvidedServiceInstance6: service-interface-deployment=StructContainerDdsInterfaceDeployment, qos-profile=small_buffer_qos.xml, transport-plugins=FSHM, dds-event-qos-props=eventDdsDeployment, service-instance-id=10005
    IflytekLocalizationEgomotion_DdsProvidedLocalization: service-interface-deployment=StructContainerDdsInterfaceDeployment, qos-profile=small_buffer_qos.xml, transport-plugins=FSHM, dds-event-qos-props=eventDdsDeployment, service-instance-id=10016
    IflytekSensorCameraPanoramaImageFront_DdsProvidedServiceInstance51: service-interface-deployment=CameraStructContainerDdsInterfaceDeployment, qos-profile=small_buffer_qos.xml, transport-plugins=NDSHM, dds-event-qos-props=DdsEventDeployment, service-instance-id=10050
    IflytekSensorCameraPanoramaImageFl_DdsProvidedServiceInstance52: service-interface-deployment=CameraStructContainerDdsInterfaceDeployment, qos-profile=small_buffer_qos.xml, transport-plugins=NDSHM, dds-event-qos-props=DdsEventDeployment, service-instance-id=10051
    IflytekSensorCameraPanoramaImageFr_DdsProvidedServiceInstance53: service-interface-deployment=CameraStructContainerDdsInterfaceDeployment, qos-profile=small_buffer_qos.xml, transport-plugins=NDSHM, dds-event-qos-props=DdsEventDeployment, service-instance-id=10052
    IflytekSensorCameraPanoramaImageRl_DdsProvidedServiceInstance54: service-interface-deployment=CameraStructContainerDdsInterfaceDeployment, qos-profile=small_buffer_qos.xml, transport-plugins=NDSHM, dds-event-qos-props=DdsEventDeployment, service-instance-id=10053
    IflytekSensorCameraPanoramaImageRr_DdsProvidedServiceInstance55: service-interface-deployment=CameraStructContainerDdsInterfaceDeployment, qos-profile=small_buffer_qos.xml, transport-plugins=NDSHM, dds-event-qos-props=DdsEventDeployment, service-instance-id=10054
    IflytekSensorCameraRear_DdsProvidedServiceInstance56: service-interface-deployment=CameraStructContainerDdsInterfaceDeployment, qos-profile=small_buffer_qos.xml, transport-plugins=NDSHM, dds-event-qos-props=DdsEventDeployment, service-instance-id=10055
    IflytekSensorGnss_DdsProvidedGnssServiceNode: service-interface-deployment=StructContainerDdsInterfaceDeployment, qos-profile=small_buffer_qos.xml, transport-plugins=FSHM, dds-event-qos-props=eventDdsDeployment, service-instance-id=10056
    struct_container_DdsProvidedServiceInstance62: service-interface-deployment=StructContainerDdsInterfaceDeployment, qos-profile=default_qos.xml, transport-plugins=FSHM, dds-event-qos-props=eventDdsDeployment, service-instance-id=10061
    struct_container_DdsProvidedServiceInstance63: service-interface-deployment=StructContainerDdsInterfaceDeployment, qos-profile=default_qos.xml, transport-plugins=FSHM, dds-event-qos-props=eventDdsDeployment, service-instance-id=10062
    camera_struct_container_DdsProvidedServiceInstance64: service-interface-deployment=CameraStructContainerDdsInterfaceDeployment, qos-profile=default_qos.xml, transport-plugins=FSHM, dds-event-qos-props=DdsEventDeployment, service-instance-id=10063
    camera_struct_container_DdsProvidedServiceInstance65: service-interface-deployment=CameraStructContainerDdsInterfaceDeployment, qos-profile=default_qos.xml, transport-plugins=FSHM, dds-event-qos-props=DdsEventDeployment, service-instance-id=10064
    IflytekSensorCameraFront120_DdsProvidedServiceInstance66: service-interface-deployment=CameraStructContainerDdsInterfaceDeployment, qos-profile=small_buffer_qos.xml, transport-plugins=NDSHM, dds-event-qos-props=DdsEventDeployment, service-instance-id=10045
    IflytekSensorCameraFront120Eagle_DdsProvidedServiceInstance67: service-interface-deployment=CameraStructContainerDdsInterfaceDeployment, qos-profile=small_buffer_qos.xml, transport-plugins=NDSHM, dds-event-qos-props=DdsEventDeployment, service-instance-id=10066
    IflytekEhrSdmapInfo_DdsProvidedServiceInstance59: service-interface-deployment=StructContainerDdsInterfaceDeployment, qos-profile=customized_qos.xml, transport-plugins=FSHM, dds-event-qos-props=eventDdsDeployment, service-instance-id=10013
    IflytekEhrSdmapInfo_DdsProvidedServiceInstance66: service-interface-deployment=StructContainerDdsInterfaceDeployment, qos-profile=customized_qos.xml, transport-plugins=FSHM, dds-event-qos-props=eventDdsDeployment, service-instance-id=10072
    IflytekSensorCameraSurroundResizeImageFront_DdsProvidedServiceInstance61: service-interface-deployment=CameraStructContainerDdsInterfaceDeployment, qos-profile=small_buffer_qos.xml, transport-plugins=NDSHM, dds-event-qos-props=DdsEventDeployment, service-instance-id=10023
    IflytekSensorCameraSurroundResizeImageLeft_DdsProvidedCameraNodeAroundView: service-interface-deployment=CameraStructContainerDdsInterfaceDeployment, qos-profile=small_buffer_qos.xml, transport-plugins=NDSHM, dds-event-qos-props=DdsEventDeployment, service-instance-id=10024
    IflytekSensorCameraSurroundResizeImageRight_DdsProvidedCameraNodeAroundView: service-interface-deployment=CameraStructContainerDdsInterfaceDeployment, qos-profile=small_buffer_qos.xml, transport-plugins=NDSHM, dds-event-qos-props=DdsEventDeployment, service-instance-id=10041
    IflytekSensorCameraSurroundResizeImageRear_DdsProvidedCameraNodeAroundView: service-interface-deployment=CameraStructContainerDdsInterfaceDeployment, qos-profile=small_buffer_qos.xml, transport-plugins=NDSHM, dds-event-qos-props=DdsEventDeployment, service-instance-id=10042
  provided someip service instance alarmInfo_ProvidedSomeipServiceInstance1: service-interface-deployment=FmAlarmReceiveServiceDeployment, service-instance-id=10000
  provided someip service instance alarmInfo_ProvidedSomeipServiceInstance2: service-interface-deployment=FmAlarmReceiveServiceDeployment, service-instance-id=10001
  9 x dds provided service instance, all with domain-id=30:
    IflytekCameraPerceptionTrafficSignRecognition_DdsProvidedServiceInstance68: service-interface-deployment=StructContainerDdsInterfaceDeployment, qos-profile=small_buffer_qos.xml, transport-plugins=FSHM, dds-event-qos-props=eventDdsDeployment, service-instance-id=10067
    IflytekLocalizationEgomotion_DdsProvidedServiceInstance70: service-interface-deployment=StructContainerDdsInterfaceDeployment, qos-profile=small_buffer_qos.xml, transport-plugins=FSHM, dds-event-qos-props=eventDdsDeployment, service-instance-id=10083
    IflytekLocalizationSemanticInfo_DdsProvidedServiceInstance75: service-interface-deployment=StructContainerDdsInterfaceDeployment, qos-profile=small_buffer_qos.xml, transport-plugins=FSHM, dds-event-qos-props=eventDdsDeployment, service-instance-id=10088
    IflytekLocalizationSemanticInfo_DdsProvidedServiceInstance76: service-interface-deployment=StructContainerDdsInterfaceDeployment, qos-profile=small_buffer_qos.xml, transport-plugins=FSHM, dds-event-qos-props=eventDdsDeployment, service-instance-id=10089
    IflytekMegaLocalMap_DdsProvidedServiceInstance78: service-interface-deployment=StructContainerDdsInterfaceDeployment, qos-profile=customized_qos.xml, transport-plugins=FSHM, dds-event-qos-props=eventDdsDeployment, service-instance-id=10092
    IflytekEhrStaticMap_DdsProvidedServiceInstance80: service-interface-deployment=StructContainerDdsInterfaceDeployment, qos-profile=large_buffer_qos.xml, transport-plugins=FSHM, dds-event-qos-props=eventDdsDeployment, service-instance-id=10096
    IflytekEhrStaticMap_DdsProvidedServiceInstance81: service-interface-deployment=StructContainerDdsInterfaceDeployment, qos-profile=large_buffer_qos.xml, transport-plugins=FSHM, dds-event-qos-props=eventDdsDeployment, service-instance-id=10097
    IflytekSensorCameraFront120FullResolutionH265_DdsProvidedServiceInstance87: service-interface-deployment=CameraStructContainerDdsInterfaceDeployment, qos-profile=small_buffer_qos.xml, transport-plugins=NDSHM, dds-event-qos-props=DdsEventDeployment, service-instance-id=10106
    IflytekSensorCameraFront120FullResolutionH265_DdsProvidedServiceInstance88: service-interface-deployment=CameraStructContainerDdsInterfaceDeployment, qos-profile=small_buffer_qos.xml, transport-plugins=NDSHM, dds-event-qos-props=DdsEventDeployment, service-instance-id=10107
  6 x provided someip service instance, all with service-interface-deployment=ClientServiceContainerInterfaceDeployment:
    clientServiceContainer_ProvidedSomeipServiceInstance3: service-instance-id=10027
    clientServiceContainer_ProvidedSomeipServiceInstance4: service-instance-id=10028
    IflytekSensorGetSurroundCameraIntriParam_ProvidedSomeipCameraNodeAroundView: service-instance-id=10032
      someip provided event group eventGroup1: event-group=ClientServiceContainerInterfaceDeployment/SomeipEventGroup
    IflytekSensorGetPanoramaCameraIntriParam_ProvidedSomeipServiceInstance7: service-instance-id=10033
      someip provided event group eventGroup1: event-group=ClientServiceContainerInterfaceDeployment/SomeipEventGroup
    IflytekSensorGetPanoramaCameraIntriParam_ProvidedSomeipServiceInstance8: service-instance-id=10034
      someip provided event group eventGroup1: event-group=ClientServiceContainerInterfaceDeployment/SomeipEventGroup
    IflytekSensorWriteFile_ProvidedSomeipServiceInstance9: service-instance-id=10035
      someip provided event group eventGroup1: event-group=ClientServiceContainerInterfaceDeployment/SomeipEventGroup
  18 x dds provided service instance, all with qos-profile=small_buffer_qos.xml, domain-id=30:
    IflytekAlarmInfoSoc_DdsProvidedServiceInstance93: service-interface-deployment=StructContainerDdsInterfaceDeployment, transport-plugins=FSHM, dds-event-qos-props=eventDdsDeployment, service-instance-id=10027
    IflytekSensorCameraSurroundFrontFullResolutionH265_DdsProvidedCameraNodeAroundView: service-interface-deployment=CameraStructContainerDdsInterfaceDeployment, transport-plugins=NDSHM, dds-event-qos-props=DdsEventDeployment, service-instance-id=10115
    IflytekSensorCameraSurroundLeftFullResolutionH265_DdsProvidedCameraNodeAroundView: service-interface-deployment=CameraStructContainerDdsInterfaceDeployment, transport-plugins=NDSHM, dds-event-qos-props=DdsEventDeployment, service-instance-id=10116
    IflytekSensorCameraSurroundRearFullResolutionH265_DdsProvidedCameraNodeAroundView: service-interface-deployment=CameraStructContainerDdsInterfaceDeployment, transport-plugins=NDSHM, dds-event-qos-props=DdsEventDeployment, service-instance-id=10117
    IflytekSensorCameraSurroundRightFullResolutionH265_DdsProvidedCameraNodeAroundView: service-interface-deployment=CameraStructContainerDdsInterfaceDeployment, transport-plugins=NDSHM, dds-event-qos-props=DdsEventDeployment, service-instance-id=10118
    IflytekSensorCameraFront30FullResolutionH265_DdsProvidedServiceInstance97: service-interface-deployment=CameraStructContainerDdsInterfaceDeployment, transport-plugins=NDSHM, dds-event-qos-props=DdsEventDeployment, service-instance-id=10119
    IflytekSensorCameraSideFlFullResolutionH265_DdsProvidedServiceInstance98: service-interface-deployment=CameraStructContainerDdsInterfaceDeployment, transport-plugins=NDSHM, dds-event-qos-props=DdsEventDeployment, service-instance-id=10120
    IflytekSensorCameraSideFrFullResolutionH265_DdsProvidedServiceInstance99: service-interface-deployment=CameraStructContainerDdsInterfaceDeployment, transport-plugins=NDSHM, dds-event-qos-props=DdsEventDeployment, service-instance-id=10121
    IflytekSensorCameraSideRlFullResolutionH265_DdsProvidedServiceInstance100: service-interface-deployment=CameraStructContainerDdsInterfaceDeployment, transport-plugins=NDSHM, dds-event-qos-props=DdsEventDeployment, service-instance-id=10122
    IflytekSensorCameraSideRrFullResolutionH265_DdsProvidedServiceInstance101: service-interface-deployment=CameraStructContainerDdsInterfaceDeployment, transport-plugins=NDSHM, dds-event-qos-props=DdsEventDeployment, service-instance-id=10123
    IflytekSensorCameraFront30FullResolutionH265_DdsProvidedServiceInstance104: service-interface-deployment=CameraStructContainerDdsInterfaceDeployment, transport-plugins=NDSHM, dds-event-qos-props=DdsEventDeployment, service-instance-id=10126
    IflytekSensorCameraSideFlFullResolutionH265_DdsProvidedServiceInstance105: service-interface-deployment=CameraStructContainerDdsInterfaceDeployment, transport-plugins=NDSHM, dds-event-qos-props=DdsEventDeployment, service-instance-id=10127
    IflytekSensorCameraSideFrFullResolutionH265_DdsProvidedServiceInstance106: service-interface-deployment=CameraStructContainerDdsInterfaceDeployment, transport-plugins=NDSHM, dds-event-qos-props=DdsEventDeployment, service-instance-id=10128
    IflytekSensorCameraSideRlFullResolutionH265_DdsProvidedServiceInstance107: service-interface-deployment=CameraStructContainerDdsInterfaceDeployment, transport-plugins=NDSHM, dds-event-qos-props=DdsEventDeployment, service-instance-id=10129
    IflytekSensorCameraSideRrFullResolutionH265_DdsProvidedServiceInstance108: service-interface-deployment=CameraStructContainerDdsInterfaceDeployment, transport-plugins=NDSHM, dds-event-qos-props=DdsEventDeployment, service-instance-id=10130
    IflytekSensorCameraRearFullResolutionH265MDCA_DdsProvidedCameraNodeAroundView: service-interface-deployment=CameraStructContainerDdsInterfaceDeployment, transport-plugins=NDSHM, dds-event-qos-props=DdsEventDeployment, service-instance-id=10135
    IflytekSensorCameraRearMDCA_DdsProvidedCameraNodeAroundView: service-interface-deployment=CameraStructContainerDdsInterfaceDeployment, transport-plugins=NDSHM, dds-event-qos-props=DdsEventDeployment, service-instance-id=10136
    IflytekSensorCameraRearMDCA_DdsProvidedServiceInstance113: service-interface-deployment=CameraStructContainerDdsInterfaceDeployment, transport-plugins=NDSHM, dds-event-qos-props=DdsEventDeployment, service-instance-id=10137
  provided someip service instance IflytekAlarmInfoMdcB_ProvidedSomeipServiceInstance13: service-interface-deployment=FmAlarmReceiveServiceDeployment, service-instance-id=2
  40 x dds provided service instance, all with domain-id=30:
    IflytekEhrSdpromapInfo_DdsProvidedServiceInstance144: service-interface-deployment=StructContainerDdsInterfaceDeployment, qos-profile=customized_qos.xml, transport-plugins=FSHM, dds-event-qos-props=eventDdsDeployment, service-instance-id=10173
    IflytekEhrSdpromapInfo_DdsProvidedServiceInstance145: service-interface-deployment=StructContainerDdsInterfaceDeployment, qos-profile=customized_qos.xml, transport-plugins=FSHM, dds-event-qos-props=eventDdsDeployment, service-instance-id=10174
    IflytekCameraPerceptionOccGrid_DdsProvidedServiceInstance146: service-interface-deployment=StructContainerDdsInterfaceDeployment, qos-profile=default_qos.xml, transport-plugins=FSHM, dds-event-qos-props=eventDdsDeployment, service-instance-id=10175
    IflytekSensorCameraSurroundResizeImageRear_DdsProvidedServiceInstance73: service-interface-deployment=CameraStructContainerDdsInterfaceDeployment, qos-profile=small_buffer_qos.xml, transport-plugins=NDSHM, dds-event-qos-props=DdsEventDeployment, service-instance-id=10002
    IflytekSensorCameraSurroundResizeImageRight_DdsProvidedServiceInstance74: service-interface-deployment=CameraStructContainerDdsInterfaceDeployment, qos-profile=small_buffer_qos.xml, transport-plugins=NDSHM, dds-event-qos-props=DdsEventDeployment, service-instance-id=10006
    IflytekSensorImu_DdsProvidedComServicePncNode: service-interface-deployment=StructContainerDdsInterfaceDeployment, qos-profile=small_buffer_qos.xml, transport-plugins=FSHM, dds-event-qos-props=eventDdsDeployment, service-instance-id=10008
    IflytekVehicleService_DdsProvidedComServicePncNode: service-interface-deployment=StructContainerDdsInterfaceDeployment, qos-profile=small_buffer_qos.xml, transport-plugins=FSHM, dds-event-qos-props=eventDdsDeployment, service-instance-id=10009
    IflytekHmiMcuToSocBsw_DdsProvidedComServicePncNode: service-interface-deployment=StructContainerDdsInterfaceDeployment, qos-profile=small_buffer_qos.xml, transport-plugins=FSHM, dds-event-qos-props=eventDdsDeployment, service-instance-id=10017
    IflytekUssUsswaveInfo_DdsProvidedComServicePncNode: service-interface-deployment=StructContainerDdsInterfaceDeployment, qos-profile=small_buffer_qos.xml, transport-plugins=FSHM, dds-event-qos-props=eventDdsDeployment, service-instance-id=10018
    IflytekSensorMcuToFmInfo_DdsProvidedComServicePncNode: service-interface-deployment=StructContainerDdsInterfaceDeployment, qos-profile=small_buffer_qos.xml, transport-plugins=FSHM, dds-event-qos-props=eventDdsDeployment, service-instance-id=10019
    IflytekAlarmInfoMcu_DdsProvidedComServicePncNode: service-interface-deployment=StructContainerDdsInterfaceDeployment, qos-profile=small_buffer_qos.xml, transport-plugins=FSHM, dds-event-qos-props=eventDdsDeployment, service-instance-id=10020
    IflytekRadarFmPerceptionInfo_DdsProvidedComServicePncNode: service-interface-deployment=StructContainerDdsInterfaceDeployment, qos-profile=small_buffer_qos.xml, transport-plugins=FSHM, dds-event-qos-props=eventDdsDeployment, service-instance-id=10021
    IflytekRadarFlPerceptionInfo_DdsProvidedComServicePncNode: service-interface-deployment=StructContainerDdsInterfaceDeployment, qos-profile=small_buffer_qos.xml, transport-plugins=FSHM, dds-event-qos-props=eventDdsDeployment, service-instance-id=10022
    IflytekRadarFrPerceptionInfo_DdsProvidedComServicePncNode: service-interface-deployment=StructContainerDdsInterfaceDeployment, qos-profile=small_buffer_qos.xml, transport-plugins=FSHM, dds-event-qos-props=eventDdsDeployment, service-instance-id=10026
    IflytekRadarRlPerceptionInfo_DdsProvidedComServicePncNode: service-interface-deployment=StructContainerDdsInterfaceDeployment, qos-profile=small_buffer_qos.xml, transport-plugins=FSHM, dds-event-qos-props=eventDdsDeployment, service-instance-id=10028
    IflytekRadarRrPerceptionInfo_DdsProvidedComServicePncNode: service-interface-deployment=StructContainerDdsInterfaceDeployment, qos-profile=small_buffer_qos.xml, transport-plugins=FSHM, dds-event-qos-props=eventDdsDeployment, service-instance-id=10030
    IflytekSensorImu_DdsProvidedServiceInstance88: service-interface-deployment=StructContainerDdsInterfaceDeployment, qos-profile=small_buffer_qos.xml, transport-plugins=FSHM, dds-event-qos-props=eventDdsDeployment, service-instance-id=10033
    IflytekVehicleService_DdsProvidedServiceInstance89: service-interface-deployment=StructContainerDdsInterfaceDeployment, qos-profile=small_buffer_qos.xml, transport-plugins=FSHM, dds-event-qos-props=eventDdsDeployment, service-instance-id=10034
    IflytekHmiMcuToSocBsw_DdsProvidedServiceInstance90: service-interface-deployment=StructContainerDdsInterfaceDeployment, qos-profile=small_buffer_qos.xml, transport-plugins=FSHM, dds-event-qos-props=eventDdsDeployment, service-instance-id=10035
    IflytekCameraPerceptionObjects_DdsProvidedServiceInstance91: service-interface-deployment=StructContainerDdsInterfaceDeployment, qos-profile=customized_qos.xml, transport-plugins=FSHM, dds-event-qos-props=eventDdsDeployment, service-instance-id=10036
    IflytekFusionObjects_DdsProvidedServiceInstance92: service-interface-deployment=StructContainerDdsInterfaceDeployment, qos-profile=customized_qos.xml, transport-plugins=FSHM, dds-event-qos-props=eventDdsDeployment, service-instance-id=10037
    IflytekCalibrationCalibInfo_DdsProvidedCalibration: service-interface-deployment=StructContainerDdsInterfaceDeployment, qos-profile=small_buffer_qos.xml, transport-plugins=FSHM, dds-event-qos-props=eventDdsDeployment, service-instance-id=10039
    IflytekMegaMappingStatus_DdsProvidedServiceInstance94: service-interface-deployment=StructContainerDdsInterfaceDeployment, qos-profile=small_buffer_qos.xml, transport-plugins=FSHM, dds-event-qos-props=eventDdsDeployment, service-instance-id=10058
    IflytekFusionObjectsCompress_DdsProvidedServiceInstance95: service-interface-deployment=StructContainerDdsInterfaceDeployment, qos-profile=small_buffer_qos.xml, transport-plugins=FSHM, dds-event-qos-props=eventDdsDeployment, service-instance-id=10059
    IflytekHmiSocToMcuBsw_DdsProvidedServiceInstance96: service-interface-deployment=StructContainerDdsInterfaceDeployment, qos-profile=default_qos.xml, transport-plugins=FSHM, dds-event-qos-props=eventDdsDeployment, service-instance-id=10076
    IflytekPlanningPlan_DdsProvidedServiceInstance98: service-interface-deployment=StructContainerDdsInterfaceDeployment, qos-profile=default_qos.xml, transport-plugins=FSHM, dds-event-qos-props=eventDdsDeployment, service-instance-id=10078
    IflytekControlControlCommand_DdsProvidedServiceInstance99: service-interface-deployment=StructContainerDdsInterfaceDeployment, qos-profile=small_buffer_qos.xml, transport-plugins=FSHM, dds-event-qos-props=eventDdsDeployment, service-instance-id=10080
    IflytekRadarFmPerception4dTarget_DdsProvidedServiceInstance100: service-interface-deployment=StructContainerDdsInterfaceDeployment, qos-profile=small_buffer_qos.xml, transport-plugins=FSHM, dds-event-qos-props=eventDdsDeployment, service-instance-id=10081
    IflytekFusionUssPerceptionInfo_DdsProvidedServiceInstance102: service-interface-deployment=StructContainerDdsInterfaceDeployment, qos-profile=customized_qos.xml, transport-plugins=FSHM, dds-event-qos-props=eventDdsDeployment, service-instance-id=10086
    IflytekFusionSpatialParkingSlot_DdsProvidedServiceInstance103: service-interface-deployment=StructContainerDdsInterfaceDeployment, qos-profile=small_buffer_qos.xml, transport-plugins=FSHM, dds-event-qos-props=eventDdsDeployment, service-instance-id=10087
    IflytekFusionOccupancyObjects_DdsProvidedServiceInstance103: service-interface-deployment=StructContainerDdsInterfaceDeployment, qos-profile=large_buffer_qos.xml, transport-plugins=FSHM, dds-event-qos-props=eventDdsDeployment, service-instance-id=10091
    IflytekFusionObjects_DdsProvidedServiceInstance104: service-interface-deployment=StructContainerDdsInterfaceDeployment, qos-profile=customized_qos.xml, transport-plugins=FSHM, dds-event-qos-props=eventDdsDeployment, service-instance-id=10093
    IflytekFusionGroundLine_DdsProvidedServiceInstance103: service-interface-deployment=StructContainerDdsInterfaceDeployment, qos-profile=default_qos.xml, transport-plugins=FSHM, dds-event-qos-props=eventDdsDeployment, service-instance-id=10068
    IflytekFusionSpeedBump_DdsProvidedServiceInstance103: service-interface-deployment=StructContainerDdsInterfaceDeployment, qos-profile=small_buffer_qos.xml, transport-plugins=FSHM, dds-event-qos-props=eventDdsDeployment, service-instance-id=10094
    IflytekCameraPerceptionScene_DdsProvidedServiceInstance104: service-interface-deployment=StructContainerDdsInterfaceDeployment, qos-profile=small_buffer_qos.xml, transport-plugins=FSHM, dds-event-qos-props=eventDdsDeployment, service-instance-id=10095
    IflytekCameraPerceptionScene_DdsProvidedServiceInstance105: service-interface-deployment=StructContainerDdsInterfaceDeployment, qos-profile=small_buffer_qos.xml, transport-plugins=FSHM, dds-event-qos-props=eventDdsDeployment, service-instance-id=10098
    IflytekCameraPerceptionOccGrid_DdsProvidedServiceInstance107: service-interface-deployment=StructContainerDdsInterfaceDeployment, qos-profile=default_qos.xml, transport-plugins=FSHM, dds-event-qos-props=eventDdsDeployment, service-instance-id=10100
    IflytekPlanningHmi_DdsProvidedServiceInstance109: service-interface-deployment=StructContainerDdsInterfaceDeployment, qos-profile=default_qos.xml, transport-plugins=FSHM, dds-event-qos-props=eventDdsDeployment, service-instance-id=10102
    IflytekSensorCameraSurroundResizeImageLeft_DdsProvidedServiceInstance110: service-interface-deployment=CameraStructContainerDdsInterfaceDeployment, qos-profile=small_buffer_qos.xml, transport-plugins=NDSHM, dds-event-qos-props=DdsEventDeployment, service-instance-id=10001
    IflytekSensorCameraSurroundResizeImageFront_DdsProvidedServiceInstance110: service-interface-deployment=CameraStructContainerDdsInterfaceDeployment, qos-profile=small_buffer_qos.xml, transport-plugins=NDSHM, dds-event-qos-props=DdsEventDeployment, service-instance-id=10000
  provided someip service instance IflytekAlarmInfoMdcA_ProvidedSomeipCameraNodeAroundView: service-interface-deployment=FmAlarmReceiveServiceDeployment, service-instance-id=1
  40 x dds provided service instance, all with domain-id=30:
    IflytekCameraPerceptionLaneLines_DdsProvidedServiceInstance100: service-interface-deployment=StructContainerDdsInterfaceDeployment, qos-profile=customized_qos.xml, transport-plugins=FSHM, dds-event-qos-props=eventDdsDeployment, service-instance-id=10031
    IflytekCameraPerceptionGroundLine_DdsProvidedServiceInstance101: service-interface-deployment=StructContainerDdsInterfaceDeployment, qos-profile=customized_qos.xml, transport-plugins=FSHM, dds-event-qos-props=eventDdsDeployment, service-instance-id=10038
    IflytekCameraPerceptionDeceler_DdsProvidedServiceInstance102: service-interface-deployment=StructContainerDdsInterfaceDeployment, qos-profile=small_buffer_qos.xml, transport-plugins=FSHM, dds-event-qos-props=eventDdsDeployment, service-instance-id=10070
    IflytekFusionParkingSlot_DdsProvidedServiceInstance104: service-interface-deployment=StructContainerDdsInterfaceDeployment, qos-profile=small_buffer_qos.xml, transport-plugins=FSHM, dds-event-qos-props=eventDdsDeployment, service-instance-id=10077
    IflytekFusionSpatialParkingSlot_DdsProvidedServiceInstance105: service-interface-deployment=StructContainerDdsInterfaceDeployment, qos-profile=small_buffer_qos.xml, transport-plugins=FSHM, dds-event-qos-props=eventDdsDeployment, service-instance-id=10082
    IflytekPlanningHmi_DdsProvidedServiceInstance106: service-interface-deployment=StructContainerDdsInterfaceDeployment, qos-profile=default_qos.xml, transport-plugins=FSHM, dds-event-qos-props=eventDdsDeployment, service-instance-id=10085
    IflytekPlanningPlan_DdsProvidedServiceInstance107: service-interface-deployment=StructContainerDdsInterfaceDeployment, qos-profile=default_qos.xml, transport-plugins=FSHM, dds-event-qos-props=eventDdsDeployment, service-instance-id=10103
    IflytekFsmSocState_DdsProvidedServiceInstance108: service-interface-deployment=StructContainerDdsInterfaceDeployment, qos-profile=small_buffer_qos.xml, transport-plugins=FSHM, dds-event-qos-props=eventDdsDeployment, service-instance-id=10104
    IflytekFsmHmiSocOuter_DdsProvidedServiceInstance109: service-interface-deployment=StructContainerDdsInterfaceDeployment, qos-profile=customized_qos.xml, transport-plugins=FSHM, dds-event-qos-props=eventDdsDeployment, service-instance-id=10105
    IflytekFsmSocState_DdsProvidedSocACommunication: service-interface-deployment=StructContainerDdsInterfaceDeployment, qos-profile=small_buffer_qos.xml, transport-plugins=FSHM, dds-event-qos-props=eventDdsDeployment, service-instance-id=10110
    IflytekSensorCameraSurroundFrontFullResolutionH265_DdsProvidedServiceInstance111: service-interface-deployment=CameraStructContainerDdsInterfaceDeployment, qos-profile=small_buffer_qos.xml, transport-plugins=NDSHM, dds-event-qos-props=DdsEventDeployment, service-instance-id=10111
    IflytekSensorCameraSurroundLeftFullResolutionH265_DdsProvidedServiceInstance112: service-interface-deployment=CameraStructContainerDdsInterfaceDeployment, qos-profile=small_buffer_qos.xml, transport-plugins=NDSHM, dds-event-qos-props=DdsEventDeployment, service-instance-id=10112
    IflytekSensorCameraSurroundRearFullResolutionH265_DdsProvidedServiceInstance113: service-interface-deployment=CameraStructContainerDdsInterfaceDeployment, qos-profile=small_buffer_qos.xml, transport-plugins=NDSHM, dds-event-qos-props=DdsEventDeployment, service-instance-id=10113
    IflytekSensorCameraSurroundRightFullResolutionH265_DdsProvidedServiceInstance114: service-interface-deployment=CameraStructContainerDdsInterfaceDeployment, qos-profile=small_buffer_qos.xml, transport-plugins=NDSHM, dds-event-qos-props=DdsEventDeployment, service-instance-id=10124
    IflytekSensorCameraRearFullResolutionH265_DdsProvidedServiceInstance115: service-interface-deployment=CameraStructContainerDdsInterfaceDeployment, qos-profile=small_buffer_qos.xml, transport-plugins=NDSHM, dds-event-qos-props=DdsEventDeployment, service-instance-id=10125
    IflytekFusionRoadFusion_DdsProvidedServiceInstance115: service-interface-deployment=StructContainerDdsInterfaceDeployment, qos-profile=customized_qos.xml, transport-plugins=FSHM, dds-event-qos-props=eventDdsDeployment, service-instance-id=10071
    IflytekCameraPerceptionTrafficSignRecognition_DdsProvidedServiceInstance115: service-interface-deployment=StructContainerDdsInterfaceDeployment, qos-profile=small_buffer_qos.xml, transport-plugins=FSHM, dds-event-qos-props=eventDdsDeployment, service-instance-id=10099
    IflytekCameraPerceptionLaneTopo_DdsProvidedServiceInstance116: service-interface-deployment=StructContainerDdsInterfaceDeployment, qos-profile=customized_qos.xml, transport-plugins=FSHM, dds-event-qos-props=eventDdsDeployment, service-instance-id=10131
    IflytekPredictionPredictionResult_DdsProvidedServiceInstance117: service-interface-deployment=StructContainerDdsInterfaceDeployment, qos-profile=customized_qos.xml, transport-plugins=FSHM, dds-event-qos-props=eventDdsDeployment, service-instance-id=10132
    IflytekFusionRoadFusion_DdsProvidedServiceInstance118: service-interface-deployment=StructContainerDdsInterfaceDeployment, qos-profile=customized_qos.xml, transport-plugins=FSHM, dds-event-qos-props=eventDdsDeployment, service-instance-id=10133
    IflytekCameraPerceptionOccupancyObjects_DdsProvidedSocBCommunication: service-interface-deployment=StructContainerDdsInterfaceDeployment, qos-profile=large_buffer_qos.xml, transport-plugins=FSHM, dds-event-qos-props=eventDdsDeployment, service-instance-id=10134
    IflytekCameraPerception3dGeneralObjects_DdsProvidedServiceInstance119: service-interface-deployment=StructContainerDdsInterfaceDeployment, qos-profile=customized_qos.xml, transport-plugins=FSHM, dds-event-qos-props=eventDdsDeployment, service-instance-id=10003
    IflytekCameraPerceptionParkingSlotList_DdsProvidedServiceInstance120: service-interface-deployment=StructContainerDdsInterfaceDeployment, qos-profile=default_qos.xml, transport-plugins=FSHM, dds-event-qos-props=eventDdsDeployment, service-instance-id=10138
    IflytekCameraPerceptionParkingLaneLine_DdsProvidedServiceInstance121: service-interface-deployment=StructContainerDdsInterfaceDeployment, qos-profile=customized_qos.xml, transport-plugins=FSHM, dds-event-qos-props=eventDdsDeployment, service-instance-id=10139
    IflytekFusionObjectsCompress_DdsProvidedServiceInstance122: service-interface-deployment=StructContainerDdsInterfaceDeployment, qos-profile=small_buffer_qos.xml, transport-plugins=FSHM, dds-event-qos-props=eventDdsDeployment, service-instance-id=10140
    IflytekFusionUssPerceptionInfo_DdsProvidedServiceInstance123: service-interface-deployment=StructContainerDdsInterfaceDeployment, qos-profile=customized_qos.xml, transport-plugins=FSHM, dds-event-qos-props=eventDdsDeployment, service-instance-id=10141
    IflytekFusionOccupancyObjects_DdsProvidedSocBCommunication: service-interface-deployment=StructContainerDdsInterfaceDeployment, qos-profile=large_buffer_qos.xml, transport-plugins=FSHM, dds-event-qos-props=eventDdsDeployment, service-instance-id=10142
    IflytekFusionRoadFusionCompress_DdsProvidedServiceInstance125: service-interface-deployment=StructContainerDdsInterfaceDeployment, qos-profile=small_buffer_qos.xml, transport-plugins=FSHM, dds-event-qos-props=eventDdsDeployment, service-instance-id=10143
    IflytekFusionGroundLine_DdsProvidedServiceInstance126: service-interface-deployment=StructContainerDdsInterfaceDeployment, qos-profile=default_qos.xml, transport-plugins=FSHM, dds-event-qos-props=eventDdsDeployment, service-instance-id=10144
    IflytekFusionSpeedBump_DdsProvidedServiceInstance127: service-interface-deployment=StructContainerDdsInterfaceDeployment, qos-profile=small_buffer_qos.xml, transport-plugins=FSHM, dds-event-qos-props=eventDdsDeployment, service-instance-id=10145
    IflytekUssUsswaveInfo_DdsProvidedServiceInstance128: service-interface-deployment=StructContainerDdsInterfaceDeployment, qos-profile=small_buffer_qos.xml, transport-plugins=FSHM, dds-event-qos-props=eventDdsDeployment, service-instance-id=10146
    IflytekRadarFlPerceptionInfo_DdsProvidedServiceInstance129: service-interface-deployment=StructContainerDdsInterfaceDeployment, qos-profile=small_buffer_qos.xml, transport-plugins=FSHM, dds-event-qos-props=eventDdsDeployment, service-instance-id=10147
    IflytekRadarFrPerceptionInfo_DdsProvidedServiceInstance130: service-interface-deployment=StructContainerDdsInterfaceDeployment, qos-profile=small_buffer_qos.xml, transport-plugins=FSHM, dds-event-qos-props=eventDdsDeployment, service-instance-id=10148
    IflytekRadarRlPerceptionInfo_DdsProvidedServiceInstance131: service-interface-deployment=StructContainerDdsInterfaceDeployment, qos-profile=small_buffer_qos.xml, transport-plugins=FSHM, dds-event-qos-props=eventDdsDeployment, service-instance-id=10149
    IflytekRadarRrPerceptionInfo_DdsProvidedServiceInstance132: service-interface-deployment=StructContainerDdsInterfaceDeployment, qos-profile=small_buffer_qos.xml, transport-plugins=FSHM, dds-event-qos-props=eventDdsDeployment, service-instance-id=10150
    IflytekAdasFunctionAdas_DdsProvidedComServicePncNode: service-interface-deployment=StructContainerDdsInterfaceDeployment, qos-profile=small_buffer_qos.xml, transport-plugins=FSHM, dds-event-qos-props=eventDdsDeployment, service-instance-id=10151
    IflytekAdasFunctionAdas_DdsProvidedSocBCommunication: service-interface-deployment=StructContainerDdsInterfaceDeployment, qos-profile=small_buffer_qos.xml, transport-plugins=FSHM, dds-event-qos-props=eventDdsDeployment, service-instance-id=10152
    IflytekControlControlCommand_DdsProvidedServiceInstance135: service-interface-deployment=StructContainerDdsInterfaceDeployment, qos-profile=small_buffer_qos.xml, transport-plugins=FSHM, dds-event-qos-props=eventDdsDeployment, service-instance-id=10153
    IflytekDTCInfoFmAService_DdsProvidedServiceInstance136: service-interface-deployment=StructContainerDdsInterfaceDeployment, qos-profile=default_qos.xml, transport-plugins=FSHM, dds-event-qos-props=eventDdsDeployment, service-instance-id=10157
    IflytekAlarmInfoFmAService_DdsProvidedSocBCommunication: service-interface-deployment=StructContainerDdsInterfaceDeployment, qos-profile=small_buffer_qos.xml, transport-plugins=FSHM, dds-event-qos-props=eventDdsDeployment, service-instance-id=10158
  6 x provided someip service instance, all with service-interface-deployment=ClientServiceContainerInterfaceDeployment:
    IflytekPostSaleCalibrationActivation_ProvidedSomeipServiceInstance11: service-instance-id=10013
      someip provided event group eventGroup1: event-group=ClientServiceContainerInterfaceDeployment/SomeipEventGroup
    IflytekPostSaleCalibrationStop_ProvidedSomeipServiceInstance12: service-instance-id=10014
      someip provided event group eventGroup1: event-group=ClientServiceContainerInterfaceDeployment/SomeipEventGroup
    IflytekPostSaleCalibrationResult_ProvidedSomeipServiceInstance13: service-instance-id=10016
      someip provided event group eventGroup1: event-group=ClientServiceContainerInterfaceDeployment/SomeipEventGroup
    IflytekPostSaleCalibrationActivation_ProvidedSomeipSocACommunication: service-instance-id=10037
      someip provided event group eventGroup1: event-group=ClientServiceContainerInterfaceDeployment/SomeipEventGroup
    IflytekPostSaleCalibrationStop_ProvidedSomeipSocACommunication: service-instance-id=10038
      someip provided event group eventGroup1: event-group=ClientServiceContainerInterfaceDeployment/SomeipEventGroup
    IflytekPostSaleCalibrationResult_ProvidedSomeipSocACommunication: service-instance-id=10039
      someip provided event group eventGroup1: event-group=ClientServiceContainerInterfaceDeployment/SomeipEventGroup
  37 x dds provided service instance, all with domain-id=30:
    IflytekSystemVersion_DdsProvidedStaticFusion: service-interface-deployment=StructContainerDdsInterfaceDeployment, qos-profile=small_buffer_qos.xml, transport-plugins=FSHM, dds-event-qos-props=eventDdsDeployment, service-instance-id=10159
    IflytekSystemVersion_DdsProvidedSocBCommunication: service-interface-deployment=StructContainerDdsInterfaceDeployment, qos-profile=small_buffer_qos.xml, transport-plugins=FSHM, dds-event-qos-props=eventDdsDeployment, service-instance-id=10160
    IflytekFdlTriggerAck_DdsProvidedSocBCommunication: service-interface-deployment=StructContainerDdsInterfaceDeployment, qos-profile=small_buffer_qos.xml, transport-plugins=FSHM, dds-event-qos-props=eventDdsDeployment, service-instance-id=10162
    IflytekFdlTrigger_DdsProvidedSocACommunication: service-interface-deployment=StructContainerDdsInterfaceDeployment, qos-profile=small_buffer_qos.xml, transport-plugins=FSHM, dds-event-qos-props=eventDdsDeployment, service-instance-id=10164
    IflytekMcuFmASentinel_DdsProvidedComServicePncNode: service-interface-deployment=StructContainerDdsInterfaceDeployment, qos-profile=small_buffer_qos.xml, transport-plugins=FSHM, dds-event-qos-props=eventDdsDeployment, service-instance-id=10165
    IflytekPlanningDebugInfo_DdsProvidedPlanning: service-interface-deployment=StructContainerDdsInterfaceDeployment, qos-profile=default_qos.xml, transport-plugins=FSHM, dds-event-qos-props=eventDdsDeployment, service-instance-id=10169
    IflytekControlDebugInfo_DdsProvidedControl: service-interface-deployment=StructContainerDdsInterfaceDeployment, qos-profile=customized_qos.xml, transport-plugins=FSHM, dds-event-qos-props=eventDdsDeployment, service-instance-id=10170
    IflytekPlanningDebugInfo_DdsProvidedSocBCommunication: service-interface-deployment=StructContainerDdsInterfaceDeployment, qos-profile=default_qos.xml, transport-plugins=FSHM, dds-event-qos-props=eventDdsDeployment, service-instance-id=10171
    IflytekControlDebugInfo_DdsProvidedSocBCommunication: service-interface-deployment=StructContainerDdsInterfaceDeployment, qos-profile=customized_qos.xml, transport-plugins=FSHM, dds-event-qos-props=eventDdsDeployment, service-instance-id=10172
    IflytekAdasFunctionDebugInfo_DdsProvidedComServicePncNode: service-interface-deployment=StructContainerDdsInterfaceDeployment, qos-profile=small_buffer_qos.xml, transport-plugins=FSHM, dds-event-qos-props=eventDdsDeployment, service-instance-id=10177
    IflytekAdasFunctionDebugInfo_DdsProvidedSocBCommunication: service-interface-deployment=StructContainerDdsInterfaceDeployment, qos-profile=small_buffer_qos.xml, transport-plugins=FSHM, dds-event-qos-props=eventDdsDeployment, service-instance-id=10178
    IflytekRadarPerception4dTargetMcu_DdsProvidedServiceInstance149: service-interface-deployment=StructContainerDdsInterfaceDeployment, qos-profile=default_qos.xml, transport-plugins=FSHM, dds-event-qos-props=eventDdsDeployment, service-instance-id=10180
    IflytekEngineerInner_DdsProvidedSocACommunication: service-interface-deployment=StructContainerDdsInterfaceDeployment, qos-profile=small_buffer_qos.xml, transport-plugins=FSHM, dds-event-qos-props=eventDdsDeployment, service-instance-id=10182
    IflytekFmADegradeFunciton_DdsProvidedServiceInstance151: service-interface-deployment=StructContainerDdsInterfaceDeployment, qos-profile=small_buffer_qos.xml, transport-plugins=FSHM, dds-event-qos-props=eventDdsDeployment, service-instance-id=10185
    IflytekCameraPerceptionPanoramaView2DBoundingBoxes_DdsProvidedServiceInstance152: service-interface-deployment=StructContainerDdsInterfaceDeployment, qos-profile=default_qos.xml, transport-plugins=FSHM, dds-event-qos-props=eventDdsDeployment, service-instance-id=10187
    IflytekSensorCameraFront120FullResolutionClearH265_DdsProvidedServiceInstance153: service-interface-deployment=CameraStructContainerDdsInterfaceDeployment, qos-profile=small_buffer_qos.xml, transport-plugins=NDSHM, dds-event-qos-props=DdsEventDeployment, service-instance-id=10189
    IflytekSensorCameraRearFullResolutionH265MDCA_DdsProvidedSocBCommunication: service-interface-deployment=CameraStructContainerDdsInterfaceDeployment, qos-profile=small_buffer_qos.xml, transport-plugins=NDSHM, dds-event-qos-props=DdsEventDeployment, service-instance-id=10190
    IflytekFmAMcuSentinel_DdsProvidedServiceInstance155: service-interface-deployment=StructContainerDdsInterfaceDeployment, qos-profile=small_buffer_qos.xml, transport-plugins=FSHM, dds-event-qos-props=eventDdsDeployment, service-instance-id=10191
    IflytekMcuFmASentinel_DdsProvidedServiceInstance156: service-interface-deployment=StructContainerDdsInterfaceDeployment, qos-profile=small_buffer_qos.xml, transport-plugins=FSHM, dds-event-qos-props=eventDdsDeployment, service-instance-id=10192
    IflytekCameraPerceptionAroundView2DBoundingBoxes_DdsProvidedServiceInstance157: service-interface-deployment=StructContainerDdsInterfaceDeployment, qos-profile=customized_qos.xml, transport-plugins=FSHM, dds-event-qos-props=eventDdsDeployment, service-instance-id=10193
    IflytekEhrPhmReport_DdsProvidedEhr: service-interface-deployment=StructContainerDdsInterfaceDeployment, qos-profile=default_qos.xml, transport-plugins=FSHM, dds-event-qos-props=eventDdsDeployment, service-instance-id=10194
    IflytekLocalizationPhmReport_DdsProvidedLocalization: service-interface-deployment=StructContainerDdsInterfaceDeployment, qos-profile=small_buffer_qos.xml, transport-plugins=FSHM, dds-event-qos-props=eventDdsDeployment, service-instance-id=10196
    IflytekGnssPhmReport_DdsProvidedGnssServiceNode: service-interface-deployment=StructContainerDdsInterfaceDeployment, qos-profile=small_buffer_qos.xml, transport-plugins=FSHM, dds-event-qos-props=eventDdsDeployment, service-instance-id=10197
    IflytekCameraPerceptionPanoramaPhmReport_DdsProvidedPanoramaViewCameraPerception: service-interface-deployment=StructContainerDdsInterfaceDeployment, qos-profile=default_qos.xml, transport-plugins=FSHM, dds-event-qos-props=eventDdsDeployment, service-instance-id=10200
    IflytekFsmPhmReport_DdsProvidedFiniteStateManager: service-interface-deployment=StructContainerDdsInterfaceDeployment, qos-profile=small_buffer_qos.xml, transport-plugins=FSHM, dds-event-qos-props=eventDdsDeployment, service-instance-id=10201
    IflytekCameraPanoramaPhmReport_DdsProvidedCameraNodePanoramaView: service-interface-deployment=StructContainerDdsInterfaceDeployment, qos-profile=small_buffer_qos.xml, transport-plugins=FSHM, dds-event-qos-props=eventDdsDeployment, service-instance-id=10202
    IflytekFusionObstaclePhmReport_DdsProvidedObstacleFusion: service-interface-deployment=StructContainerDdsInterfaceDeployment, qos-profile=small_buffer_qos.xml, transport-plugins=FSHM, dds-event-qos-props=eventDdsDeployment, service-instance-id=10204
    IflytekPlanningPhmReport_DdsProvidedPlanning: service-interface-deployment=StructContainerDdsInterfaceDeployment, qos-profile=small_buffer_qos.xml, transport-plugins=FSHM, dds-event-qos-props=eventDdsDeployment, service-instance-id=10205
    IflytekComPncPhmReport_DdsProvidedComServicePncNode: service-interface-deployment=StructContainerDdsInterfaceDeployment, qos-profile=small_buffer_qos.xml, transport-plugins=FSHM, dds-event-qos-props=eventDdsDeployment, service-instance-id=10206
    IflytekCameraAroundPhmReport_DdsProvidedCameraNodeAroundView: service-interface-deployment=StructContainerDdsInterfaceDeployment, qos-profile=small_buffer_qos.xml, transport-plugins=FSHM, dds-event-qos-props=eventDdsDeployment, service-instance-id=10208
    IflytekControlPhmReport_DdsProvidedControl: service-interface-deployment=StructContainerDdsInterfaceDeployment, qos-profile=small_buffer_qos.xml, transport-plugins=FSHM, dds-event-qos-props=eventDdsDeployment, service-instance-id=10210
    IflytekFusionStaticPhmReport_DdsProvidedStaticFusion: service-interface-deployment=StructContainerDdsInterfaceDeployment, qos-profile=small_buffer_qos.xml, transport-plugins=FSHM, dds-event-qos-props=eventDdsDeployment, service-instance-id=10211
    IflytekCameraPerception3dOccupancyObjects_DdsProvidedServiceInstance170: service-interface-deployment=StructContainerDdsInterfaceDeployment, qos-profile=large_buffer_qos.xml, transport-plugins=FSHM, dds-event-qos-props=eventDdsDeployment, service-instance-id=10213
    IflytekSensorTboxTime_DdsProvidedComServicePncNode: service-interface-deployment=StructContainerDdsInterfaceDeployment, qos-profile=large_buffer_qos.xml, transport-plugins=FSHM, dds-event-qos-props=eventDdsDeployment, service-instance-id=10011
    IflytekSensorTboxTime_DdsProvidedSocBCommunication: service-interface-deployment=StructContainerDdsInterfaceDeployment, qos-profile=large_buffer_qos.xml, transport-plugins=FSHM, dds-event-qos-props=eventDdsDeployment, service-instance-id=10032
    IflytekCameraState_DdsProvidedCameraNodeAroundView: service-interface-deployment=StructContainerDdsInterfaceDeployment, qos-profile=small_buffer_qos.xml, transport-plugins=FSHM, dds-event-qos-props=eventDdsDeployment, service-instance-id=10214
    IflytekFdlUploadState_DdsProvidedServiceInstance173: service-interface-deployment=StructContainerDdsInterfaceDeployment, qos-profile=small_buffer_qos.xml, transport-plugins=FSHM, dds-event-qos-props=eventDdsDeployment, service-instance-id=10217
  provided someip service instance IflytekFdlNetStatCheck_ProvidedSomeipSocACommunication: service-interface-deployment=ClientServiceContainerInterfaceDeployment, service-instance-id=10043
    someip provided event group eventGroup1: event-group=ClientServiceContainerInterfaceDeployment/SomeipEventGroup
  11 x dds provided service instance, all with service-interface-deployment=StructContainerDdsInterfaceDeployment, domain-id=30, transport-plugins=FSHM, dds-event-qos-props=eventDdsDeployment:
    IflytekDiskSpaceInfoPhmBOta_DdsProvidedSocACommunication: qos-profile=small_buffer_qos.xml, service-instance-id=10220
    IflytekDiskCleanRequest_DdsProvidedSocBCommunication: qos-profile=small_buffer_qos.xml, service-instance-id=10222
    IflytekDiskStatePhmAFdl_DdsProvidedSocBCommunication: qos-profile=small_buffer_qos.xml, service-instance-id=10224
    IflytekDiskCleanRequestPhmAFdl_DdsProvidedSocBCommunication: qos-profile=small_buffer_qos.xml, service-instance-id=10226
    IflytekCalibrationPhmReport_DdsProvidedCalibration: qos-profile=small_buffer_qos.xml, service-instance-id=10231
    IflytekCalibrationDebugInfo_DdsProvidedCalibration: qos-profile=default_qos.xml, service-instance-id=10234
    IflytekEhpParkingMap_DdsProvidedSocBCommunication: qos-profile=customized_qos.xml, service-instance-id=10047
    IflytekEhpParkingMapFileInfo_DdsProvidedSocBCommunication: qos-profile=small_buffer_qos.xml, service-instance-id=10195
    IflytekEhpMapManager_DdsProvidedSocBCommunication: qos-profile=small_buffer_qos.xml, service-instance-id=10236
    IflytekSensorGnss_DdsProvidedSocACommunication: qos-profile=small_buffer_qos.xml, service-instance-id=10237
    IflytekCameraAroundErrorStatus_DdsProvidedCameraNodeAroundView: qos-profile=small_buffer_qos.xml, service-instance-id=10238
  provided someip service instance IflytekOtaLogUploadRequest_ProvidedSomeipSocACommunication: service-interface-deployment=ClientServiceContainerInterfaceDeployment, service-instance-id=10046
    someip provided event group eventGroup1: event-group=ClientServiceContainerInterfaceDeployment/SomeipEventGroup
  10 x dds provided service instance, all with domain-id=30:
    IflytekCalibrationCalibInfo_DdsProvidedSocACommunication: service-interface-deployment=StructContainerDdsInterfaceDeployment, qos-profile=small_buffer_qos.xml, transport-plugins=FSHM, dds-event-qos-props=eventDdsDeployment, service-instance-id=10239
    IflytekSystemAProcessLoading_DdsProvidedSocBCommunition: service-interface-deployment=StructContainerDdsInterfaceDeployment, qos-profile=default_qos.xml, transport-plugins=FSHM, dds-event-qos-props=eventDdsDeployment, service-instance-id=10240
    IflytekCameraPerceptionDrivableSpaceGrid_DdsProvidedSocBCommunication: service-interface-deployment=StructContainerDdsInterfaceDeployment, qos-profile=default_qos.xml, transport-plugins=FSHM, dds-event-qos-props=eventDdsDeployment, service-instance-id=10167
    IflytekCameraPerceptionObstacleFeature_DdsProvidedPanoramaViewCameraPerception: service-interface-deployment=CameraStructContainerDdsInterfaceDeployment, qos-profile=small_buffer_qos.xml, transport-plugins=NDSHM, dds-event-qos-props=DdsEventDeployment, service-instance-id=10048
    IflytekCameraPerceptionLaneFeature_DdsProvidedPanoramaViewCameraPerception: service-interface-deployment=CameraStructContainerDdsInterfaceDeployment, qos-profile=small_buffer_qos.xml, transport-plugins=NDSHM, dds-event-qos-props=DdsEventDeployment, service-instance-id=10049
    IflytekCameraPerceptionObstacleFeature_DdsProvidedSocACommunication: service-interface-deployment=CameraStructContainerDdsInterfaceDeployment, qos-profile=small_buffer_qos.xml, transport-plugins=NDSHM, dds-event-qos-props=DdsEventDeployment, service-instance-id=10176
    IflytekCameraPerceptionLaneFeature_DdsProvidedSocACommunication: service-interface-deployment=CameraStructContainerDdsInterfaceDeployment, qos-profile=small_buffer_qos.xml, transport-plugins=NDSHM, dds-event-qos-props=DdsEventDeployment, service-instance-id=10215
    IflytekEhpParkingMapToHmi_DdsProvidedSocBCommunication: service-interface-deployment=StructContainerDdsInterfaceDeployment, qos-profile=customized_qos.xml, transport-plugins=FSHM, dds-event-qos-props=eventDdsDeployment, service-instance-id=10241
    IflytekCanTxInfo_DdsProvidedComServicePncNode: service-interface-deployment=StructContainerDdsInterfaceDeployment, qos-profile=small_buffer_qos.xml, transport-plugins=FSHM, dds-event-qos-props=eventDdsDeployment, service-instance-id=10242
    IflytekCanTxInfo_DdsProvidedSocBCommunication: service-interface-deployment=StructContainerDdsInterfaceDeployment, qos-profile=small_buffer_qos.xml, transport-plugins=FSHM, dds-event-qos-props=eventDdsDeployment, service-instance-id=10243
package /HuaweiMDC/instance_manifests/instanceToMachineMappings
  37 x dds service instance to machine mapping, all with communication-connector=InnerEthernetCommConnector:
    IflytekSensorCameraPanoramaImageFront_DdsRequiredServiceInstance81_ToDdsMachineMapping: service-instance=IflytekSensorCameraFront30_DdsRequiredServiceInstance81
    IflytekSensorCameraPanoramaImageFl_DdsRequiredServiceInstance82_ToDdsMachineMapping: service-instance=IflytekSensorCameraSideFl_DdsRequiredServiceInstance82
    IflytekSensorCameraPanoramaImageFr_DdsRequiredServiceInstance83_ToDdsMachineMapping: service-instance=IflytekSensorCameraSideFr_DdsRequiredServiceInstance83
    IflytekSensorCameraPanoramaImageRl_DdsRequiredServiceInstance84_ToDdsMachineMapping: service-instance=IflytekSensorCameraSideRl_DdsRequiredServiceInstance84
    IflytekSensorCameraPanoramaImageRr_DdsRequiredServiceInstance85_ToDdsMachineMapping: service-instance=IflytekSensorCameraSideRr_DdsRequiredServiceInstance85
    IflytekSensorCameraPanoramaImageRear_DdsProvidedServiceInstance56_ToDdsMachineMapping: service-instance=IflytekSensorCameraRear_DdsProvidedServiceInstance56
    IflytekSensorCameraPanoramaImageFl_DdsProvidedServiceInstance52_ToDdsMachineMapping: service-instance=IflytekSensorCameraPanoramaImageFl_DdsProvidedServiceInstance52
    IflytekSensorCameraPanoramaImageRr_DdsProvidedServiceInstance55_ToDdsMachineMapping: service-instance=IflytekSensorCameraPanoramaImageRr_DdsProvidedServiceInstance55
    IflytekSensorCameraPanoramaImageFront_DdsProvidedServiceInstance51_ToDdsMachineMapping: service-instance=IflytekSensorCameraPanoramaImageFront_DdsProvidedServiceInstance51
    IflytekSensorCameraPanoramaImageFr_DdsProvidedServiceInstance53_ToDdsMachineMapping: service-instance=IflytekSensorCameraPanoramaImageFr_DdsProvidedServiceInstance53
    IflytekSensorCameraPanoramaImageRl_DdsProvidedServiceInstance54_ToDdsMachineMapping: service-instance=IflytekSensorCameraPanoramaImageRl_DdsProvidedServiceInstance54
    IflytekCameraPerceptionParkingSlotList_DdsRequiredServiceInstance165_ToDdsMachineMapping
    IflytekCameraPerceptionDeceler_DdsRequiredServiceInstance166_ToDdsMachineMapping
    IflytekSensorPboxImu_DdsRequiredServiceInstance120_ToDdsMachineMapping
    IflytekCameraPerceptionDebugInfo_DdsRequiredServiceInstance135_ToDdsMachineMapping
    camera_struct_container_DdsProvidedServiceInstance65_ToDdsMachineMapping: service-instance=camera_struct_container_DdsProvidedServiceInstance65
    IflytekSensorGnss_DdsProvidedServiceInstance57_ToDdsMachineMapping: service-instance=IflytekSensorGnss_DdsProvidedGnssServiceNode
    IflytekLocalizationEgomotion_DdsProvidedServiceInstance17_ToDdsMachineMapping: service-instance=IflytekLocalizationEgomotion_DdsProvidedLocalization
    IflytekSensorPboxImu_DdsRequiredServiceInstance90_ToDdsMachineMapping
    IflytekSensorGnss_DdsRequiredServiceInstance87_ToDdsMachineMapping: service-instance=IflytekSensorGnss_DdsRequiredServiceInstance87
    IflytekSensorCameraFront120_DdsProvidedServiceInstance66_ToDdsMachineMapping: service-instance=IflytekSensorCameraFront120_DdsProvidedServiceInstance66
    RPortPrototype1_DdsRequiredServiceInstance172_ToDdsMachineMapping: service-instance=IflytekSensorCameraFront120_DdsRequiredServiceInstance172
    IflytekSensorCameraFront120Eagle_DdsProvidedServiceInstance67_ToDdsMachineMapping: service-instance=IflytekSensorCameraFront120Eagle_DdsProvidedServiceInstance67
    RPortPrototype1_DdsRequiredServiceInstance173_ToDdsMachineMapping: service-instance=IflytekSensorCameraFront120Eagle_DdsRequiredServiceInstance173
    RPortPrototype1_DdsRequiredServiceInstance180_ToDdsMachineMapping
    RPortPrototype1_DdsRequiredServiceInstance170_ToDdsMachineMapping: service-instance=IflytekSdmapSdmapInfo_DdsRequiredServiceInstance170
    IflytekEhrSdmapInfo_DdsProvidedServiceInstance59_ToDdsMachineMapping: service-instance=IflytekEhrSdmapInfo_DdsProvidedServiceInstance59
    RPortPrototype1_DdsRequiredServiceInstance167_ToDdsMachineMapping
    RPortPrototype1_DdsRequiredServiceInstance165_ToDdsMachineMapping
    RPortPrototype1_DdsRequiredServiceInstance173_ToDdsMachineMapping: service-instance=IflytekEhrSdmapInfo_DdsRequiredServiceInstance173
    IflytekEhrSdmapInfo_DdsProvidedServiceInstance66_ToDdsMachineMapping: service-instance=IflytekEhrSdmapInfo_DdsProvidedServiceInstance66
    RPortPrototype1_DdsRequiredServiceInstance176_ToDdsMachineMapping: service-instance=IflytekLocalizationEgomotion_DdsRequiredServiceInstance176
    IflytekSensorCameraSurroundImageFront_DdsProvidedServiceInstance61_ToDdsMachineMapping: service-instance=IflytekSensorCameraSurroundResizeImageFront_DdsProvidedServiceInstance61
    IflytekSensorCameraSurroundImageLeft_DdsProvidedServiceInstance62_ToDdsMachineMapping: service-instance=IflytekSensorCameraSurroundResizeImageLeft_DdsProvidedCameraNodeAroundView
    IflytekSensorCameraSurroundImageRight_DdsProvidedServiceInstance63_ToDdsMachineMapping: service-instance=IflytekSensorCameraSurroundResizeImageRight_DdsProvidedCameraNodeAroundView
    IflytekSensorCameraSurroundImageRear_DdsProvidedServiceInstance64_ToDdsMachineMapping: service-instance=IflytekSensorCameraSurroundResizeImageRear_DdsProvidedCameraNodeAroundView
    RPortPrototype1_DdsRequiredServiceInstance161_ToDdsMachineMapping
  14 x someip service instance to machine mapping, all with communication-connector=InnerEthernetCommConnector, tcp-port=0:
    PPortPrototype1_ProvidedSomeipServiceInstance1_ToSomeIpMachineMapping
    RPortPrototype1_RequiredSomeipServiceInstance1_ToSomeIpMachineMapping
    PPortPrototype1_ProvidedSomeipServiceInstance2_ToSomeIpMachineMapping
    RPortPrototype2_RequiredSomeipServiceInstance2_ToSomeIpMachineMapping
    RPortPrototype1_RequiredSomeipServiceInstance3_ToSomeIpMachineMapping: service-instance=IflytekAlarmInfoCameraNodeAroundView_RequiredSomeipCameraNodeAroundView
    RPortPrototype1_RequiredSomeipServiceInstance4_ToSomeIpMachineMapping: service-instance=IflytekAlarmInfoSocACommunication_RequiredSomeipServiceInstance4
    RPortPrototype1_RequiredSomeipServiceInstance5_ToSomeIpMachineMapping: service-instance=IflytekAlarmInfoGnssServiceNode_RequiredSomeipServiceInstance5
    RPortPrototype1_RequiredSomeipServiceInstance6_ToSomeIpMachineMapping: service-instance=IflytekAlarmInfoEhr_RequiredSomeipServiceInstance6
    RPortPrototype1_RequiredSomeipServiceInstance8_ToSomeIpMachineMapping: service-instance=IflytekAlarmInfoLocalization_RequiredSomeipServiceInstance8
    RPortPrototype1_RequiredSomeipServiceInstance9_ToSomeIpMachineMapping: service-instance=IflytekAlarmInfoSocBCommunication_RequiredSomeipServiceInstance9
    RPortPrototype1_RequiredSomeipServiceInstance14_ToSomeIpMachineMapping: service-instance=IflytekAlarmInfoCameraNodePanoramaView_RequiredSomeipServiceInstance14
    RPortPrototype1_RequiredSomeipServiceInstance15_ToSomeIpMachineMapping: service-instance=IflytekAlarmInfoPanoramaViewCameraPerception_RequiredSomeipServiceInstance15
    RPortPrototype1_RequiredSomeipServiceInstance23_ToSomeIpMachineMapping
    RPortPrototype1_RequiredSomeipServiceInstance21_ToSomeIpMachineMapping
  5 x dds service instance to machine mapping, all with communication-connector=InnerEthernetCommConnector:
    IflytekCameraPerceptionTrafficSignRecognition_DdsProvidedServiceInstance68_ToDdsMachineMapping: service-instance=IflytekCameraPerceptionTrafficSignRecognition_DdsProvidedServiceInstance68
    IflytekFusionParkingSlot_DdsProvidedServiceInstance6_ToDdsMachineMapping: service-instance=IflytekFusionParkingSlot_DdsProvidedServiceInstance6
    IflytekFusionRoadFusion_compress_DdsProvidedServiceInstance5_ToDdsMachineMapping: service-instance=IflytekFusionRoadFusion_compress_DdsProvidedServiceInstance5
    IflytekMegaLocalMap_DdsRequiredServiceInstance167_ToDdsMachineMapping: service-instance=IflytekMegaLocalMap_DdsRequiredServiceInstance167
    IflytekLocalizationEgomotion_DdsProvidedServiceInstance70_ToDdsMachineMapping: service-instance=IflytekLocalizationEgomotion_DdsProvidedServiceInstance70
  someip service instance to machine mapping RPortPrototype1_RequiredSomeipServiceInstance20_ToSomeIpMachineMapping: communication-connector=InnerEthernetCommConnector, service-instance=IflytekAlarmInfoStaticFusion_RequiredSomeipServiceInstance20, tcp-port=0
  25 x dds service instance to machine mapping, all with communication-connector=InnerEthernetCommConnector:
    RPortPrototype1_DdsRequiredServiceInstance134_ToDdsMachineMapping: service-instance=IflytekLocalizationEgomotion_DdsRequiredServiceInstance134
    RPortPrototype1_DdsRequiredServiceInstance134_ToDdsMachineMapping: service-instance=IflytekEhrSdmapInfo_DdsRequiredServiceInstance134
    RPortPrototype1_DdsRequiredServiceInstance135_ToDdsMachineMapping: service-instance=IflytekCameraPerceptionLaneLines_DdsRequiredServiceInstance135
    RPortPrototype1_DdsRequiredServiceInstance135_ToDdsMachineMapping: service-instance=IflytekCameraPerceptionLaneTopo_DdsRequiredServiceInstance135
    RPortPrototype1_DdsRequiredServiceInstance135_ToDdsMachineMapping: service-instance=IflytekCameraPerceptionParkingSlotList_DdsRequiredServiceInstance135
    RPortPrototype1_DdsRequiredServiceInstance136_ToDdsMachineMapping: service-instance=IflytekCameraPerceptionGroundLine_DdsRequiredServiceInstance136
    RPortPrototype1_DdsRequiredServiceInstance137_ToDdsMachineMapping: service-instance=IflytekCameraPerceptionParkingLaneLine_DdsRequiredServiceInstance137
    RPortPrototype1_DdsRequiredServiceInstance135_ToDdsMachineMapping: service-instance=IflytekCameraPerceptionDeceler_DdsRequiredServiceInstance135
    RPortPrototype1_DdsRequiredServiceInstance139_ToDdsMachineMapping: service-instance=IflytekLocalizationEgomotion_DdsRequiredServiceInstance139
    RPortPrototype1_DdsRequiredServiceInstance138_ToDdsMachineMapping: service-instance=IflytekEhrSdmapInfo_DdsRequiredServiceInstance138
    RPortPrototype1_DdsRequiredServiceInstance140_ToDdsMachineMapping: service-instance=IflytekSensorGnss_DdsRequiredServiceInstance140
    IflytekLocalizationSemanticInfo_DdsProvidedServiceInstance75_ToDdsMachineMapping: service-instance=IflytekLocalizationSemanticInfo_DdsProvidedServiceInstance75
    RPortPrototype1_DdsRequiredServiceInstance142_ToDdsMachineMapping: service-instance=IflytekLocalizationSemanticInfo_DdsRequiredServiceInstance142
    IflytekLocalizationSemanticInfo_DdsProvidedServiceInstance76_ToDdsMachineMapping: service-instance=IflytekLocalizationSemanticInfo_DdsProvidedServiceInstance76
    RPortPrototype1_DdsRequiredServiceInstance143_ToDdsMachineMapping: service-instance=[IflytekMegaMappingStatus_DdsRequiredServiceInstance143, IflytekFusionOccupancyObjects_DdsRequiredServiceInstance141]
    RPortPrototype1_DdsRequiredServiceInstance145_ToDdsMachineMapping: service-instance=IflytekMegaLocalMap_DdsRequiredServiceInstance145
    IflytekMegaLocalMap_DdsProvidedServiceInstance78_ToDdsMachineMapping: service-instance=IflytekMegaLocalMap_DdsProvidedServiceInstance78
    RPortPrototype1_DdsRequiredServiceInstance146_ToDdsMachineMapping: service-instance=IflytekMegaLocalMap_DdsRequiredServiceInstance146
    IflytekEhrStaticMap_DdsProvidedServiceInstance80_ToDdsMachineMapping: service-instance=IflytekEhrStaticMap_DdsProvidedServiceInstance80
    RPortPrototype1_DdsRequiredServiceInstance152_ToDdsMachineMapping: service-instance=IflytekEhrStaticMap_DdsRequiredServiceInstance152
    IflytekEhrStaticMap_DdsProvidedServiceInstance81_ToDdsMachineMapping: service-instance=IflytekEhrStaticMap_DdsProvidedServiceInstance81
    RPortPrototype1_DdsRequiredServiceInstance153_ToDdsMachineMapping: service-instance=IflytekEhrStaticMap_DdsRequiredServiceInstance153
    IflytekSensorCameraFront120FullResolutionH265_DdsProvidedServiceInstance87_ToDdsMachineMapping: service-instance=IflytekSensorCameraFront120FullResolutionH265_DdsProvidedServiceInstance87
    RPortPrototype1_DdsRequiredServiceInstance161_ToDdsMachineMapping: service-instance=IflytekSensorCameraFront120FullResolutionH265_DdsRequiredServiceInstance161
    IflytekSensorCameraFront120FullResolutionH265_DdsProvidedServiceInstance88_ToDdsMachineMapping: service-instance=IflytekSensorCameraFront120FullResolutionH265_DdsProvidedServiceInstance88
  5 x someip service instance to machine mapping, all with communication-connector=InnerEthernetCommConnector, tcp-port=0:
    IflytekSensorGetSurroundCalibrationIntrlParam_ProvidedSomeipServiceInstance6_ToSomeIpMachineMapping: service-instance=IflytekSensorGetSurroundCameraIntriParam_ProvidedSomeipCameraNodeAroundView
    IflytekSensorGetPanoramaCalibrationIntrlParam_ProvidedSomeipServiceInstance7_ToSomeIpMachineMapping: service-instance=IflytekSensorGetPanoramaCameraIntriParam_ProvidedSomeipServiceInstance7
    RPortPrototype1_RequiredSomeipServiceInstance24_ToSomeIpMachineMapping: service-instance=IflytekSensorGetPanoramaCameraIntriParam_RequiredSomeipServiceInstance24
    IflytekSensorGetPanoramaCalibrationIntrlParam_ProvidedSomeipServiceInstance8_ToSomeIpMachineMapping: service-instance=IflytekSensorGetPanoramaCameraIntriParam_ProvidedSomeipServiceInstance8
    IflytekSensorWriteCalibrationFile_ProvidedSomeipServiceInstance9_ToSomeIpMachineMapping: service-instance=IflytekSensorWriteFile_ProvidedSomeipServiceInstance9
  32 x dds service instance to machine mapping, all with communication-connector=InnerEthernetCommConnector:
    IflytekAlarmInfoSoc_DdsProvidedServiceInstance93_ToDdsMachineMapping: service-instance=IflytekAlarmInfoSoc_DdsProvidedServiceInstance93
    RPortPrototype1_DdsRequiredServiceInstance166_ToDdsMachineMapping: service-instance=IflytekAlarmInfoSoc_DdsRequiredServiceInstance166
    IflytekSensorCameraSurroundFrontFullResolutionH265_DdsProvidedServiceInstance93_ToDdsMachineMapping: service-instance=IflytekSensorCameraSurroundFrontFullResolutionH265_DdsProvidedCameraNodeAroundView
    IflytekSensorCameraSurroundLeftFullResolutionH265_DdsProvidedServiceInstance94_ToDdsMachineMapping: service-instance=IflytekSensorCameraSurroundLeftFullResolutionH265_DdsProvidedCameraNodeAroundView
    IflytekSensorCameraSurroundRearFullResolutionH265_DdsProvidedServiceInstance95_ToDdsMachineMapping: service-instance=IflytekSensorCameraSurroundRearFullResolutionH265_DdsProvidedCameraNodeAroundView
    IflytekSensorCameraSurroundRightFullResolutionH265_DdsProvidedServiceInstance96_ToDdsMachineMapping: service-instance=IflytekSensorCameraSurroundRightFullResolutionH265_DdsProvidedCameraNodeAroundView
    IflytekSensorCameraFront30FullResolutionH265_DdsProvidedServiceInstance97_ToDdsMachineMapping: service-instance=IflytekSensorCameraFront30FullResolutionH265_DdsProvidedServiceInstance97
    RPortPrototype1_DdsRequiredServiceInstance163_ToDdsMachineMapping: service-instance=IflytekSensorCameraFront30FullResolutionH265_DdsRequiredServiceInstance163
    IflytekSensorCameraSideFlFullResolutionH265_DdsProvidedServiceInstance98_ToDdsMachineMapping: service-instance=IflytekSensorCameraSideFlFullResolutionH265_DdsProvidedServiceInstance98
    RPortPrototype1_DdsRequiredServiceInstance164_ToDdsMachineMapping: service-instance=IflytekSensorCameraSideFlFullResolutionH265_DdsRequiredServiceInstance164
    IflytekSensorCameraSideFrFullResolutionH265_DdsProvidedServiceInstance99_ToDdsMachineMapping: service-instance=IflytekSensorCameraSideFrFullResolutionH265_DdsProvidedServiceInstance99
    RPortPrototype1_DdsRequiredServiceInstance165_ToDdsMachineMapping: service-instance=IflytekSensorCameraSideFrFullResolutionH265_DdsRequiredServiceInstance165
    IflytekSensorCameraSideRlFullResolutionH265_DdsProvidedServiceInstance100_ToDdsMachineMapping: service-instance=IflytekSensorCameraSideRlFullResolutionH265_DdsProvidedServiceInstance100
    RPortPrototype1_DdsRequiredServiceInstance166_ToDdsMachineMapping: service-instance=IflytekSensorCameraSideRlFullResolutionH265_DdsRequiredServiceInstance166
    IflytekSensorCameraSideRrFullResolutionH265_DdsProvidedServiceInstance101_ToDdsMachineMapping: service-instance=IflytekSensorCameraSideRrFullResolutionH265_DdsProvidedServiceInstance101
    RPortPrototype1_DdsRequiredServiceInstance167_ToDdsMachineMapping: service-instance=IflytekSensorCameraSideRrFullResolutionH265_DdsRequiredServiceInstance167
    IflytekSensorCameraFront30FullResolutionH265_DdsProvidedServiceInstance104_ToDdsMachineMapping: service-instance=IflytekSensorCameraFront30FullResolutionH265_DdsProvidedServiceInstance104
    IflytekSensorCameraSideFlFullResolutionH265_DdsProvidedServiceInstance105_ToDdsMachineMapping: service-instance=IflytekSensorCameraSideFlFullResolutionH265_DdsProvidedServiceInstance105
    IflytekSensorCameraSideFrFullResolutionH265_DdsProvidedServiceInstance106_ToDdsMachineMapping: service-instance=IflytekSensorCameraSideFrFullResolutionH265_DdsProvidedServiceInstance106
    IflytekSensorCameraSideRlFullResolutionH265_DdsProvidedServiceInstance107_ToDdsMachineMapping: service-instance=IflytekSensorCameraSideRlFullResolutionH265_DdsProvidedServiceInstance107
    IflytekSensorCameraSideRrFullResolutionH265_DdsProvidedServiceInstance108_ToDdsMachineMapping: service-instance=IflytekSensorCameraSideRrFullResolutionH265_DdsProvidedServiceInstance108
    RPortPrototype1_DdsRequiredServiceInstance174_ToDdsMachineMapping: service-instance=IflytekRadarFmPerception4dPointCloud_DdsRequiredServiceInstance174
    RPortPrototype1_DdsRequiredServiceInstance175_ToDdsMachineMapping: service-instance=IflytekRadarFmPerception4dTarget_DdsRequiredServiceInstance175
    RPortPrototype1_DdsRequiredServiceInstance177_ToDdsMachineMapping: service-instance=IflytekLocalizationEgomotion_DdsRequiredServiceInstance177
    RPortPrototype1_DdsRequiredServiceInstance172_ToDdsMachineMapping: service-instance=IflytekCameraPerceptionObjects_DdsRequiredServiceInstance172
    IflytekSensorCameraRearFullResolutionH265MDCA_DdsProvidedServiceInstance111_ToDdsMachineMapping: service-instance=IflytekSensorCameraRearFullResolutionH265MDCA_DdsProvidedCameraNodeAroundView
    IflytekSensorCameraRearMDCA_DdsProvidedServiceInstance112_ToDdsMachineMapping: service-instance=IflytekSensorCameraRearMDCA_DdsProvidedCameraNodeAroundView
    RPortPrototype1_DdsRequiredServiceInstance177_ToDdsMachineMapping: service-instance=IflytekSensorCameraRearMDCA_DdsRequiredServiceInstance177
    IflytekSensorCameraRearMDCA_DdsProvidedServiceInstance113_ToDdsMachineMapping: service-instance=IflytekSensorCameraRearMDCA_DdsProvidedServiceInstance113
    RPortPrototype1_DdsRequiredServiceInstance184_ToDdsMachineMapping: service-instance=IflytekCameraPerceptionTrafficSignRecognition_DdsRequiredServiceInstance184
    RPortPrototype1_DdsRequiredServiceInstance188_ToDdsMachineMapping: service-instance=IflytekRadarFmPerception4dTarget_DdsRequiredServiceInstance188
    RPortPrototype1_DdsRequiredServiceInstance197_ToDdsMachineMapping: service-instance=IflytekSensorCameraRearMDCA_DdsRequiredServiceInstance197
  someip service instance to machine mapping RPortPrototype1_RequiredSomeipServiceInstance22_ToSomeIpMachineMapping: communication-connector=InnerEthernetCommConnector, service-instance=IflytekConfigManager_RequiredSomeipServiceInstance22, tcp-port=0
  someip service instance to machine mapping IflytekAlarmInfoMdcB_ProvidedSomeipServiceInstance13_ToSomeIpMachineMapping: communication-connector=InnerEthernetCommConnector, service-instance=IflytekAlarmInfoMdcB_ProvidedSomeipServiceInstance13, tcp-port=0
  21 x dds service instance to machine mapping, all with communication-connector=InnerEthernetCommConnector:
    IflytekEhrSdpromapInfo_DdsProvidedServiceInstance144_ToDdsMachineMapping: service-instance=IflytekEhrSdpromapInfo_DdsProvidedServiceInstance144
    RPortPrototype1_DdsRequiredServiceInstance199_ToDdsMachineMapping: service-instance=IflytekEhrSdpromapInfo_DdsRequiredServiceInstance199
    IflytekEhrSdpromapInfo_DdsProvidedServiceInstance145_ToDdsMachineMapping: service-instance=IflytekEhrSdpromapInfo_DdsProvidedServiceInstance145
    RPortPrototype1_DdsRequiredServiceInstance202_ToDdsMachineMapping: service-instance=IflytekEhrSdpromapInfo_DdsRequiredServiceInstance202
    RPortPrototype1_DdsRequiredServiceInstance203_ToDdsMachineMapping: service-instance=IflytekEhrSdpromapInfo_DdsRequiredServiceInstance203
    IflytekCameraPerceptionOccGrid_DdsProvidedServiceInstance146_ToDdsMachineMapping: service-instance=IflytekCameraPerceptionOccGrid_DdsProvidedServiceInstance146
    RPortPrototype1_DdsRequiredServiceInstance206_ToDdsMachineMapping: service-instance=IflytekCameraPerceptionOccGrid_DdsRequiredServiceInstance206
    RPortPrototype1_DdsRequiredServiceInstance87_ToDdsMachineMapping: service-instance=IflytekSensorCameraSideRr_DdsRequiredServiceInstance87
    RPortPrototype1_DdsRequiredServiceInstance88_ToDdsMachineMapping: service-instance=IflytekSensorCameraSideRl_DdsRequiredServiceInstance88
    RPortPrototype1_DdsRequiredServiceInstance90_ToDdsMachineMapping: service-instance=IflytekSensorCameraSideFl_DdsRequiredServiceInstance90
    RPortPrototype1_DdsRequiredServiceInstance91_ToDdsMachineMapping: service-instance=IflytekSensorCameraFront30_DdsRequiredServiceInstance91
    RPortPrototype1_DdsRequiredServiceInstance92_ToDdsMachineMapping: service-instance=IflytekSensorCameraFront120FullResolutionH265_DdsRequiredServiceInstance92
    RPortPrototype1_DdsRequiredServiceInstance93_ToDdsMachineMapping: service-instance=IflytekSensorCameraSurroundResizeImageFront_DdsRequiredServiceInstance93
    RPortPrototype2_DdsRequiredServiceInstance94_ToDdsMachineMapping: service-instance=IflytekSensorCameraSurroundResizeImageLeft_DdsRequiredServiceInstance94
    RPortPrototype3_DdsRequiredServiceInstance95_ToDdsMachineMapping: service-instance=IflytekSensorCameraSurroundResizeImageRear_DdsRequiredServiceInstance95
    RPortPrototype4_DdsRequiredServiceInstance96_ToDdsMachineMapping: service-instance=IflytekSensorCameraSurroundResizeImageRight_DdsRequiredServiceInstance96
    IflytekSensorCameraSurroundResizeImageLeft_DdsProvidedServiceInstance72_ToDdsMachineMapping
    IflytekSensorCameraSurroundResizeImageRear_DdsProvidedServiceInstance73_ToDdsMachineMapping: service-instance=IflytekSensorCameraSurroundResizeImageRear_DdsProvidedServiceInstance73
    RPortPrototype3_DdsRequiredServiceInstance99_ToDdsMachineMapping: service-instance=IflytekSensorCameraSurroundResizeImageRear_DdsRequiredServiceInstance99
    IflytekSensorCameraSurroundResizeImageRight_DdsProvidedServiceInstance74_ToDdsMachineMapping: service-instance=IflytekSensorCameraSurroundResizeImageRight_DdsProvidedServiceInstance74
    RPortPrototype4_DdsRequiredServiceInstance100_ToDdsMachineMapping: service-instance=IflytekSensorCameraSurroundResizeImageRight_DdsRequiredServiceInstance100
  someip service instance to machine mapping RPortPrototype1_RequiredSomeipServiceInstance16_ToSomeIpMachineMapping: communication-connector=InnerEthernetCommConnector, service-instance=IflytekAlarmInfoCalibration_RequiredSomeipServiceInstance16, tcp-port=0
  42 x dds service instance to machine mapping, all with communication-connector=InnerEthernetCommConnector:
    IflytekSensorImu_DdsProvidedServiceInstance74_ToDdsMachineMapping: service-instance=IflytekSensorImu_DdsProvidedComServicePncNode
    RPortPrototype1_DdsRequiredServiceInstance101_ToDdsMachineMapping: service-instance=IflytekSensorImu_DdsRequiredServiceInstance101
    IflytekVehicleService_DdsProvidedServiceInstance75_ToDdsMachineMapping: service-instance=IflytekVehicleService_DdsProvidedComServicePncNode
    RPortPrototype2_DdsRequiredServiceInstance102_ToDdsMachineMapping: service-instance=IflytekVehicleService_DdsRequiredServiceInstance102
    IflytekHmiMcuToSocBsw_DdsProvidedServiceInstance77_ToDdsMachineMapping: service-instance=IflytekHmiMcuToSocBsw_DdsProvidedComServicePncNode
    RPortPrototype1_DdsRequiredServiceInstance104_ToDdsMachineMapping: service-instance=IflytekHmiMcuToSocBsw_DdsRequiredServiceInstance104
    IflytekUssUsswaveInfo_DdsProvidedServiceInstance78_ToDdsMachineMapping: service-instance=IflytekUssUsswaveInfo_DdsProvidedComServicePncNode
    IflytekSensorMcuToFmInfo_DdsProvidedServiceInstance79_ToDdsMachineMapping: service-instance=IflytekSensorMcuToFmInfo_DdsProvidedComServicePncNode
    IflytekAlarmInfoMcu_DdsProvidedServiceInstance80_ToDdsMachineMapping: service-instance=IflytekAlarmInfoMcu_DdsProvidedComServicePncNode
    IflytekRadarFmPerceptionInfo_DdsProvidedServiceInstance81_ToDdsMachineMapping: service-instance=IflytekRadarFmPerceptionInfo_DdsProvidedComServicePncNode
    RPortPrototype1_DdsRequiredServiceInstance106_ToDdsMachineMapping: service-instance=IflytekRadarFmPerceptionInfo_DdsRequiredServiceInstance106
    IflytekRadarFlPerceptionInfo_DdsProvidedServiceInstance82_ToDdsMachineMapping: service-instance=IflytekRadarFlPerceptionInfo_DdsProvidedComServicePncNode
    RPortPrototype2_DdsRequiredServiceInstance107_ToDdsMachineMapping: service-instance=IflytekRadarFlPerceptionInfo_DdsRequiredServiceInstance107
    IflytekRadarFrPerceptionInfo_DdsProvidedServiceInstance83_ToDdsMachineMapping: service-instance=IflytekRadarFrPerceptionInfo_DdsProvidedComServicePncNode
    RPortPrototype3_DdsRequiredServiceInstance108_ToDdsMachineMapping: service-instance=IflytekRadarFrPerceptionInfo_DdsRequiredServiceInstance108
    IflytekRadarRlPerceptionInfo_DdsProvidedServiceInstance84_ToDdsMachineMapping: service-instance=IflytekRadarRlPerceptionInfo_DdsProvidedComServicePncNode
    RPortPrototype4_DdsRequiredServiceInstance109_ToDdsMachineMapping: service-instance=IflytekRadarRlPerceptionInfo_DdsRequiredServiceInstance109
    IflytekRadarRrPerceptionInfo_DdsProvidedServiceInstance85_ToDdsMachineMapping: service-instance=IflytekRadarRrPerceptionInfo_DdsProvidedComServicePncNode
    RPortPrototype5_DdsRequiredServiceInstance110_ToDdsMachineMapping: service-instance=IflytekRadarRrPerceptionInfo_DdsRequiredServiceInstance110
    IflytekSensorImu_DdsProvidedServiceInstance88_ToDdsMachineMapping: service-instance=IflytekSensorImu_DdsProvidedServiceInstance88
    RPortPrototype1_DdsRequiredServiceInstance113_ToDdsMachineMapping: service-instance=IflytekSensorImu_DdsRequiredServiceInstance113
    IflytekVehicleService_DdsProvidedServiceInstance89_ToDdsMachineMapping: service-instance=IflytekVehicleService_DdsProvidedServiceInstance89
    RPortPrototype1_DdsRequiredServiceInstance114_ToDdsMachineMapping: service-instance=IflytekVehicleService_DdsRequiredServiceInstance114
    RPortPrototype1_DdsRequiredServiceInstance115_ToDdsMachineMapping: service-instance=IflytekVehicleService_DdsRequiredServiceInstance115
    IflytekHmiMcuToSocBsw_DdsProvidedServiceInstance90_ToDdsMachineMapping: service-instance=IflytekHmiMcuToSocBsw_DdsProvidedServiceInstance90
    RPortPrototype1_DdsRequiredServiceInstance116_ToDdsMachineMapping: service-instance=IflytekSensorImu_DdsRequiredServiceInstance116
    RPortPrototype1_DdsRequiredServiceInstance117_ToDdsMachineMapping: service-instance=IflytekVehicleService_DdsRequiredServiceInstance117
    RPortPrototype1_DdsRequiredServiceInstance118_ToDdsMachineMapping: service-instance=IflytekLocalizationEgomotion_DdsRequiredServiceInstance118
    IflytekCameraPerceptionObjects_DdsProvidedServiceInstance91_ToDdsMachineMapping: service-instance=IflytekCameraPerceptionObjects_DdsProvidedServiceInstance91
    RPortPrototype1_DdsRequiredServiceInstance119_ToDdsMachineMapping: service-instance=IflytekCameraPerceptionObjects_DdsRequiredServiceInstance119
    IflytekFusionObjects_DdsProvidedServiceInstance92_ToDdsMachineMapping: service-instance=IflytekFusionObjects_DdsProvidedServiceInstance92
    RPortPrototype1_DdsRequiredServiceInstance120_ToDdsMachineMapping: service-instance=IflytekFusionObjects_DdsRequiredServiceInstance120
    IflytekCalibrationCalibInfo_DdsProvidedServiceInstance94_ToDdsMachineMapping: service-instance=IflytekCalibrationCalibInfo_DdsProvidedCalibration
    RPortPrototype1_DdsRequiredServiceInstance122_ToDdsMachineMapping: service-instance=IflytekCalibrationCalibInfo_DdsRequiredSocBCommunication
    IflytekMegaMappingStatus_DdsProvidedServiceInstance94_ToDdsMachineMapping: service-instance=IflytekMegaMappingStatus_DdsProvidedServiceInstance94
    IflytekFusionObjectsCompress_DdsProvidedServiceInstance95_ToDdsMachineMapping: service-instance=IflytekFusionObjectsCompress_DdsProvidedServiceInstance95
    RPortPrototype1_DdsRequiredServiceInstance126_ToDdsMachineMapping: service-instance=IflytekFusionObjectsCompress_DdsRequiredComServicePncNode
    RPortPrototype1_DdsRequiredServiceInstance126_ToDdsMachineMapping: service-instance=IflytekFmMcuInfo_DdsRequiredComServicePncNode
    RPortPrototype1_DdsRequiredServiceInstance127_ToDdsMachineMapping: service-instance=IflytekFusionRoadFusionCompress_DdsRequiredComServicePncNode
    RPortPrototype1_DdsRequiredServiceInstance128_ToDdsMachineMapping: service-instance=IflytekHmiSocToMcuBsw_DdsRequiredServiceInstance128
    IflytekHmiSocToMcuBsw_DdsProvidedServiceInstance96_ToDdsMachineMapping: service-instance=IflytekHmiSocToMcuBsw_DdsProvidedServiceInstance96
    RPortPrototype1_DdsRequiredServiceInstance129_ToDdsMachineMapping: service-instance=IflytekHmiSocToMcuBsw_DdsRequiredComServicePncNode
  someip service instance to machine mapping RPortPrototype1_RequiredSomeipServiceInstance17_ToSomeIpMachineMapping: communication-connector=InnerEthernetCommConnector, service-instance=IflytekAlarmInfoComServicePncNode_RequiredSomeipComServicePncNode, tcp-port=0
  24 x dds service instance to machine mapping, all with communication-connector=InnerEthernetCommConnector:
    RPortPrototype1_DdsRequiredServiceInstance130_ToDdsMachineMapping: service-instance=IflytekLocalizationEgomotion_DdsRequiredComServicePncNode
    IflytekPlanningPlan_DdsProvidedServiceInstance98_ToDdsMachineMapping: service-instance=IflytekPlanningPlan_DdsProvidedServiceInstance98
    RPortPrototype1_DdsRequiredServiceInstance132_ToDdsMachineMapping: service-instance=IflytekPlanningPlan_DdsRequiredComServicePncNode
    IflytekControlControlCommand_DdsProvidedServiceInstance99_ToDdsMachineMapping: service-instance=IflytekControlControlCommand_DdsProvidedServiceInstance99
    RPortPrototype1_DdsRequiredServiceInstance133_ToDdsMachineMapping: service-instance=IflytekControlControlCommand_DdsRequiredComServicePncNode
    RPortPrototype1_DdsRequiredServiceInstance134_ToDdsMachineMapping: service-instance=IflytekUssUsswaveInfo_DdsRequiredServiceInstance134
    IflytekRadarFmPerception4dTarget_DdsProvidedServiceInstance100_ToDdsMachineMapping: service-instance=IflytekRadarFmPerception4dTarget_DdsProvidedServiceInstance100
    RPortPrototype1_DdsRequiredServiceInstance135_ToDdsMachineMapping: service-instance=IflytekRadarFmPerception4dTarget_DdsRequiredServiceInstance135
    RPortPrototype1_DdsRequiredServiceInstance137_ToDdsMachineMapping: service-instance=IflytekVehicleService_DdsRequiredServiceInstance137
    RPortPrototype1_DdsRequiredServiceInstance138_ToDdsMachineMapping: service-instance=IflytekLocalizationEgomotion_DdsRequiredServiceInstance138
    RPortPrototype1_DdsRequiredServiceInstance139_ToDdsMachineMapping: service-instance=IflytekPredictionPredictionResult_DdsRequiredServiceInstance139
    IflytekFusionUssPerceptionInfo_DdsProvidedServiceInstance102_ToDdsMachineMapping: service-instance=IflytekFusionUssPerceptionInfo_DdsProvidedServiceInstance102
    RPortPrototype1_DdsRequiredServiceInstance140_ToDdsMachineMapping: service-instance=IflytekFusionUssPerceptionInfo_DdsRequiredServiceInstance140
    IflytekFusionSpatialParkingSlot_DdsProvidedServiceInstance103_ToDdsMachineMapping: service-instance=IflytekFusionSpatialParkingSlot_DdsProvidedServiceInstance103
    IflytekFusionOccupancyObjects_DdsProvidedServiceInstance103_ToDdsMachineMapping: service-instance=IflytekFusionOccupancyObjects_DdsProvidedServiceInstance103
    RPortPrototype1_DdsRequiredServiceInstance141_ToDdsMachineMapping
    IflytekFusionObjects_DdsProvidedServiceInstance104_ToDdsMachineMapping: service-instance=IflytekFusionObjects_DdsProvidedServiceInstance104
    RPortPrototype1_DdsRequiredServiceInstance142_ToDdsMachineMapping: service-instance=IflytekFusionObjects_DdsRequiredServiceInstance142
    RPortPrototype1_DdsRequiredServiceInstance143_ToDdsMachineMapping: service-instance=IflytekFusionObjects_DdsRequiredServiceInstance143
    RPortPrototype1_DdsRequiredServiceInstance145_ToDdsMachineMapping: service-instance=IflytekFusionParkingSlot_DdsRequiredServiceInstance145
    RPortPrototype1_DdsRequiredServiceInstance146_ToDdsMachineMapping: service-instance=IflytekFusionParkingSlot_DdsRequiredServiceInstance146
    RPortPrototype1_DdsRequiredServiceInstance148_ToDdsMachineMapping: service-instance=IflytekCameraPerceptionOccupancyObjects_DdsRequiredServiceInstance148
    RPortPrototype1_DdsRequiredServiceInstance149_ToDdsMachineMapping: service-instance=[IflytekCameraPerception3dGeneralObjects_DdsRequiredServiceInstance149, IflytekCameraPerceptionObjects_DdsRequiredServiceInstance150]
    RPortPrototype1_DdsRequiredServiceInstance150_ToDdsMachineMapping
  someip service instance to machine mapping RPortPrototype1_RequiredSomeipServiceInstance18_ToSomeIpMachineMapping: communication-connector=InnerEthernetCommConnector, service-instance=IflytekAlarmInfoObstacleFusion_RequiredSomeipServiceInstance18, tcp-port=0
  20 x dds service instance to machine mapping, all with communication-connector=InnerEthernetCommConnector:
    RPortPrototype1_DdsRequiredServiceInstance151_ToDdsMachineMapping: service-instance=IflytekEhrStaticMap_DdsRequiredServiceInstance151
    RPortPrototype1_DdsRequiredServiceInstance152_ToDdsMachineMapping: service-instance=IflytekEhrSdmapInfo_DdsRequiredServiceInstance152
    RPortPrototype1_DdsRequiredServiceInstance153_ToDdsMachineMapping: service-instance=IflytekEhrSdpromapInfo_DdsRequiredServiceInstance153
    RPortPrototype1_DdsRequiredServiceInstance154_ToDdsMachineMapping: service-instance=IflytekLocalizationEgomotion_DdsRequiredServiceInstance154
    RPortPrototype1_DdsRequiredServiceInstance155_ToDdsMachineMapping: service-instance=IflytekUssUsswaveInfo_DdsRequiredServiceInstance155
    RPortPrototype1_DdsRequiredServiceInstance156_ToDdsMachineMapping: service-instance=IflytekVehicleService_DdsRequiredServiceInstance156
    IflytekFusionGroundLine_DdsProvidedServiceInstance103_ToDdsMachineMapping: service-instance=IflytekFusionGroundLine_DdsProvidedServiceInstance103
    RPortPrototype1_DdsRequiredServiceInstance157_ToDdsMachineMapping: service-instance=IflytekFusionGroundLine_DdsRequiredServiceInstance157
    IflytekFusionSpeedBump_DdsProvidedServiceInstance103_ToDdsMachineMapping: service-instance=IflytekFusionSpeedBump_DdsProvidedServiceInstance103
    RPortPrototype1_DdsRequiredServiceInstance157_ToDdsMachineMapping: service-instance=IflytekFusionSpeedBump_DdsRequiredServiceInstance157
    IflytekCameraPerceptionScene_DdsProvidedServiceInstance104_ToDdsMachineMapping: service-instance=IflytekCameraPerceptionScene_DdsProvidedServiceInstance104
    RPortPrototype1_DdsRequiredServiceInstance158_ToDdsMachineMapping: service-instance=IflytekCameraPerceptionScene_DdsRequiredServiceInstance158
    IflytekCameraPerceptionScene_DdsProvidedServiceInstance105_ToDdsMachineMapping: service-instance=IflytekCameraPerceptionScene_DdsProvidedServiceInstance105
    RPortPrototype1_DdsRequiredServiceInstance157_ToDdsMachineMapping: service-instance=IflytekCameraPerceptionScene_DdsRequiredServiceInstance157
    IflytekCameraPerceptionOccGrid_DdsProvidedServiceInstance107_ToDdsMachineMapping: service-instance=IflytekCameraPerceptionOccGrid_DdsProvidedServiceInstance107
    RPortPrototype1_DdsRequiredServiceInstance159_ToDdsMachineMapping: service-instance=IflytekCameraPerceptionOccGrid_DdsRequiredServiceInstance159
    RPortPrototype1_DdsRequiredServiceInstance161_ToDdsMachineMapping: service-instance=IflytekControlControlCommand_DdsRequiredServiceInstance161
    RPortPrototype1_DdsRequiredServiceInstance162_ToDdsMachineMapping: service-instance=IflytekPlanningPlan_DdsRequiredServiceInstance162
    IflytekPlanningHmi_DdsProvidedServiceInstance109_ToDdsMachineMapping: service-instance=IflytekPlanningHmi_DdsProvidedServiceInstance109
    RPortPrototype1_DdsRequiredServiceInstance164_ToDdsMachineMapping: service-instance=IflytekPlanningHmi_DdsRequiredServiceInstance164
  someip service instance to machine mapping RPortPrototype1_RequiredSomeipServiceInstance19_ToSomeIpMachineMapping: communication-connector=InnerEthernetCommConnector, service-instance=IflytekAlarmInfoPlanning_RequiredSomeipServiceInstance19, tcp-port=0
  someip service instance to machine mapping RPortPrototype1_RequiredSomeipServiceInstance20_ToSomeIpMachineMapping: communication-connector=InnerEthernetCommConnector, service-instance=IflytekAlarmInfoControl_RequiredSomeipServiceInstance20, tcp-port=0
  9 x dds service instance to machine mapping, all with communication-connector=InnerEthernetCommConnector:
    RPortPrototype1_DdsRequiredServiceInstance166_ToDdsMachineMapping: service-instance=IflytekLocalizationEgomotion_DdsRequiredServiceInstance166
    RPortPrototype1_DdsRequiredServiceInstance167_ToDdsMachineMapping: service-instance=IflytekVehicleService_DdsRequiredServiceInstance167
    RPortPrototype1_DdsRequiredServiceInstance178_ToDdsMachineMapping: service-instance=IflytekVehicleService_DdsRequiredServiceInstance178
    RPortPrototype1_DdsRequiredServiceInstance183_ToDdsMachineMapping
    RPortPrototype1_DdsRequiredServiceInstance183_ToDdsMachineMapping
    IflytekSensorCameraSurroundResizeImageLeft_DdsProvidedServiceInstance110_ToDdsMachineMapping: service-instance=IflytekSensorCameraSurroundResizeImageLeft_DdsProvidedServiceInstance110
    RPortPrototype1_DdsRequiredServiceInstance176_ToDdsMachineMapping: service-instance=IflytekSensorCameraSurroundResizeImageLeft_DdsRequiredServiceInstance176
    IflytekSensorCameraSurroundResizeImageFront_DdsProvidedServiceInstance110_ToDdsMachineMapping: service-instance=IflytekSensorCameraSurroundResizeImageFront_DdsProvidedServiceInstance110
    RPortPrototype1_DdsRequiredServiceInstance176_ToDdsMachineMapping: service-instance=IflytekSensorCameraSurroundResizeImageFront_DdsRequiredServiceInstance176
  someip service instance to machine mapping RPortPrototype1_RequiredSomeipServiceInstance22_ToSomeIpMachineMapping: communication-connector=InnerEthernetCommConnector, service-instance=IflytekConfigManager_RequiredSomeipCameraNodeAroundView, tcp-port=0
  someip service instance to machine mapping IflytekAlarmInfoMdcA_ProvidedSomeipServiceInstance13_ToSomeIpMachineMapping: communication-connector=InnerEthernetCommConnector, service-instance=IflytekAlarmInfoMdcA_ProvidedSomeipCameraNodeAroundView, tcp-port=0
  4 x dds service instance to machine mapping, all with communication-connector=InnerEthernetCommConnector:
    RPortPrototype1_DdsRequiredServiceInstance176_ToDdsMachineMapping
    RPortPrototype1_DdsRequiredServiceInstance175_ToDdsMachineMapping: service-instance=IflytekSensorCameraRear_DdsRequiredPanoramaViewCameraPerception
    RPortPrototype1_DdsRequiredServiceInstance174_ToDdsMachineMapping: service-instance=IflytekPlanningHmi_DdsRequiredStaticFusion
    RPortPrototype1_DdsRequiredServiceInstance172_ToDdsMachineMapping: service-instance=IflytekPlanningHmi_DdsRequiredControl
  someip service instance to machine mapping RPortPrototype1_RequiredSomeipServiceInstance21_ToSomeIpMachineMapping: communication-connector=InnerEthernetCommConnector, service-instance=IflytekAlarmInfoFiniteStateManager_RequiredSomeipServiceInstance21, tcp-port=0
  dds service instance to machine mapping RPortPrototype1_DdsRequiredServiceInstance143_ToDdsMachineMapping: communication-connector=InnerEthernetCommConnector, service-instance=IflytekVehicleService_DdsRequiredServiceInstance143
  dds service instance to machine mapping RPortPrototype1_DdsRequiredServiceInstance144_ToDdsMachineMapping: communication-connector=InnerEthernetCommConnector, service-instance=IflytekSensorGnss_DdsRequiredServiceInstance144
  someip service instance to machine mapping RPortPrototype1_RequiredSomeipServiceInstance22_ToSomeIpMachineMapping: communication-connector=InnerEthernetCommConnector, service-instance=IflytekConfigManager_RequiredSomeipServiceInstance22, tcp-port=0
  104 x dds service instance to machine mapping, all with communication-connector=InnerEthernetCommConnector:
    RPortPrototype1_DdsRequiredServiceInstance145_ToDdsMachineMapping: service-instance=IflytekEhrSdmapInfo_DdsRequiredServiceInstance145
    RPortPrototype1_DdsRequiredServiceInstance146_ToDdsMachineMapping: service-instance=IflytekEhrSdpromapInfo_DdsRequiredServiceInstance146
    RPortPrototype1_DdsRequiredServiceInstance149_ToDdsMachineMapping: service-instance=IflytekLocalizationEgomotion_DdsRequiredServiceInstance149
    RPortPrototype1_DdsRequiredServiceInstance150_ToDdsMachineMapping: service-instance=IflytekLocalizationSemanticInfo_DdsRequiredServiceInstance150
    RPortPrototype1_DdsRequiredServiceInstance151_ToDdsMachineMapping: service-instance=IflytekMegaMappingStatus_DdsRequiredServiceInstance151
    RPortPrototype1_DdsRequiredServiceInstance152_ToDdsMachineMapping: service-instance=IflytekCameraPerceptionLaneLines_DdsRequiredServiceInstance152
    IflytekCameraPerceptionLaneLines_DdsProvidedServiceInstance100_ToDdsMachineMapping: service-instance=IflytekCameraPerceptionLaneLines_DdsProvidedServiceInstance100
    RPortPrototype1_DdsRequiredServiceInstance153_ToDdsMachineMapping: service-instance=IflytekCameraPerceptionLaneLines_DdsRequiredServiceInstance153
    RPortPrototype1_DdsRequiredServiceInstance154_ToDdsMachineMapping: service-instance=IflytekCameraPerceptionGroundLine_DdsRequiredServiceInstance154
    IflytekCameraPerceptionGroundLine_DdsProvidedServiceInstance101_ToDdsMachineMapping: service-instance=IflytekCameraPerceptionGroundLine_DdsProvidedServiceInstance101
    RPortPrototype1_DdsRequiredServiceInstance155_ToDdsMachineMapping: service-instance=IflytekCameraPerceptionGroundLine_DdsRequiredServiceInstance155
    RPortPrototype1_DdsRequiredServiceInstance156_ToDdsMachineMapping: service-instance=IflytekCameraPerceptionDeceler_DdsRequiredServiceInstance156
    IflytekCameraPerceptionDeceler_DdsProvidedServiceInstance102_ToDdsMachineMapping: service-instance=IflytekCameraPerceptionDeceler_DdsProvidedServiceInstance102
    RPortPrototype1_DdsRequiredServiceInstance157_ToDdsMachineMapping: service-instance=IflytekCameraPerceptionDeceler_DdsRequiredServiceInstance157
    RPortPrototype1_DdsRequiredServiceInstance162_ToDdsMachineMapping: service-instance=IflytekFusionParkingSlot_DdsRequiredServiceInstance162
    IflytekFusionParkingSlot_DdsProvidedServiceInstance104_ToDdsMachineMapping: service-instance=IflytekFusionParkingSlot_DdsProvidedServiceInstance104
    RPortPrototype1_DdsRequiredServiceInstance163_ToDdsMachineMapping: service-instance=IflytekFusionParkingSlot_DdsRequiredServiceInstance163
    RPortPrototype1_DdsRequiredServiceInstance164_ToDdsMachineMapping: service-instance=IflytekFusionSpatialParkingSlot_DdsRequiredServiceInstance164
    IflytekFusionSpatialParkingSlot_DdsProvidedServiceInstance105_ToDdsMachineMapping: service-instance=IflytekFusionSpatialParkingSlot_DdsProvidedServiceInstance105
    RPortPrototype1_DdsRequiredServiceInstance165_ToDdsMachineMapping: service-instance=IflytekFusionSpatialParkingSlot_DdsRequiredServiceInstance165
    RPortPrototype1_DdsRequiredServiceInstance166_ToDdsMachineMapping: service-instance=IflytekFusionObjects_DdsRequiredServiceInstance166
    RPortPrototype1_DdsRequiredServiceInstance167_ToDdsMachineMapping: service-instance=IflytekCalibrationCalibInfo_DdsRequiredServiceInstance167
    RPortPrototype1_DdsRequiredServiceInstance168_ToDdsMachineMapping: service-instance=IflytekPlanningHmi_DdsRequiredServiceInstance168
    RPortPrototype1_DdsRequiredServiceInstance169_ToDdsMachineMapping: service-instance=IflytekPlanningPlan_DdsRequiredServiceInstance169
    IflytekPlanningHmi_DdsProvidedServiceInstance106_ToDdsMachineMapping: service-instance=IflytekPlanningHmi_DdsProvidedServiceInstance106
    RPortPrototype1_DdsRequiredServiceInstance170_ToDdsMachineMapping: service-instance=IflytekPlanningHmi_DdsRequiredServiceInstance170
    IflytekPlanningPlan_DdsProvidedServiceInstance107_ToDdsMachineMapping: service-instance=IflytekPlanningPlan_DdsProvidedServiceInstance107
    RPortPrototype2_DdsRequiredServiceInstance171_ToDdsMachineMapping: service-instance=IflytekPlanningPlan_DdsRequiredServiceInstance171
    RPortPrototype1_DdsRequiredServiceInstance172_ToDdsMachineMapping: service-instance=IflytekHmiInner_DdsRequiredServiceInstance172
    IflytekFsmSocState_DdsProvidedServiceInstance108_ToDdsMachineMapping: service-instance=IflytekFsmSocState_DdsProvidedServiceInstance108
    RPortPrototype1_DdsRequiredServiceInstance{173..177}_ToDdsMachineMapping: service-instance=IflytekFsmSocState_DdsRequiredServiceInstance{173..177}
    IflytekFsmHmiSocOuter_DdsProvidedServiceInstance109_ToDdsMachineMapping: service-instance=IflytekFsmHmiSocOuter_DdsProvidedServiceInstance109
    IflytekFsmSocState_DdsProvidedServiceInstance110_ToDdsMachineMapping: service-instance=IflytekFsmSocState_DdsProvidedSocACommunication
    RPortPrototype1_DdsRequiredServiceInstance{178..181}_ToDdsMachineMapping: service-instance=IflytekFsmSocState_DdsRequiredServiceInstance{178..181}
    RPortPrototype1_DdsRequiredServiceInstance182_ToDdsMachineMapping: service-instance=IflytekFsmSocState_DdsRequiredComServicePncNode
    RPortPrototype1_DdsRequiredServiceInstance183_ToDdsMachineMapping: service-instance=IflytekSensorCameraSurroundFrontFullResolutionH265_DdsRequiredServiceInstance183
    RPortPrototype1_DdsRequiredServiceInstance184_ToDdsMachineMapping: service-instance=IflytekSensorCameraSurroundLeftFullResolutionH265_DdsRequiredServiceInstance184
    RPortPrototype1_DdsRequiredServiceInstance185_ToDdsMachineMapping: service-instance=IflytekSensorCameraSurroundRearFullResolutionH265_DdsRequiredServiceInstance185
    RPortPrototype1_DdsRequiredServiceInstance186_ToDdsMachineMapping: service-instance=IflytekSensorCameraSurroundRightFullResolutionH265_DdsRequiredServiceInstance186
    IflytekSensorCameraSurroundFrontFullResolutionH265_DdsProvidedServiceInstance111_ToDdsMachineMapping: service-instance=IflytekSensorCameraSurroundFrontFullResolutionH265_DdsProvidedServiceInstance111
    IflytekSensorCameraSurroundLeftFullResolutionH265_DdsProvidedServiceInstance112_ToDdsMachineMapping: service-instance=IflytekSensorCameraSurroundLeftFullResolutionH265_DdsProvidedServiceInstance112
    IflytekSensorCameraSurroundRearFullResolutionH265_DdsProvidedServiceInstance113_ToDdsMachineMapping: service-instance=IflytekSensorCameraSurroundRearFullResolutionH265_DdsProvidedServiceInstance113
    IflytekSensorCameraSurroundRightFullResolutionH265_DdsProvidedServiceInstance114_ToDdsMachineMapping: service-instance=IflytekSensorCameraSurroundRightFullResolutionH265_DdsProvidedServiceInstance114
    IflytekSensorCameraRearFullResolutionH265_DdsProvidedServiceInstance115_ToDdsMachineMapping: service-instance=IflytekSensorCameraRearFullResolutionH265_DdsProvidedServiceInstance115
    IflytekFusionRoadFusion_DdsProvidedServiceInstance115_ToDdsMachineMapping: service-instance=IflytekFusionRoadFusion_DdsProvidedServiceInstance115
    RPortPrototype1_DdsRequiredServiceInstance186_ToDdsMachineMapping: service-instance=IflytekFusionRoadFusion_DdsRequiredServiceInstance186
    IflytekCameraPerceptionTrafficSignRecognition_DdsProvidedServiceInstance115_ToDdsMachineMapping: service-instance=IflytekCameraPerceptionTrafficSignRecognition_DdsProvidedServiceInstance115
    RPortPrototype1_DdsRequiredServiceInstance186_ToDdsMachineMapping: service-instance=IflytekCameraPerceptionTrafficSignRecognition_DdsRequiredPlanning
    RPortPrototype1_DdsRequiredServiceInstance187_ToDdsMachineMapping: service-instance=IflytekCameraPerceptionTrafficSignRecognition_DdsRequiredServiceInstance187
    RPortPrototype1_DdsRequiredServiceInstance188_ToDdsMachineMapping: service-instance=IflytekCameraPerceptionLaneTopo_DdsRequiredServiceInstance188
    IflytekCameraPerceptionLaneTopo_DdsProvidedServiceInstance116_ToDdsMachineMapping: service-instance=IflytekCameraPerceptionLaneTopo_DdsProvidedServiceInstance116
    RPortPrototype1_DdsRequiredServiceInstance189_ToDdsMachineMapping: service-instance=IflytekPredictionPredictionResult_DdsRequiredServiceInstance189
    IflytekPredictionPredictionResult_DdsProvidedServiceInstance117_ToDdsMachineMapping: service-instance=IflytekPredictionPredictionResult_DdsProvidedServiceInstance117
    RPortPrototype1_DdsRequiredServiceInstance190_ToDdsMachineMapping: service-instance=IflytekCameraPerceptionOccupancyObjects_DdsRequiredServiceInstance190
    IflytekFusionRoadFusion_DdsProvidedServiceInstance118_ToDdsMachineMapping: service-instance=IflytekFusionRoadFusion_DdsProvidedServiceInstance118
    RPortPrototype1_DdsRequiredServiceInstance191_ToDdsMachineMapping: service-instance=IflytekFusionRoadFusion_DdsRequiredServiceInstance191
    IflytekCameraPerceptionOccupancyObjects_DdsProvidedServiceInstance119_ToDdsMachineMapping: service-instance=IflytekCameraPerceptionOccupancyObjects_DdsProvidedSocBCommunication
    RPortPrototype1_DdsRequiredServiceInstance190_ToDdsMachineMapping: service-instance=IflytekFusionRoadFusion_DdsRequiredServiceInstance190
    RPortPrototype1_DdsRequiredServiceInstance191_ToDdsMachineMapping: service-instance=IflytekCameraPerception3dGeneralObjects_DdsRequiredServiceInstance191
    IflytekCameraPerception3dGeneralObjects_DdsProvidedServiceInstance119_ToDdsMachineMapping: service-instance=IflytekCameraPerception3dGeneralObjects_DdsProvidedServiceInstance119
    RPortPrototype1_DdsRequiredServiceInstance192_ToDdsMachineMapping: service-instance=IflytekCameraPerceptionParkingSlotList_DdsRequiredServiceInstance192
    IflytekCameraPerceptionParkingSlotList_DdsProvidedServiceInstance120_ToDdsMachineMapping: service-instance=IflytekCameraPerceptionParkingSlotList_DdsProvidedServiceInstance120
    RPortPrototype1_DdsRequiredServiceInstance193_ToDdsMachineMapping: service-instance=IflytekCameraPerceptionParkingLaneLine_DdsRequiredServiceInstance193
    IflytekCameraPerceptionParkingLaneLine_DdsProvidedServiceInstance121_ToDdsMachineMapping: service-instance=IflytekCameraPerceptionParkingLaneLine_DdsProvidedServiceInstance121
    RPortPrototype1_DdsRequiredServiceInstance194_ToDdsMachineMapping: service-instance=IflytekFusionObjectsCompress_DdsRequiredServiceInstance194
    IflytekFusionObjectsCompress_DdsProvidedServiceInstance122_ToDdsMachineMapping: service-instance=IflytekFusionObjectsCompress_DdsProvidedServiceInstance122
    RPortPrototype1_DdsRequiredServiceInstance195_ToDdsMachineMapping: service-instance=IflytekFusionUssPerceptionInfo_DdsRequiredServiceInstance195
    IflytekFusionUssPerceptionInfo_DdsProvidedServiceInstance123_ToDdsMachineMapping: service-instance=IflytekFusionUssPerceptionInfo_DdsProvidedServiceInstance123
    RPortPrototype1_DdsRequiredServiceInstance196_ToDdsMachineMapping: service-instance=IflytekFusionOccupancyObjects_DdsRequiredServiceInstance196
    IflytekFusionOccupancyObjects_DdsProvidedServiceInstance124_ToDdsMachineMapping: service-instance=IflytekFusionOccupancyObjects_DdsProvidedSocBCommunication
    RPortPrototype1_DdsRequiredServiceInstance197_ToDdsMachineMapping: service-instance=IflytekFusionRoadFusionCompress_DdsRequiredServiceInstance197
    IflytekFusionRoadFusionCompress_DdsProvidedServiceInstance125_ToDdsMachineMapping: service-instance=IflytekFusionRoadFusionCompress_DdsProvidedServiceInstance125
    RPortPrototype1_DdsRequiredServiceInstance198_ToDdsMachineMapping: service-instance=IflytekFusionGroundLine_DdsRequiredServiceInstance198
    IflytekFusionGroundLine_DdsProvidedServiceInstance126_ToDdsMachineMapping: service-instance=IflytekFusionGroundLine_DdsProvidedServiceInstance126
    RPortPrototype1_DdsRequiredServiceInstance199_ToDdsMachineMapping: service-instance=IflytekFusionSpeedBump_DdsRequiredServiceInstance199
    IflytekFusionSpeedBump_DdsProvidedServiceInstance127_ToDdsMachineMapping: service-instance=IflytekFusionSpeedBump_DdsProvidedServiceInstance127
    RPortPrototype1_DdsRequiredServiceInstance200_ToDdsMachineMapping: service-instance=IflytekUssUsswaveInfo_DdsRequiredServiceInstance200
    IflytekUssUsswaveInfo_DdsProvidedServiceInstance128_ToDdsMachineMapping: service-instance=IflytekUssUsswaveInfo_DdsProvidedServiceInstance128
    RPortPrototype1_DdsRequiredServiceInstance201_ToDdsMachineMapping: service-instance=IflytekRadarFlPerceptionInfo_DdsRequiredServiceInstance201
    RPortPrototype1_DdsRequiredServiceInstance202_ToDdsMachineMapping: service-instance=IflytekRadarFrPerceptionInfo_DdsRequiredServiceInstance202
    IflytekRadarFlPerceptionInfo_DdsProvidedServiceInstance129_ToDdsMachineMapping: service-instance=IflytekRadarFlPerceptionInfo_DdsProvidedServiceInstance129
    RPortPrototype1_DdsRequiredServiceInstance203_ToDdsMachineMapping: service-instance=IflytekRadarRlPerceptionInfo_DdsRequiredServiceInstance203
    IflytekRadarFrPerceptionInfo_DdsProvidedServiceInstance130_ToDdsMachineMapping: service-instance=IflytekRadarFrPerceptionInfo_DdsProvidedServiceInstance130
    IflytekRadarRlPerceptionInfo_DdsProvidedServiceInstance131_ToDdsMachineMapping: service-instance=IflytekRadarRlPerceptionInfo_DdsProvidedServiceInstance131
    RPortPrototype1_DdsRequiredServiceInstance204_ToDdsMachineMapping: service-instance=IflytekRadarRrPerceptionInfo_DdsRequiredServiceInstance204
    IflytekRadarRrPerceptionInfo_DdsProvidedServiceInstance132_ToDdsMachineMapping: service-instance=IflytekRadarRrPerceptionInfo_DdsProvidedServiceInstance132
    IflytekAdasFunctionAdas_DdsProvidedServiceInstance133_ToDdsMachineMapping: service-instance=IflytekAdasFunctionAdas_DdsProvidedComServicePncNode
    RPortPrototype1_DdsRequiredServiceInstance205_ToDdsMachineMapping: service-instance=IflytekAdasFunctionAdas_DdsRequiredServiceInstance205
    IflytekAdasFunctionAdas_DdsProvidedServiceInstance134_ToDdsMachineMapping: service-instance=IflytekAdasFunctionAdas_DdsProvidedSocBCommunication
    RPortPrototype1_DdsRequiredServiceInstance206_ToDdsMachineMapping: service-instance=IflytekControlControlCommand_DdsRequiredServiceInstance206
    IflytekControlControlCommand_DdsProvidedServiceInstance135_ToDdsMachineMapping: service-instance=IflytekControlControlCommand_DdsProvidedServiceInstance135
    RPortPrototype1_DdsRequiredServiceInstance207_ToDdsMachineMapping: service-instance=IflytekAlarmInfoFmAService_DdsRequiredServiceInstance207
    RPortPrototype2_DdsRequiredServiceInstance208_ToDdsMachineMapping: service-instance=IflytekDTCInfoFmAService_DdsRequiredServiceInstance208
    IflytekDTCInfoFmAService_DdsProvidedServiceInstance136_ToDdsMachineMapping: service-instance=IflytekDTCInfoFmAService_DdsProvidedServiceInstance136
    IflytekAlarmInfoFmAService_DdsProvidedServiceInstance137_ToDdsMachineMapping: service-instance=IflytekAlarmInfoFmAService_DdsProvidedSocBCommunication
    RPortPrototype1_DdsRequiredServiceInstance208_ToDdsMachineMapping: service-instance=IflytekSensorCameraSideFr_DdsRequiredCalibration
    RPortPrototype1_DdsRequiredServiceInstance208_ToDdsMachineMapping: service-instance=IflytekSensorCameraRear_DdsRequiredCalibration
  9 x someip service instance to machine mapping, all with communication-connector=InnerEthernetCommConnector, tcp-port=0:
    IflytekPostSaleCalibrationActivation_ProvidedSomeipServiceInstance11_ToSomeIpMachineMapping: service-instance=IflytekPostSaleCalibrationActivation_ProvidedSomeipServiceInstance11
    RPortPrototype1_RequiredSomeipServiceInstance23_ToSomeIpMachineMapping: service-instance=IflytekPostSaleCalibrationActivation_RequiredSomeipSocBCommunication
    IflytekPostSaleCalibrationStop_ProvidedSomeipServiceInstance12_ToSomeIpMachineMapping: service-instance=IflytekPostSaleCalibrationStop_ProvidedSomeipServiceInstance12
    RPortPrototype1_RequiredSomeipServiceInstance24_ToSomeIpMachineMapping: service-instance=IflytekPostSaleCalibrationStop_RequiredSomeipSocBCommunication
    IflytekPostSaleCalibrationResult_ProvidedSomeipServiceInstance13_ToSomeIpMachineMapping: service-instance=IflytekPostSaleCalibrationResult_ProvidedSomeipServiceInstance13
    RPortPrototype1_RequiredSomeipServiceInstance25_ToSomeIpMachineMapping: service-instance=IflytekPostSaleCalibrationResult_RequiredSomeipSocBCommunication
    IflytekPostSaleCalibrationActivation_ProvidedSomeipServiceInstance14_ToSomeIpMachineMapping: service-instance=IflytekPostSaleCalibrationActivation_ProvidedSomeipSocACommunication
    IflytekPostSaleCalibrationStop_ProvidedSomeipServiceInstance15_ToSomeIpMachineMapping: service-instance=IflytekPostSaleCalibrationStop_ProvidedSomeipSocACommunication
    IflytekPostSaleCalibrationResult_ProvidedSomeipServiceInstance16_ToSomeIpMachineMapping: service-instance=IflytekPostSaleCalibrationResult_ProvidedSomeipSocACommunication
  70 x dds service instance to machine mapping, all with communication-connector=InnerEthernetCommConnector:
    RPortPrototype1_DdsRequiredServiceInstance207_ToDdsMachineMapping: service-instance=IflytekAlarmInfoToBCamera_DdsRequiredCameraNodePanoramaView
    RPortPrototype1_DdsRequiredServiceInstance208_ToDdsMachineMapping: service-instance=IflytekAlarmInfoToACamera_DdsRequiredCameraNodeAroundView
    IflytekSystemVersion_DdsProvidedServiceInstance137_ToDdsMachineMapping: service-instance=IflytekSystemVersion_DdsProvidedStaticFusion
    RPortPrototype1_DdsRequiredServiceInstance209_ToDdsMachineMapping: service-instance=IflytekSystemVersion_DdsRequiredSocACommunication
    IflytekSystemVersion_DdsProvidedServiceInstance138_ToDdsMachineMapping: service-instance=IflytekSystemVersion_DdsProvidedSocBCommunication
    RPortPrototype1_DdsRequiredServiceInstance210_ToDdsMachineMapping: service-instance=IflytekFdlTrigger_DdsRequiredSocBCommunication
    IflytekFdlTriggerAck_DdsProvidedServiceInstance139_ToDdsMachineMapping: service-instance=IflytekFdlTriggerAck_DdsProvidedSocBCommunication
    RPortPrototype1_DdsRequiredServiceInstance211_ToDdsMachineMapping: service-instance=IflytekFdlTriggerAck_DdsRequiredSocACommunication
    IflytekFdlTrigger_DdsProvidedServiceInstance140_ToDdsMachineMapping: service-instance=IflytekFdlTrigger_DdsProvidedSocACommunication
    IflytekMcuFmASentinel_DdsProvidedServiceInstance141_ToDdsMachineMapping: service-instance=IflytekMcuFmASentinel_DdsProvidedComServicePncNode
    RPortPrototype1_DdsRequiredServiceInstance212_ToDdsMachineMapping: service-instance=IflytekFmAMcuSentinel_DdsRequiredComServicePncNode
    RPortPrototype1_DdsRequiredServiceInstance213_ToDdsMachineMapping: service-instance=IflytekFmACameraSentinel_DdsRequiredCameraNodeAroundView
    IflytekPlanningDebugInfo_DdsProvidedServiceInstance143_ToDdsMachineMapping: service-instance=IflytekPlanningDebugInfo_DdsProvidedPlanning
    RPortPrototype1_DdsRequiredServiceInstance214_ToDdsMachineMapping: service-instance=IflytekPlanningDebugInfo_DdsRequiredSocACommunication
    IflytekControlDebugInfo_DdsProvidedServiceInstance144_ToDdsMachineMapping: service-instance=IflytekControlDebugInfo_DdsProvidedControl
    RPortPrototype1_DdsRequiredServiceInstance215_ToDdsMachineMapping: service-instance=IflytekControlDebugInfo_DdsRequiredSocACommunication
    IflytekPlanningDebugInfo_DdsProvidedServiceInstance145_ToDdsMachineMapping: service-instance=IflytekPlanningDebugInfo_DdsProvidedSocBCommunication
    IflytekControlDebugInfo_DdsProvidedServiceInstance146_ToDdsMachineMapping: service-instance=IflytekControlDebugInfo_DdsProvidedSocBCommunication
    IflytekAdasFunctionDebugInfo_DdsProvidedServiceInstance147_ToDdsMachineMapping: service-instance=IflytekAdasFunctionDebugInfo_DdsProvidedComServicePncNode
    RPortPrototype1_DdsRequiredServiceInstance216_ToDdsMachineMapping: service-instance=IflytekAdasFunctionDebugInfo_DdsRequiredSocACommunication
    IflytekAdasFunctionDebugInfo_DdsProvidedServiceInstance148_ToDdsMachineMapping: service-instance=IflytekAdasFunctionDebugInfo_DdsProvidedSocBCommunication
    RPortPrototype1_DdsRequiredServiceInstance217_ToDdsMachineMapping: service-instance=IflytekRadarPerception4dTargetMcu_DdsRequiredServiceInstance217
    IflytekRadarPerception4dTargetMcu_DdsProvidedServiceInstance149_ToDdsMachineMapping: service-instance=IflytekRadarPerception4dTargetMcu_DdsProvidedServiceInstance149
    RPortPrototype1_DdsRequiredServiceInstance218_ToDdsMachineMapping: service-instance=IflytekRadarPerception4dTargetMcu_DdsRequiredServiceInstance218
    RPortPrototype1_DdsRequiredServiceInstance219_ToDdsMachineMapping: service-instance=IflytekEngineerInner_DdsRequiredFiniteStateManager
    RPortPrototype1_DdsRequiredServiceInstance220_ToDdsMachineMapping: service-instance=IflytekEngineerInner_DdsRequiredSocBCommunication
    IflytekEngineerInner_DdsProvidedServiceInstance150_ToDdsMachineMapping: service-instance=IflytekEngineerInner_DdsProvidedSocACommunication
    RPortPrototype1_DdsRequiredServiceInstance221_ToDdsMachineMapping: service-instance=IflytekFmAMcuDegradeFunciton_DdsRequiredServiceInstance221
    RPortPrototype1_DdsRequiredServiceInstance222_ToDdsMachineMapping: service-instance=IflytekFmADegradeFunciton_DdsRequiredServiceInstance222
    RPortPrototype1_DdsRequiredServiceInstance223_ToDdsMachineMapping: service-instance=IflytekFmADegradeFunciton_DdsRequiredServiceInstance223
    IflytekFmADegradeFunciton_DdsProvidedServiceInstance151_ToDdsMachineMapping: service-instance=IflytekFmADegradeFunciton_DdsProvidedServiceInstance151
    RPortPrototype1_DdsRequiredServiceInstance224_ToDdsMachineMapping: service-instance=IflytekFmADegradeFunciton_DdsRequiredServiceInstance224
    RPortPrototype1_DdsRequiredServiceInstance225_ToDdsMachineMapping: service-instance=IflytekCameraPerceptionPanoramaView2DBoundingBoxes_DdsRequiredServiceInstance225
    IflytekCameraPerceptionPanoramaView2DBoundingBoxes_DdsProvidedServiceInstance152_ToDdsMachineMapping: service-instance=IflytekCameraPerceptionPanoramaView2DBoundingBoxes_DdsProvidedServiceInstance152
    RPortPrototype1_DdsRequiredServiceInstance226_ToDdsMachineMapping: service-instance=IflytekCameraPerceptionPanoramaView2DBoundingBoxes_DdsRequiredServiceInstance226
    RPortPrototype1_DdsRequiredServiceInstance227_ToDdsMachineMapping: service-instance=IflytekCameraPerceptionPanoramaView2DBoundingBoxes_DdsRequiredServiceInstance227
    RPortPrototype1_DdsRequiredServiceInstance228_ToDdsMachineMapping: service-instance=IflytekCameraPerceptionAroundView2DBoundingBoxes_DdsRequiredServiceInstance228
    IflytekSensorCameraFront120FullResolutionClearH265_DdsProvidedServiceInstance153_ToDdsMachineMapping: service-instance=IflytekSensorCameraFront120FullResolutionClearH265_DdsProvidedServiceInstance153
    RPortPrototype1_DdsRequiredServiceInstance229_ToDdsMachineMapping: service-instance=IflytekSensorCameraFront120FullResolutionClearH265_DdsRequiredServiceInstance229
    RPortPrototype1_DdsRequiredServiceInstance230_ToDdsMachineMapping: service-instance=IflytekSensorCameraRearFullResolutionH265MDCA_DdsRequiredSocACommunication
    IflytekSensorCameraRearFullResolutionH265MDCA_DdsProvidedServiceInstance154_ToDdsMachineMapping: service-instance=IflytekSensorCameraRearFullResolutionH265MDCA_DdsProvidedSocBCommunication
    RPortPrototype1_DdsRequiredServiceInstance231_ToDdsMachineMapping: service-instance=IflytekFmAMcuSentinel_DdsRequiredServiceInstance231
    IflytekFmAMcuSentinel_DdsProvidedServiceInstance155_ToDdsMachineMapping: service-instance=IflytekFmAMcuSentinel_DdsProvidedServiceInstance155
    RPortPrototype1_DdsRequiredServiceInstance232_ToDdsMachineMapping: service-instance=IflytekMcuFmASentinel_DdsRequiredServiceInstance232
    IflytekMcuFmASentinel_DdsProvidedServiceInstance156_ToDdsMachineMapping: service-instance=IflytekMcuFmASentinel_DdsProvidedServiceInstance156
    RPortPrototype1_DdsRequiredServiceInstance233_ToDdsMachineMapping: service-instance=IflytekCameraPerceptionAroundView2DBoundingBoxes_DdsRequiredServiceInstance233
    IflytekCameraPerceptionAroundView2DBoundingBoxes_DdsProvidedServiceInstance157_ToDdsMachineMapping: service-instance=IflytekCameraPerceptionAroundView2DBoundingBoxes_DdsProvidedServiceInstance157
    IflytekEhrPhmReport_DdsProvidedServiceInstance158_ToDdsMachineMapping: service-instance=IflytekEhrPhmReport_DdsProvidedEhr
    IflytekLocalizationPhmReport_DdsProvidedServiceInstance159_ToDdsMachineMapping: service-instance=IflytekLocalizationPhmReport_DdsProvidedLocalization
    IflytekGnssPhmReport_DdsProvidedServiceInstance160_ToDdsMachineMapping: service-instance=IflytekGnssPhmReport_DdsProvidedGnssServiceNode
    IflytekCameraPerceptionPanoramaPhmReport_DdsProvidedServiceInstance161_ToDdsMachineMapping: service-instance=IflytekCameraPerceptionPanoramaPhmReport_DdsProvidedPanoramaViewCameraPerception
    IflytekFsmPhmReport_DdsProvidedServiceInstance162_ToDdsMachineMapping: service-instance=IflytekFsmPhmReport_DdsProvidedFiniteStateManager
    IflytekCameraPanoramaPhmReport_DdsProvidedServiceInstance163_ToDdsMachineMapping: service-instance=IflytekCameraPanoramaPhmReport_DdsProvidedCameraNodePanoramaView
    IflytekFusionObstaclePhmReport_DdsProvidedServiceInstance164_ToDdsMachineMapping: service-instance=IflytekFusionObstaclePhmReport_DdsProvidedObstacleFusion
    IflytekPlanningPhmReport_DdsProvidedServiceInstance165_ToDdsMachineMapping: service-instance=IflytekPlanningPhmReport_DdsProvidedPlanning
    IflytekComPncPhmReport_DdsProvidedServiceInstance166_ToDdsMachineMapping: service-instance=IflytekComPncPhmReport_DdsProvidedComServicePncNode
    IflytekCameraAroundPhmReport_DdsProvidedServiceInstance167_ToDdsMachineMapping: service-instance=IflytekCameraAroundPhmReport_DdsProvidedCameraNodeAroundView
    IflytekControlPhmReport_DdsProvidedServiceInstance168_ToDdsMachineMapping: service-instance=IflytekControlPhmReport_DdsProvidedControl
    IflytekFusionStaticPhmReport_DdsProvidedServiceInstance169_ToDdsMachineMapping: service-instance=IflytekFusionStaticPhmReport_DdsProvidedStaticFusion
    RPortPrototype1_DdsRequiredServiceInstance234_ToDdsMachineMapping: service-instance=IflytekCameraPerception3dOccupancyObjects_DdsRequiredServiceInstance234
    IflytekCameraPerception3dOccupancyObjects_DdsProvidedServiceInstance170_ToDdsMachineMapping: service-instance=IflytekCameraPerception3dOccupancyObjects_DdsProvidedServiceInstance170
    IflytekSensorTboxTime_DdsProvidedServiceInstance169_ToDdsMachineMapping: service-instance=IflytekSensorTboxTime_DdsProvidedComServicePncNode
    RPortPrototype1_DdsRequiredServiceInstance233_ToDdsMachineMapping: service-instance=IflytekSensorTboxTime_DdsRequiredSocACommunication
    IflytekSensorTboxTime_DdsProvidedServiceInstance170_ToDdsMachineMapping: service-instance=IflytekSensorTboxTime_DdsProvidedSocBCommunication
    RPortPrototype1_DdsRequiredServiceInstance234_ToDdsMachineMapping: service-instance=IflytekSensorTboxTime_DdsRequiredGnssServiceNode
    RPortPrototype1_DdsRequiredServiceInstance235_ToDdsMachineMapping: service-instance=IflytekVehicleService_DdsRequiredCameraNodeAroundView
    RPortPrototype1_DdsRequiredServiceInstance236_ToDdsMachineMapping: service-instance=IflytekFsmSocState_DdsRequiredCameraNodeAroundView
    IflytekCameraState_DdsProvidedServiceInstance171_ToDdsMachineMapping: service-instance=IflytekCameraState_DdsProvidedCameraNodeAroundView
    RPortPrototype1_DdsRequiredServiceInstance239_ToDdsMachineMapping: service-instance=IflytekFdlUploadState_DdsRequiredSocBCommunication
    IflytekFdlUploadState_DdsProvidedServiceInstance173_ToDdsMachineMapping: service-instance=IflytekFdlUploadState_DdsProvidedServiceInstance173
  someip service instance to machine mapping RPortPrototype1_RequiredSomeipServiceInstance26_ToSomeIpMachineMapping: communication-connector=InnerEthernetCommConnector, service-instance=IflytekFdlNetStatCheck_RequiredSomeipSocBCommunication, tcp-port=0
  someip service instance to machine mapping IflytekFdlNetStatCheck_ProvidedSomeipServiceInstance17_ToSomeIpMachineMapping: communication-connector=InnerEthernetCommConnector, service-instance=IflytekFdlNetStatCheck_ProvidedSomeipSocACommunication, tcp-port=0
  23 x dds service instance to machine mapping, all with communication-connector=InnerEthernetCommConnector:
    RPortPrototype1_DdsRequiredServiceInstance240_ToDdsMachineMapping: service-instance=IflytekDiskSpaceInfoPhmBOta_DdsRequiredSocBCommunication
    IflytekDiskSpaceInfoPhmBOta_DdsProvidedServiceInstance174_ToDdsMachineMapping: service-instance=IflytekDiskSpaceInfoPhmBOta_DdsProvidedSocACommunication
    RPortPrototype1_DdsRequiredServiceInstance241_ToDdsMachineMapping: service-instance=IflytekDiskCleanRequest_DdsRequiredSocACommunication
    IflytekDiskCleanRequest_DdsProvidedServiceInstance175_ToDdsMachineMapping: service-instance=IflytekDiskCleanRequest_DdsProvidedSocBCommunication
    RPortPrototype1_DdsRequiredServiceInstance242_ToDdsMachineMapping: service-instance=IflytekDiskStatePhmAFdl_DdsRequiredSocACommunication
    IflytekDiskStatePhmAFdl_DdsProvidedServiceInstance176_ToDdsMachineMapping: service-instance=IflytekDiskStatePhmAFdl_DdsProvidedSocBCommunication
    RPortPrototype1_DdsRequiredServiceInstance243_ToDdsMachineMapping: service-instance=IflytekDiskCleanRequestPhmAFdl_DdsRequiredServiceInstance243
    IflytekDiskCleanRequestPhmAFdl_DdsProvidedServiceInstance177_ToDdsMachineMapping: service-instance=IflytekDiskCleanRequestPhmAFdl_DdsProvidedSocBCommunication
    IflytekCalibrationPhmReport_DdsProvidedServiceInstance178_ToDdsMachineMapping: service-instance=IflytekCalibrationPhmReport_DdsProvidedCalibration
    IflytekCalibrationDebugInfo_DdsProvidedServiceInstance179_ToDdsMachineMapping: service-instance=IflytekCalibrationDebugInfo_DdsProvidedCalibration
    RPortPrototype1_DdsRequiredServiceInstance237_ToDdsMachineMapping: service-instance=IflytekEhpParkingMap_DdsRequiredSocACommunication
    IflytekEhpParkingMap_DdsProvidedServiceInstance179_ToDdsMachineMapping: service-instance=IflytekEhpParkingMap_DdsProvidedSocBCommunication
    RPortPrototype1_DdsRequiredServiceInstance238_ToDdsMachineMapping: service-instance=IflytekEhpParkingMap_DdsRequiredLocalization
    RPortPrototype1_DdsRequiredServiceInstance239_ToDdsMachineMapping: service-instance=IflytekEhpParkingMap_DdsRequiredEhr
    RPortPrototype1_DdsRequiredServiceInstance240_ToDdsMachineMapping: service-instance=IflytekEhpParkingMap_DdsRequiredFiniteStateManager
    RPortPrototype1_DdsRequiredServiceInstance241_ToDdsMachineMapping: service-instance=IflytekEhpParkingMapFileInfo_DdsRequiredSocACommunication
    IflytekEhpParkingMapFileInfo_DdsProvidedServiceInstance180_ToDdsMachineMapping: service-instance=IflytekEhpParkingMapFileInfo_DdsProvidedSocBCommunication
    RPortPrototype1_DdsRequiredServiceInstance242_ToDdsMachineMapping: service-instance=IflytekEhpMapManager_DdsRequiredSocACommunication
    IflytekEhpMapManager_DdsProvidedServiceInstance181_ToDdsMachineMapping: service-instance=IflytekEhpMapManager_DdsProvidedSocBCommunication
    RPortPrototype1_DdsRequiredServiceInstance243_ToDdsMachineMapping: service-instance=IflytekEhpMapManager_DdsRequiredFiniteStateManager
    IflytekSensorGnss_DdsProvidedServiceInstance182_ToDdsMachineMapping: service-instance=IflytekSensorGnss_DdsProvidedSocACommunication
    IflytekCameraAroundErrorStatus_DdsProvidedServiceInstance183_ToDdsMachineMapping: service-instance=IflytekCameraAroundErrorStatus_DdsProvidedCameraNodeAroundView
    RPortPrototype1_DdsRequiredServiceInstance244_ToDdsMachineMapping: service-instance=IflytekCameraAroundErrorStatus_DdsRequiredComServicePncNode
  someip service instance to machine mapping RPortPrototype1_RequiredSomeipServiceInstance27_ToSomeIpMachineMapping: communication-connector=InnerEthernetCommConnector, service-instance=IflytekOtaLogUploadRequest_RequiredSomeipSocBCommunication, tcp-port=0
  someip service instance to machine mapping IflytekOtaLogUploadRequest_ProvidedSomeipServiceInstance18_ToSomeIpMachineMapping: communication-connector=InnerEthernetCommConnector, service-instance=IflytekOtaLogUploadRequest_ProvidedSomeipSocACommunication, tcp-port=0
  21 x dds service instance to machine mapping, all with communication-connector=InnerEthernetCommConnector:
    IflytekCalibrationCalibInfo_DdsProvidedServiceInstance184_ToDdsMachineMapping: service-instance=IflytekCalibrationCalibInfo_DdsProvidedSocACommunication
    RPortPrototype1_DdsRequiredServiceInstance245_ToDdsMachineMapping: service-instance=IflytekSystemAProcessLoading_DdsRequiredSocACommunication
    IflytekSystemAProcessLoading_DdsProvidedServiceInstance185_ToDdsMachineMapping: service-instance=IflytekSystemAProcessLoading_DdsProvidedSocBCommunition
    RPortPrototype1_DdsRequiredServiceInstance238_ToDdsMachineMapping: service-instance=IflytekCameraPerceptionDrivableSpaceGrid_DdsRequiredPlanning
    RPortPrototype1_DdsRequiredServiceInstance239_ToDdsMachineMapping: service-instance=IflytekCameraPerceptionDrivableSpaceGrid_DdsRequiredSocACommunication
    IflytekCameraPerceptionDrivableSpaceGrid_DdsProvidedServiceInstance182_ToDdsMachineMapping: service-instance=IflytekCameraPerceptionDrivableSpaceGrid_DdsProvidedSocBCommunication
    RPortPrototype1_DdsRequiredServiceInstance240_ToDdsMachineMapping: service-instance=IflytekCameraPerceptionDrivableSpaceGrid_DdsRequiredFiniteStateManager
    IflytekCameraPerceptionObstacleFeature_DdsProvidedServiceInstance181_ToDdsMachineMapping: service-instance=IflytekCameraPerceptionObstacleFeature_DdsProvidedPanoramaViewCameraPerception
    RPortPrototype1_DdsRequiredServiceInstance240_ToDdsMachineMapping: service-instance=IflytekCameraPerceptionObstacleFeature_DdsRequiredSocBCommunication
    IflytekCameraPerceptionLaneFeature_DdsProvidedServiceInstance182_ToDdsMachineMapping: service-instance=IflytekCameraPerceptionLaneFeature_DdsProvidedPanoramaViewCameraPerception
    RPortPrototype1_DdsRequiredServiceInstance241_ToDdsMachineMapping: service-instance=IflytekCameraPerceptionLaneFeature_DdsRequiredSocBCommunication
    IflytekCameraPerceptionObstacleFeature_DdsProvidedServiceInstance183_ToDdsMachineMapping: service-instance=IflytekCameraPerceptionObstacleFeature_DdsProvidedSocACommunication
    IflytekCameraPerceptionLaneFeature_DdsProvidedServiceInstance184_ToDdsMachineMapping: service-instance=IflytekCameraPerceptionLaneFeature_DdsProvidedSocACommunication
    RPortPrototype1_DdsRequiredServiceInstance242_ToDdsMachineMapping: service-instance=IflytekFusionOccupancyObjects_DdsRequiredFiniteStateManager
    RPortPrototype1_DdsRequiredServiceInstance243_ToDdsMachineMapping: service-instance=IflytekEhpParkingMapToHmi_DdsRequiredSocACommunication
    IflytekEhpParkingMapToHmi_DdsProvidedServiceInstance185_ToDdsMachineMapping: service-instance=IflytekEhpParkingMapToHmi_DdsProvidedSocBCommunication
    IflytekCanTxInfo_DdsProvidedServiceInstance186_ToDdsMachineMapping: service-instance=IflytekCanTxInfo_DdsProvidedComServicePncNode
    RPortPrototype1_DdsRequiredServiceInstance244_ToDdsMachineMapping: service-instance=IflytekCanTxInfo_DdsRequiredSocACommunication
    IflytekCanTxInfo_DdsProvidedServiceInstance187_ToDdsMachineMapping: service-instance=IflytekCanTxInfo_DdsProvidedSocBCommunication
    RPortPrototype1_DdsRequiredServiceInstance245_ToDdsMachineMapping: service-instance=IflytekMegaMappingStatus_DdsRequiredStaticFusion
    RPortPrototype1_DdsRequiredServiceInstance246_ToDdsMachineMapping: service-instance=IflytekAdasFunctionAdas_DdsRequiredFiniteStateManager
package /HuaweiMDC/instance_manifests/requiredInstances
  16 x dds required service instance, all with domain-id=30:
    IflytekSensorCameraFront30_DdsRequiredServiceInstance81: service-interface-deployment=CameraStructContainerDdsInterfaceDeployment, qos-profile=small_buffer_qos.xml, transport-plugins=NDSHM, dds-event-qos-props=DdsEventDeployment, required-service-instance-id=10050
    IflytekSensorCameraSideFl_DdsRequiredServiceInstance82: service-interface-deployment=CameraStructContainerDdsInterfaceDeployment, qos-profile=small_buffer_qos.xml, transport-plugins=NDSHM, dds-event-qos-props=DdsEventDeployment, required-service-instance-id=10051
    IflytekSensorCameraSideFr_DdsRequiredServiceInstance83: service-interface-deployment=CameraStructContainerDdsInterfaceDeployment, qos-profile=small_buffer_qos.xml, transport-plugins=NDSHM, dds-event-qos-props=DdsEventDeployment, required-service-instance-id=10052
    IflytekSensorCameraSideRl_DdsRequiredServiceInstance84: service-interface-deployment=CameraStructContainerDdsInterfaceDeployment, qos-profile=small_buffer_qos.xml, transport-plugins=NDSHM, dds-event-qos-props=DdsEventDeployment, required-service-instance-id=10053
    IflytekSensorCameraSideRr_DdsRequiredServiceInstance85: service-interface-deployment=CameraStructContainerDdsInterfaceDeployment, qos-profile=small_buffer_qos.xml, transport-plugins=NDSHM, dds-event-qos-props=DdsEventDeployment, required-service-instance-id=10054
    IflytekSensorGnss_DdsRequiredServiceInstance87: service-interface-deployment=StructContainerDdsInterfaceDeployment, qos-profile=small_buffer_qos.xml, transport-plugins=FSHM, dds-event-qos-props=eventDdsDeployment, required-service-instance-id=10056
    RPortPrototype1_DdsRequiredServiceInstance154: service-interface-deployment=StructContainerDdsInterfaceDeployment, qos-profile=default_qos.xml, transport-plugins=FSHM, dds-event-qos-props=eventDdsDeployment, required-service-instance-id=10061
    RPortPrototype1_DdsRequiredServiceInstance155: service-interface-deployment=StructContainerDdsInterfaceDeployment, qos-profile=default_qos.xml, transport-plugins=FSHM, dds-event-qos-props=eventDdsDeployment, required-service-instance-id=10062
    RPortPrototype1_DdsRequiredServiceInstance156: service-interface-deployment=CameraStructContainerDdsInterfaceDeployment, qos-profile=default_qos.xml, transport-plugins=FSHM, dds-event-qos-props=DdsEventDeployment, required-service-instance-id=10063
    RPortPrototype1_DdsRequiredServiceInstance157: service-interface-deployment=CameraStructContainerDdsInterfaceDeployment, qos-profile=default_qos.xml, transport-plugins=FSHM, dds-event-qos-props=DdsEventDeployment, required-service-instance-id=10064
    IflytekSensorCameraFront120_DdsRequiredServiceInstance172: service-interface-deployment=CameraStructContainerDdsInterfaceDeployment, qos-profile=small_buffer_qos.xml, transport-plugins=NDSHM, dds-event-qos-props=DdsEventDeployment, required-service-instance-id=10045
    IflytekSensorCameraFront120Eagle_DdsRequiredServiceInstance173: service-interface-deployment=CameraStructContainerDdsInterfaceDeployment, qos-profile=small_buffer_qos.xml, transport-plugins=NDSHM, dds-event-qos-props=DdsEventDeployment, required-service-instance-id=10066
    IflytekSdmapSdmapInfo_DdsRequiredServiceInstance170: service-interface-deployment=StructContainerDdsInterfaceDeployment, qos-profile=large_buffer_qos.xml, transport-plugins=FSHM, dds-event-qos-props=eventDdsDeployment, required-service-instance-id=10012
    IflytekMegaLocalMap_DdsRequiredServiceInstance167: service-interface-deployment=StructContainerDdsInterfaceDeployment, qos-profile=customized_qos.xml, transport-plugins=FSHM, dds-event-qos-props=eventDdsDeployment, required-service-instance-id=10015
    IflytekEhrSdmapInfo_DdsRequiredServiceInstance173: service-interface-deployment=StructContainerDdsInterfaceDeployment, qos-profile=customized_qos.xml, transport-plugins=FSHM, dds-event-qos-props=eventDdsDeployment, required-service-instance-id=10013
    IflytekLocalizationEgomotion_DdsRequiredServiceInstance176: service-interface-deployment=StructContainerDdsInterfaceDeployment, qos-profile=small_buffer_qos.xml, transport-plugins=FSHM, dds-event-qos-props=eventDdsDeployment, required-service-instance-id=10016
  11 x required someip service instance, all with service-interface-deployment=FmAlarmReceiveServiceDeployment:
    IflytekAlarmInfoCameraNodeAroundView_RequiredSomeipCameraNodeAroundView: required-service-instance-id=10002
    IflytekAlarmInfoSocACommunication_RequiredSomeipServiceInstance4: required-service-instance-id=10005
    IflytekAlarmInfoGnssServiceNode_RequiredSomeipServiceInstance5: required-service-instance-id=10007
    IflytekAlarmInfoEhr_RequiredSomeipServiceInstance6: required-service-instance-id=10008
    IflytekAlarmInfoLocalization_RequiredSomeipServiceInstance8: required-service-instance-id=10010
    IflytekAlarmInfoSocBCommunication_RequiredSomeipServiceInstance9: required-service-instance-id=10011
    IflytekAlarmInfoCameraNodePanoramaView_RequiredSomeipServiceInstance14: required-service-instance-id=10017
    IflytekAlarmInfoPanoramaViewCameraPerception_RequiredSomeipServiceInstance15: required-service-instance-id=10018
    alarmInfo_RequiredSomeipServiceInstance20: required-service-instance-id=10000
    alarmInfo_RequiredSomeipServiceInstance21: required-service-instance-id=10001
    IflytekAlarmInfoStaticFusion_RequiredSomeipServiceInstance20: required-service-instance-id=10015
  18 x dds required service instance, all with domain-id=30:
    IflytekLocalizationEgomotion_DdsRequiredServiceInstance134: service-interface-deployment=StructContainerDdsInterfaceDeployment, qos-profile=small_buffer_qos.xml, transport-plugins=FSHM, dds-event-qos-props=eventDdsDeployment, required-service-instance-id=10083
    IflytekEhrSdmapInfo_DdsRequiredServiceInstance134: service-interface-deployment=StructContainerDdsInterfaceDeployment, qos-profile=customized_qos.xml, transport-plugins=FSHM, dds-event-qos-props=eventDdsDeployment, required-service-instance-id=10072
    IflytekCameraPerceptionLaneLines_DdsRequiredServiceInstance135: service-interface-deployment=StructContainerDdsInterfaceDeployment, qos-profile=customized_qos.xml, transport-plugins=FSHM, dds-event-qos-props=eventDdsDeployment, required-service-instance-id=10069
    IflytekCameraPerceptionLaneTopo_DdsRequiredServiceInstance135: service-interface-deployment=StructContainerDdsInterfaceDeployment, qos-profile=customized_qos.xml, transport-plugins=FSHM, dds-event-qos-props=eventDdsDeployment, required-service-instance-id=10073
    IflytekCameraPerceptionParkingSlotList_DdsRequiredServiceInstance135: service-interface-deployment=StructContainerDdsInterfaceDeployment, qos-profile=default_qos.xml, transport-plugins=FSHM, dds-event-qos-props=eventDdsDeployment, required-service-instance-id=10014
    IflytekCameraPerceptionGroundLine_DdsRequiredServiceInstance136: service-interface-deployment=StructContainerDdsInterfaceDeployment, qos-profile=customized_qos.xml, transport-plugins=FSHM, dds-event-qos-props=eventDdsDeployment, required-service-instance-id=10065
    IflytekCameraPerceptionParkingLaneLine_DdsRequiredServiceInstance137: service-interface-deployment=StructContainerDdsInterfaceDeployment, qos-profile=customized_qos.xml, transport-plugins=FSHM, dds-event-qos-props=eventDdsDeployment, required-service-instance-id=10074
    IflytekCameraPerceptionDeceler_DdsRequiredServiceInstance135: service-interface-deployment=StructContainerDdsInterfaceDeployment, qos-profile=small_buffer_qos.xml, transport-plugins=FSHM, dds-event-qos-props=eventDdsDeployment, required-service-instance-id=10079
    IflytekLocalizationEgomotion_DdsRequiredServiceInstance139: service-interface-deployment=StructContainerDdsInterfaceDeployment, qos-profile=small_buffer_qos.xml, transport-plugins=FSHM, dds-event-qos-props=eventDdsDeployment, required-service-instance-id=10016
    IflytekEhrSdmapInfo_DdsRequiredServiceInstance138: service-interface-deployment=StructContainerDdsInterfaceDeployment, qos-profile=customized_qos.xml, transport-plugins=FSHM, dds-event-qos-props=eventDdsDeployment, required-service-instance-id=10013
    IflytekSensorGnss_DdsRequiredServiceInstance140: service-interface-deployment=StructContainerDdsInterfaceDeployment, qos-profile=small_buffer_qos.xml, transport-plugins=FSHM, dds-event-qos-props=eventDdsDeployment, required-service-instance-id=10056
    IflytekLocalizationSemanticInfo_DdsRequiredServiceInstance142: service-interface-deployment=StructContainerDdsInterfaceDeployment, qos-profile=small_buffer_qos.xml, transport-plugins=FSHM, dds-event-qos-props=eventDdsDeployment, required-service-instance-id=10088
    IflytekMegaMappingStatus_DdsRequiredServiceInstance143: service-interface-deployment=StructContainerDdsInterfaceDeployment, qos-profile=small_buffer_qos.xml, transport-plugins=FSHM, dds-event-qos-props=eventDdsDeployment, required-service-instance-id=10090
    IflytekMegaLocalMap_DdsRequiredServiceInstance145: service-interface-deployment=StructContainerDdsInterfaceDeployment, qos-profile=customized_qos.xml, transport-plugins=FSHM, dds-event-qos-props=eventDdsDeployment, required-service-instance-id=10015
    IflytekMegaLocalMap_DdsRequiredServiceInstance146: service-interface-deployment=StructContainerDdsInterfaceDeployment, qos-profile=customized_qos.xml, transport-plugins=FSHM, dds-event-qos-props=eventDdsDeployment, required-service-instance-id=10092
    IflytekEhrStaticMap_DdsRequiredServiceInstance152: service-interface-deployment=StructContainerDdsInterfaceDeployment, qos-profile=large_buffer_qos.xml, transport-plugins=FSHM, dds-event-qos-props=eventDdsDeployment, required-service-instance-id=10096
    IflytekEhrStaticMap_DdsRequiredServiceInstance153: service-interface-deployment=StructContainerDdsInterfaceDeployment, qos-profile=large_buffer_qos.xml, transport-plugins=FSHM, dds-event-qos-props=eventDdsDeployment, required-service-instance-id=10097
    IflytekSensorCameraFront120FullResolutionH265_DdsRequiredServiceInstance161: service-interface-deployment=CameraStructContainerDdsInterfaceDeployment, qos-profile=small_buffer_qos.xml, transport-plugins=NDSHM, dds-event-qos-props=DdsEventDeployment, required-service-instance-id=10106
  required someip service instance clientServiceContainer_RequiredSomeipServiceInstance21: service-interface-deployment=ClientServiceContainerInterfaceDeployment, required-service-instance-id=10027
  required someip service instance clientServiceContainer_RequiredSomeipServiceInstance22: service-interface-deployment=ClientServiceContainerInterfaceDeployment, required-service-instance-id=10028
  required someip service instance IflytekSensorGetPanoramaCameraIntriParam_RequiredSomeipServiceInstance24: service-interface-deployment=ClientServiceContainerInterfaceDeployment, required-service-instance-id=10033
    someip required event group eventGroup1: event-group=ClientServiceContainerInterfaceDeployment/SomeipEventGroup
  29 x dds required service instance, all with domain-id=30:
    IflytekAlarmInfoSoc_DdsRequiredServiceInstance166: service-interface-deployment=StructContainerDdsInterfaceDeployment, qos-profile=small_buffer_qos.xml, transport-plugins=FSHM, dds-event-qos-props=eventDdsDeployment, required-service-instance-id=10057
    IflytekSensorCameraFront30FullResolutionH265_DdsRequiredServiceInstance163: service-interface-deployment=CameraStructContainerDdsInterfaceDeployment, qos-profile=small_buffer_qos.xml, transport-plugins=NDSHM, dds-event-qos-props=DdsEventDeployment, required-service-instance-id=10119
    IflytekSensorCameraSideFlFullResolutionH265_DdsRequiredServiceInstance164: service-interface-deployment=CameraStructContainerDdsInterfaceDeployment, qos-profile=small_buffer_qos.xml, transport-plugins=NDSHM, dds-event-qos-props=DdsEventDeployment, required-service-instance-id=10120
    IflytekSensorCameraSideFrFullResolutionH265_DdsRequiredServiceInstance165: service-interface-deployment=CameraStructContainerDdsInterfaceDeployment, qos-profile=small_buffer_qos.xml, transport-plugins=NDSHM, dds-event-qos-props=DdsEventDeployment, required-service-instance-id=10121
    IflytekSensorCameraSideRlFullResolutionH265_DdsRequiredServiceInstance166: service-interface-deployment=CameraStructContainerDdsInterfaceDeployment, qos-profile=small_buffer_qos.xml, transport-plugins=NDSHM, dds-event-qos-props=DdsEventDeployment, required-service-instance-id=10122
    IflytekSensorCameraSideRrFullResolutionH265_DdsRequiredServiceInstance167: service-interface-deployment=CameraStructContainerDdsInterfaceDeployment, qos-profile=small_buffer_qos.xml, transport-plugins=NDSHM, dds-event-qos-props=DdsEventDeployment, required-service-instance-id=10123
    IflytekRadarFmPerception4dPointCloud_DdsRequiredServiceInstance174: service-interface-deployment=StructContainerDdsInterfaceDeployment, qos-profile=customized_qos.xml, transport-plugins=FSHM, dds-event-qos-props=eventDdsDeployment, required-service-instance-id=10010
    IflytekRadarFmPerception4dTarget_DdsRequiredServiceInstance175: service-interface-deployment=StructContainerDdsInterfaceDeployment, qos-profile=small_buffer_qos.xml, transport-plugins=FSHM, dds-event-qos-props=eventDdsDeployment, required-service-instance-id=10084
    IflytekLocalizationEgomotion_DdsRequiredServiceInstance177: service-interface-deployment=StructContainerDdsInterfaceDeployment, qos-profile=small_buffer_qos.xml, transport-plugins=FSHM, dds-event-qos-props=eventDdsDeployment, required-service-instance-id=10016
    IflytekCameraPerceptionObjects_DdsRequiredServiceInstance172: service-interface-deployment=StructContainerDdsInterfaceDeployment, qos-profile=customized_qos.xml, transport-plugins=FSHM, dds-event-qos-props=eventDdsDeployment, required-service-instance-id=10025
    IflytekSensorCameraRearMDCA_DdsRequiredServiceInstance177: service-interface-deployment=CameraStructContainerDdsInterfaceDeployment, qos-profile=small_buffer_qos.xml, transport-plugins=NDSHM, dds-event-qos-props=DdsEventDeployment, required-service-instance-id=10136
    IflytekCameraPerceptionTrafficSignRecognition_DdsRequiredServiceInstance184: service-interface-deployment=StructContainerDdsInterfaceDeployment, qos-profile=small_buffer_qos.xml, transport-plugins=FSHM, dds-event-qos-props=eventDdsDeployment, required-service-instance-id=10067
    IflytekRadarFmPerception4dTarget_DdsRequiredServiceInstance188: service-interface-deployment=StructContainerDdsInterfaceDeployment, qos-profile=small_buffer_qos.xml, transport-plugins=FSHM, dds-event-qos-props=eventDdsDeployment, required-service-instance-id=10084
    IflytekSensorCameraRearMDCA_DdsRequiredServiceInstance197: service-interface-deployment=CameraStructContainerDdsInterfaceDeployment, qos-profile=small_buffer_qos.xml, transport-plugins=NDSHM, dds-event-qos-props=DdsEventDeployment, required-service-instance-id=10137
    IflytekEhrSdpromapInfo_DdsRequiredServiceInstance199: service-interface-deployment=StructContainerDdsInterfaceDeployment, qos-profile=customized_qos.xml, transport-plugins=FSHM, dds-event-qos-props=eventDdsDeployment, required-service-instance-id=10173
    IflytekEhrSdpromapInfo_DdsRequiredServiceInstance202: service-interface-deployment=StructContainerDdsInterfaceDeployment, qos-profile=customized_qos.xml, transport-plugins=FSHM, dds-event-qos-props=eventDdsDeployment, required-service-instance-id=10174
    IflytekEhrSdpromapInfo_DdsRequiredServiceInstance203: service-interface-deployment=StructContainerDdsInterfaceDeployment, qos-profile=customized_qos.xml, transport-plugins=FSHM, dds-event-qos-props=eventDdsDeployment, required-service-instance-id=10173
    IflytekCameraPerceptionOccGrid_DdsRequiredServiceInstance206: service-interface-deployment=StructContainerDdsInterfaceDeployment, qos-profile=default_qos.xml, transport-plugins=FSHM, dds-event-qos-props=eventDdsDeployment, required-service-instance-id=10175
    IflytekSensorCameraSideRr_DdsRequiredServiceInstance87: service-interface-deployment=CameraStructContainerDdsInterfaceDeployment, qos-profile=small_buffer_qos.xml, transport-plugins=NDSHM, dds-event-qos-props=DdsEventDeployment, required-service-instance-id=10054
    IflytekSensorCameraSideRl_DdsRequiredServiceInstance88: service-interface-deployment=CameraStructContainerDdsInterfaceDeployment, qos-profile=small_buffer_qos.xml, transport-plugins=NDSHM, dds-event-qos-props=DdsEventDeployment, required-service-instance-id=10053
    IflytekSensorCameraSideFl_DdsRequiredServiceInstance90: service-interface-deployment=CameraStructContainerDdsInterfaceDeployment, qos-profile=small_buffer_qos.xml, transport-plugins=NDSHM, dds-event-qos-props=DdsEventDeployment, required-service-instance-id=10051
    IflytekSensorCameraFront30_DdsRequiredServiceInstance91: service-interface-deployment=CameraStructContainerDdsInterfaceDeployment, qos-profile=small_buffer_qos.xml, transport-plugins=NDSHM, dds-event-qos-props=DdsEventDeployment, required-service-instance-id=10050
    IflytekSensorCameraFront120FullResolutionH265_DdsRequiredServiceInstance92: service-interface-deployment=CameraStructContainerDdsInterfaceDeployment, qos-profile=small_buffer_qos.xml, transport-plugins=NDSHM, dds-event-qos-props=DdsEventDeployment, required-service-instance-id=10106
    IflytekSensorCameraSurroundResizeImageFront_DdsRequiredServiceInstance93: service-interface-deployment=CameraStructContainerDdsInterfaceDeployment, qos-profile=small_buffer_qos.xml, transport-plugins=NDSHM, dds-event-qos-props=DdsEventDeployment, required-service-instance-id=10023
    IflytekSensorCameraSurroundResizeImageLeft_DdsRequiredServiceInstance94: service-interface-deployment=CameraStructContainerDdsInterfaceDeployment, qos-profile=small_buffer_qos.xml, transport-plugins=NDSHM, dds-event-qos-props=DdsEventDeployment, required-service-instance-id=10024
    IflytekSensorCameraSurroundResizeImageRear_DdsRequiredServiceInstance95: service-interface-deployment=CameraStructContainerDdsInterfaceDeployment, qos-profile=small_buffer_qos.xml, transport-plugins=NDSHM, dds-event-qos-props=DdsEventDeployment, required-service-instance-id=10042
    IflytekSensorCameraSurroundResizeImageRight_DdsRequiredServiceInstance96: service-interface-deployment=CameraStructContainerDdsInterfaceDeployment, qos-profile=small_buffer_qos.xml, transport-plugins=NDSHM, dds-event-qos-props=DdsEventDeployment, required-service-instance-id=10041
    IflytekSensorCameraSurroundResizeImageRear_DdsRequiredServiceInstance99: service-interface-deployment=CameraStructContainerDdsInterfaceDeployment, qos-profile=small_buffer_qos.xml, transport-plugins=NDSHM, dds-event-qos-props=DdsEventDeployment, required-service-instance-id=10002
    IflytekSensorCameraSurroundResizeImageRight_DdsRequiredServiceInstance100: service-interface-deployment=CameraStructContainerDdsInterfaceDeployment, qos-profile=small_buffer_qos.xml, transport-plugins=NDSHM, dds-event-qos-props=DdsEventDeployment, required-service-instance-id=10006
  required someip service instance IflytekAlarmInfoCalibration_RequiredSomeipServiceInstance16: service-interface-deployment=FmAlarmReceiveServiceDeployment, required-service-instance-id=10009
  22 x dds required service instance, all with service-interface-deployment=StructContainerDdsInterfaceDeployment, domain-id=30, transport-plugins=FSHM, dds-event-qos-props=eventDdsDeployment:
    IflytekSensorImu_DdsRequiredServiceInstance101: qos-profile=small_buffer_qos.xml, required-service-instance-id=10008
    IflytekVehicleService_DdsRequiredServiceInstance102: qos-profile=small_buffer_qos.xml, required-service-instance-id=10009
    IflytekHmiMcuToSocBsw_DdsRequiredServiceInstance104: qos-profile=small_buffer_qos.xml, required-service-instance-id=10017
    IflytekRadarFmPerceptionInfo_DdsRequiredServiceInstance106: qos-profile=small_buffer_qos.xml, required-service-instance-id=10021
    IflytekRadarFlPerceptionInfo_DdsRequiredServiceInstance107: qos-profile=small_buffer_qos.xml, required-service-instance-id=10022
    IflytekRadarFrPerceptionInfo_DdsRequiredServiceInstance108: qos-profile=small_buffer_qos.xml, required-service-instance-id=10026
    IflytekRadarRlPerceptionInfo_DdsRequiredServiceInstance109: qos-profile=small_buffer_qos.xml, required-service-instance-id=10028
    IflytekRadarRrPerceptionInfo_DdsRequiredServiceInstance110: qos-profile=small_buffer_qos.xml, required-service-instance-id=10030
    IflytekSensorImu_DdsRequiredServiceInstance113: qos-profile=small_buffer_qos.xml, required-service-instance-id=10033
    IflytekVehicleService_DdsRequiredServiceInstance114: qos-profile=small_buffer_qos.xml, required-service-instance-id=10034
    IflytekVehicleService_DdsRequiredServiceInstance115: qos-profile=small_buffer_qos.xml, required-service-instance-id=10034
    IflytekSensorImu_DdsRequiredServiceInstance116: qos-profile=small_buffer_qos.xml, required-service-instance-id=10033
    IflytekVehicleService_DdsRequiredServiceInstance117: qos-profile=small_buffer_qos.xml, required-service-instance-id=10034
    IflytekLocalizationEgomotion_DdsRequiredServiceInstance118: qos-profile=small_buffer_qos.xml, required-service-instance-id=10016
    IflytekCameraPerceptionObjects_DdsRequiredServiceInstance119: qos-profile=customized_qos.xml, required-service-instance-id=10036
    IflytekFusionObjects_DdsRequiredServiceInstance120: qos-profile=customized_qos.xml, required-service-instance-id=10037
    IflytekCalibrationCalibInfo_DdsRequiredSocBCommunication: qos-profile=small_buffer_qos.xml, required-service-instance-id=10039
    IflytekFusionObjectsCompress_DdsRequiredComServicePncNode: qos-profile=small_buffer_qos.xml, required-service-instance-id=10059
    IflytekFmMcuInfo_DdsRequiredComServicePncNode: qos-profile=small_buffer_qos.xml, required-service-instance-id=10060
    IflytekFusionRoadFusionCompress_DdsRequiredComServicePncNode: qos-profile=small_buffer_qos.xml, required-service-instance-id=10004
    IflytekHmiSocToMcuBsw_DdsRequiredServiceInstance128: qos-profile=default_qos.xml, required-service-instance-id=10075
    IflytekHmiSocToMcuBsw_DdsRequiredComServicePncNode: qos-profile=default_qos.xml, required-service-instance-id=10076
  required someip service instance IflytekAlarmInfoComServicePncNode_RequiredSomeipComServicePncNode: service-interface-deployment=FmAlarmReceiveServiceDeployment, required-service-instance-id=10020
  17 x dds required service instance, all with service-interface-deployment=StructContainerDdsInterfaceDeployment, domain-id=30, transport-plugins=FSHM, dds-event-qos-props=eventDdsDeployment:
    IflytekLocalizationEgomotion_DdsRequiredComServicePncNode: qos-profile=small_buffer_qos.xml, required-service-instance-id=10083
    IflytekPlanningPlan_DdsRequiredComServicePncNode: qos-profile=default_qos.xml, required-service-instance-id=10078
    IflytekControlControlCommand_DdsRequiredComServicePncNode: qos-profile=small_buffer_qos.xml, required-service-instance-id=10080
    IflytekUssUsswaveInfo_DdsRequiredServiceInstance134: qos-profile=small_buffer_qos.xml, required-service-instance-id=10018
    IflytekRadarFmPerception4dTarget_DdsRequiredServiceInstance135: qos-profile=small_buffer_qos.xml, required-service-instance-id=10081
    IflytekVehicleService_DdsRequiredServiceInstance137: qos-profile=small_buffer_qos.xml, required-service-instance-id=10009
    IflytekLocalizationEgomotion_DdsRequiredServiceInstance138: qos-profile=small_buffer_qos.xml, required-service-instance-id=10083
    IflytekPredictionPredictionResult_DdsRequiredServiceInstance139: qos-profile=customized_qos.xml, required-service-instance-id=10029
    IflytekFusionUssPerceptionInfo_DdsRequiredServiceInstance140: qos-profile=customized_qos.xml, required-service-instance-id=10086
    IflytekFusionOccupancyObjects_DdsRequiredServiceInstance141: qos-profile=large_buffer_qos.xml, required-service-instance-id=10091
    IflytekFusionObjects_DdsRequiredServiceInstance142: qos-profile=customized_qos.xml, required-service-instance-id=10093
    IflytekFusionObjects_DdsRequiredServiceInstance143: qos-profile=customized_qos.xml, required-service-instance-id=10093
    IflytekFusionParkingSlot_DdsRequiredServiceInstance145: qos-profile=small_buffer_qos.xml, required-service-instance-id=10005
    IflytekFusionParkingSlot_DdsRequiredServiceInstance146: qos-profile=small_buffer_qos.xml, required-service-instance-id=10005
    IflytekCameraPerceptionOccupancyObjects_DdsRequiredServiceInstance148: qos-profile=large_buffer_qos.xml, required-service-instance-id=10044
    IflytekCameraPerception3dGeneralObjects_DdsRequiredServiceInstance149: qos-profile=customized_qos.xml, required-service-instance-id=10043
    IflytekCameraPerceptionObjects_DdsRequiredServiceInstance150: qos-profile=customized_qos.xml, required-service-instance-id=10025
  required someip service instance IflytekAlarmInfoObstacleFusion_RequiredSomeipServiceInstance18: service-interface-deployment=FmAlarmReceiveServiceDeployment, required-service-instance-id=10021
  14 x dds required service instance, all with domain-id=30, transport-plugins=FSHM:
    IflytekEhrStaticMap_DdsRequiredServiceInstance151: service-interface-deployment=StructContainerDdsInterfaceDeployment, qos-profile=large_buffer_qos.xml, dds-event-qos-props=eventDdsDeployment, required-service-instance-id=10097
    IflytekEhrSdmapInfo_DdsRequiredServiceInstance152: service-interface-deployment=StructContainerDdsInterfaceDeployment, qos-profile=customized_qos.xml, dds-event-qos-props=eventDdsDeployment, required-service-instance-id=10072
    IflytekEhrSdpromapInfo_DdsRequiredServiceInstance153: service-interface-deployment=StructContainerDdsInterfaceDeployment, qos-profile=customized_qos.xml, dds-event-qos-props=eventDdsDeployment, required-service-instance-id=10174
    IflytekLocalizationEgomotion_DdsRequiredServiceInstance154: service-interface-deployment=StructContainerDdsInterfaceDeployment, qos-profile=small_buffer_qos.xml, dds-event-qos-props=eventDdsDeployment, required-service-instance-id=10083
    IflytekUssUsswaveInfo_DdsRequiredServiceInstance155: service-interface-deployment=StructContainerDdsInterfaceDeployment, qos-profile=small_buffer_qos.xml, dds-event-qos-props=eventDdsDeployment, required-service-instance-id=10018
    IflytekVehicleService_DdsRequiredServiceInstance156: service-interface-deployment=StructContainerDdsInterfaceDeployment, qos-profile=small_buffer_qos.xml, dds-event-qos-props=eventDdsDeployment, required-service-instance-id=10009
    IflytekFusionGroundLine_DdsRequiredServiceInstance157: service-interface-deployment=StructContainerDdsInterfaceDeployment, qos-profile=default_qos.xml, dds-event-qos-props=eventDdsDeployment, required-service-instance-id=10068
    IflytekFusionSpeedBump_DdsRequiredServiceInstance157: service-interface-deployment=StructContainerDdsInterfaceDeployment, qos-profile=small_buffer_qos.xml, dds-event-qos-props=eventDdsDeployment, required-service-instance-id=10094
    IflytekCameraPerceptionScene_DdsRequiredServiceInstance158: service-interface-deployment=StructContainerDdsInterfaceDeployment, qos-profile=small_buffer_qos.xml, dds-event-qos-props=eventDdsDeployment, required-service-instance-id=10095
    IflytekCameraPerceptionScene_DdsRequiredServiceInstance157: service-interface-deployment=StructContainerDdsInterfaceDeployment, qos-profile=small_buffer_qos.xml, dds-event-qos-props=eventDdsDeployment, required-service-instance-id=10098
    IflytekCameraPerceptionOccGrid_DdsRequiredServiceInstance159: service-interface-deployment=StructContainerDdsInterfaceDeployment, qos-profile=default_qos.xml, dds-event-qos-props=eventDdsDeployment, required-service-instance-id=10100
    IflytekControlControlCommand_DdsRequiredServiceInstance161: service-interface-deployment=StructContainerDdsInterfaceDeployment, qos-profile=small_buffer_qos.xml, dds-event-qos-props=eventDdsDeployment, required-service-instance-id=10080
    IflytekPlanningPlan_DdsRequiredServiceInstance162: service-interface-deployment=StructContainerDdsInterfaceDeployment, qos-profile=default_qos.xml, dds-event-qos-props=eventDdsDeployment, required-service-instance-id=10078
    IflytekPlanningHmi_DdsRequiredServiceInstance164: service-interface-deployment=TimeDelayDeployment, qos-profile=default_qos.xml, dds-event-qos-props=TimeDelayDdsEventDeployment, required-service-instance-id=10102
  required someip service instance IflytekAlarmInfoPlanning_RequiredSomeipServiceInstance19: service-interface-deployment=FmAlarmReceiveServiceDeployment, required-service-instance-id=10022
  required someip service instance IflytekAlarmInfoControl_RequiredSomeipServiceInstance20: service-interface-deployment=FmAlarmReceiveServiceDeployment, required-service-instance-id=10025
  5 x dds required service instance, all with qos-profile=small_buffer_qos.xml, domain-id=30:
    IflytekLocalizationEgomotion_DdsRequiredServiceInstance166: service-interface-deployment=StructContainerDdsInterfaceDeployment, transport-plugins=FSHM, dds-event-qos-props=eventDdsDeployment, required-service-instance-id=10083
    IflytekVehicleService_DdsRequiredServiceInstance167: service-interface-deployment=StructContainerDdsInterfaceDeployment, transport-plugins=FSHM, dds-event-qos-props=eventDdsDeployment, required-service-instance-id=10009
    IflytekVehicleService_DdsRequiredServiceInstance178: service-interface-deployment=StructContainerDdsInterfaceDeployment, transport-plugins=FSHM, dds-event-qos-props=eventDdsDeployment, required-service-instance-id=10009
    IflytekSensorCameraSurroundResizeImageLeft_DdsRequiredServiceInstance176: service-interface-deployment=CameraStructContainerDdsInterfaceDeployment, transport-plugins=NDSHM, dds-event-qos-props=DdsEventDeployment, required-service-instance-id=10001
    IflytekSensorCameraSurroundResizeImageFront_DdsRequiredServiceInstance176: service-interface-deployment=CameraStructContainerDdsInterfaceDeployment, transport-plugins=NDSHM, dds-event-qos-props=DdsEventDeployment, required-service-instance-id=10000
  required someip service instance IflytekConfigManager_RequiredSomeipCameraNodeAroundView: service-interface-deployment=ConfigServerSomeipServiceInterfaceDeployment, required-service-instance-id=1
    someip required event group eventGroup1: event-group=ParamUpdateEventGroup
    someip required event group eventGroup2: event-group=ServerNotifyEventGroup
  dds required service instance IflytekSensorCameraRear_DdsRequiredPanoramaViewCameraPerception: service-interface-deployment=CameraStructContainerDdsInterfaceDeployment, qos-profile=small_buffer_qos.xml, domain-id=30, transport-plugins=NDSHM, dds-event-qos-props=DdsEventDeployment, required-service-instance-id=10055
  dds required service instance IflytekPlanningHmi_DdsRequiredStaticFusion: service-interface-deployment=StructContainerDdsInterfaceDeployment, qos-profile=default_qos.xml, domain-id=30, transport-plugins=FSHM, dds-event-qos-props=eventDdsDeployment, required-service-instance-id=10102
  dds required service instance IflytekPlanningHmi_DdsRequiredControl: service-interface-deployment=StructContainerDdsInterfaceDeployment, qos-profile=default_qos.xml, domain-id=30, transport-plugins=FSHM, dds-event-qos-props=eventDdsDeployment, required-service-instance-id=10102
  required someip service instance IflytekAlarmInfoFiniteStateManager_RequiredSomeipServiceInstance21: service-interface-deployment=FmAlarmReceiveServiceDeployment, required-service-instance-id=10031
  dds required service instance IflytekVehicleService_DdsRequiredServiceInstance143: service-interface-deployment=StructContainerDdsInterfaceDeployment, qos-profile=small_buffer_qos.xml, domain-id=30, transport-plugins=FSHM, dds-event-qos-props=eventDdsDeployment, required-service-instance-id=10034
  dds required service instance IflytekSensorGnss_DdsRequiredServiceInstance144: service-interface-deployment=StructContainerDdsInterfaceDeployment, qos-profile=small_buffer_qos.xml, domain-id=30, transport-plugins=FSHM, dds-event-qos-props=eventDdsDeployment, required-service-instance-id=10056
  required someip service instance IflytekConfigManager_RequiredSomeipServiceInstance22: service-interface-deployment=ConfigServerSomeipServiceInterfaceDeployment, required-service-instance-id=1
    someip required event group eventGroup1: event-group=ParamUpdateEventGroup
    someip required event group eventGroup2: event-group=ServerNotifyEventGroup
  64 x dds required service instance, all with domain-id=30:
    IflytekEhrSdmapInfo_DdsRequiredServiceInstance145: service-interface-deployment=StructContainerDdsInterfaceDeployment, qos-profile=customized_qos.xml, transport-plugins=FSHM, dds-event-qos-props=eventDdsDeployment, required-service-instance-id=10013
    IflytekEhrSdpromapInfo_DdsRequiredServiceInstance146: service-interface-deployment=StructContainerDdsInterfaceDeployment, qos-profile=customized_qos.xml, transport-plugins=FSHM, dds-event-qos-props=eventDdsDeployment, required-service-instance-id=10173
    IflytekLocalizationEgomotion_DdsRequiredServiceInstance149: service-interface-deployment=StructContainerDdsInterfaceDeployment, qos-profile=small_buffer_qos.xml, transport-plugins=FSHM, dds-event-qos-props=eventDdsDeployment, required-service-instance-id=10016
    IflytekLocalizationSemanticInfo_DdsRequiredServiceInstance150: service-interface-deployment=StructContainerDdsInterfaceDeployment, qos-profile=small_buffer_qos.xml, transport-plugins=FSHM, dds-event-qos-props=eventDdsDeployment, required-service-instance-id=10088
    IflytekMegaMappingStatus_DdsRequiredServiceInstance151: service-interface-deployment=StructContainerDdsInterfaceDeployment, qos-profile=small_buffer_qos.xml, transport-plugins=FSHM, dds-event-qos-props=eventDdsDeployment, required-service-instance-id=10058
    IflytekCameraPerceptionLaneLines_DdsRequiredServiceInstance152: service-interface-deployment=StructContainerDdsInterfaceDeployment, qos-profile=customized_qos.xml, transport-plugins=FSHM, dds-event-qos-props=eventDdsDeployment, required-service-instance-id=10069
    IflytekCameraPerceptionLaneLines_DdsRequiredServiceInstance153: service-interface-deployment=StructContainerDdsInterfaceDeployment, qos-profile=customized_qos.xml, transport-plugins=FSHM, dds-event-qos-props=eventDdsDeployment, required-service-instance-id=10031
    IflytekCameraPerceptionGroundLine_DdsRequiredServiceInstance154: service-interface-deployment=StructContainerDdsInterfaceDeployment, qos-profile=customized_qos.xml, transport-plugins=FSHM, dds-event-qos-props=eventDdsDeployment, required-service-instance-id=10065
    IflytekCameraPerceptionGroundLine_DdsRequiredServiceInstance155: service-interface-deployment=StructContainerDdsInterfaceDeployment, qos-profile=customized_qos.xml, transport-plugins=FSHM, dds-event-qos-props=eventDdsDeployment, required-service-instance-id=10038
    IflytekCameraPerceptionDeceler_DdsRequiredServiceInstance156: service-interface-deployment=StructContainerDdsInterfaceDeployment, qos-profile=small_buffer_qos.xml, transport-plugins=FSHM, dds-event-qos-props=eventDdsDeployment, required-service-instance-id=10079
    IflytekCameraPerceptionDeceler_DdsRequiredServiceInstance157: service-interface-deployment=StructContainerDdsInterfaceDeployment, qos-profile=small_buffer_qos.xml, transport-plugins=FSHM, dds-event-qos-props=eventDdsDeployment, required-service-instance-id=10070
    IflytekFusionParkingSlot_DdsRequiredServiceInstance162: service-interface-deployment=StructContainerDdsInterfaceDeployment, qos-profile=small_buffer_qos.xml, transport-plugins=FSHM, dds-event-qos-props=eventDdsDeployment, required-service-instance-id=10005
    IflytekFusionParkingSlot_DdsRequiredServiceInstance163: service-interface-deployment=StructContainerDdsInterfaceDeployment, qos-profile=small_buffer_qos.xml, transport-plugins=FSHM, dds-event-qos-props=eventDdsDeployment, required-service-instance-id=10077
    IflytekFusionSpatialParkingSlot_DdsRequiredServiceInstance164: service-interface-deployment=StructContainerDdsInterfaceDeployment, qos-profile=small_buffer_qos.xml, transport-plugins=FSHM, dds-event-qos-props=eventDdsDeployment, required-service-instance-id=10087
    IflytekFusionSpatialParkingSlot_DdsRequiredServiceInstance165: service-interface-deployment=StructContainerDdsInterfaceDeployment, qos-profile=small_buffer_qos.xml, transport-plugins=FSHM, dds-event-qos-props=eventDdsDeployment, required-service-instance-id=10082
    IflytekFusionObjects_DdsRequiredServiceInstance166: service-interface-deployment=StructContainerDdsInterfaceDeployment, qos-profile=customized_qos.xml, transport-plugins=FSHM, dds-event-qos-props=eventDdsDeployment, required-service-instance-id=10037
    IflytekCalibrationCalibInfo_DdsRequiredServiceInstance167: service-interface-deployment=StructContainerDdsInterfaceDeployment, qos-profile=small_buffer_qos.xml, transport-plugins=FSHM, dds-event-qos-props=eventDdsDeployment, required-service-instance-id=10039
    IflytekPlanningHmi_DdsRequiredServiceInstance168: service-interface-deployment=StructContainerDdsInterfaceDeployment, qos-profile=default_qos.xml, transport-plugins=FSHM, dds-event-qos-props=eventDdsDeployment, required-service-instance-id=10102
    IflytekPlanningPlan_DdsRequiredServiceInstance169: service-interface-deployment=StructContainerDdsInterfaceDeployment, qos-profile=default_qos.xml, transport-plugins=FSHM, dds-event-qos-props=eventDdsDeployment, required-service-instance-id=10078
    IflytekPlanningHmi_DdsRequiredServiceInstance170: service-interface-deployment=StructContainerDdsInterfaceDeployment, qos-profile=default_qos.xml, transport-plugins=FSHM, dds-event-qos-props=eventDdsDeployment, required-service-instance-id=10085
    IflytekPlanningPlan_DdsRequiredServiceInstance171: service-interface-deployment=StructContainerDdsInterfaceDeployment, qos-profile=default_qos.xml, transport-plugins=FSHM, dds-event-qos-props=eventDdsDeployment, required-service-instance-id=10103
    IflytekHmiInner_DdsRequiredServiceInstance172: service-interface-deployment=StructContainerDdsInterfaceDeployment, qos-profile=small_buffer_qos.xml, transport-plugins=FSHM, dds-event-qos-props=eventDdsDeployment, required-service-instance-id=10007
    IflytekFsmSocState_DdsRequiredServiceInstance{173..177}: service-interface-deployment=StructContainerDdsInterfaceDeployment, qos-profile=small_buffer_qos.xml, transport-plugins=FSHM, dds-event-qos-props=eventDdsDeployment, required-service-instance-id=10104
    IflytekFsmSocState_DdsRequiredServiceInstance{178..181}: service-interface-deployment=StructContainerDdsInterfaceDeployment, qos-profile=small_buffer_qos.xml, transport-plugins=FSHM, dds-event-qos-props=eventDdsDeployment, required-service-instance-id=10110
    IflytekFsmSocState_DdsRequiredComServicePncNode: service-interface-deployment=StructContainerDdsInterfaceDeployment, qos-profile=small_buffer_qos.xml, transport-plugins=FSHM, dds-event-qos-props=eventDdsDeployment, required-service-instance-id=10110
    IflytekSensorCameraSurroundFrontFullResolutionH265_DdsRequiredServiceInstance183: service-interface-deployment=CameraStructContainerDdsInterfaceDeployment, qos-profile=small_buffer_qos.xml, transport-plugins=NDSHM, dds-event-qos-props=DdsEventDeployment, required-service-instance-id=10115
    IflytekSensorCameraSurroundLeftFullResolutionH265_DdsRequiredServiceInstance184: service-interface-deployment=CameraStructContainerDdsInterfaceDeployment, qos-profile=small_buffer_qos.xml, transport-plugins=NDSHM, dds-event-qos-props=DdsEventDeployment, required-service-instance-id=10116
    IflytekSensorCameraSurroundRearFullResolutionH265_DdsRequiredServiceInstance185: service-interface-deployment=CameraStructContainerDdsInterfaceDeployment, qos-profile=small_buffer_qos.xml, transport-plugins=NDSHM, dds-event-qos-props=DdsEventDeployment, required-service-instance-id=10117
    IflytekSensorCameraSurroundRightFullResolutionH265_DdsRequiredServiceInstance186: service-interface-deployment=CameraStructContainerDdsInterfaceDeployment, qos-profile=small_buffer_qos.xml, transport-plugins=NDSHM, dds-event-qos-props=DdsEventDeployment, required-service-instance-id=10118
    IflytekFusionRoadFusion_DdsRequiredServiceInstance186: service-interface-deployment=StructContainerDdsInterfaceDeployment, qos-profile=customized_qos.xml, transport-plugins=FSHM, dds-event-qos-props=eventDdsDeployment, required-service-instance-id=10071
    IflytekCameraPerceptionTrafficSignRecognition_DdsRequiredPlanning: service-interface-deployment=StructContainerDdsInterfaceDeployment, qos-profile=small_buffer_qos.xml, transport-plugins=FSHM, dds-event-qos-props=eventDdsDeployment, required-service-instance-id=10099
    IflytekCameraPerceptionTrafficSignRecognition_DdsRequiredServiceInstance187: service-interface-deployment=StructContainerDdsInterfaceDeployment, qos-profile=small_buffer_qos.xml, transport-plugins=FSHM, dds-event-qos-props=eventDdsDeployment, required-service-instance-id=10067
    IflytekCameraPerceptionLaneTopo_DdsRequiredServiceInstance188: service-interface-deployment=StructContainerDdsInterfaceDeployment, qos-profile=customized_qos.xml, transport-plugins=FSHM, dds-event-qos-props=eventDdsDeployment, required-service-instance-id=10073
    IflytekPredictionPredictionResult_DdsRequiredServiceInstance189: service-interface-deployment=StructContainerDdsInterfaceDeployment, qos-profile=customized_qos.xml, transport-plugins=FSHM, dds-event-qos-props=eventDdsDeployment, required-service-instance-id=10029
    IflytekCameraPerceptionOccupancyObjects_DdsRequiredServiceInstance190: service-interface-deployment=StructContainerDdsInterfaceDeployment, qos-profile=large_buffer_qos.xml, transport-plugins=FSHM, dds-event-qos-props=eventDdsDeployment, required-service-instance-id=10044
    IflytekFusionRoadFusion_DdsRequiredServiceInstance191: service-interface-deployment=StructContainerDdsInterfaceDeployment, qos-profile=customized_qos.xml, transport-plugins=FSHM, dds-event-qos-props=eventDdsDeployment, required-service-instance-id=10133
    IflytekFusionRoadFusion_DdsRequiredServiceInstance190: service-interface-deployment=StructContainerDdsInterfaceDeployment, qos-profile=customized_qos.xml, transport-plugins=FSHM, dds-event-qos-props=eventDdsDeployment, required-service-instance-id=10133
    IflytekCameraPerception3dGeneralObjects_DdsRequiredServiceInstance191: service-interface-deployment=StructContainerDdsInterfaceDeployment, qos-profile=customized_qos.xml, transport-plugins=FSHM, dds-event-qos-props=eventDdsDeployment, required-service-instance-id=10043
    IflytekCameraPerceptionParkingSlotList_DdsRequiredServiceInstance192: service-interface-deployment=StructContainerDdsInterfaceDeployment, qos-profile=default_qos.xml, transport-plugins=FSHM, dds-event-qos-props=eventDdsDeployment, required-service-instance-id=10014
    IflytekCameraPerceptionParkingLaneLine_DdsRequiredServiceInstance193: service-interface-deployment=StructContainerDdsInterfaceDeployment, qos-profile=customized_qos.xml, transport-plugins=FSHM, dds-event-qos-props=eventDdsDeployment, required-service-instance-id=10074
    IflytekFusionObjectsCompress_DdsRequiredServiceInstance194: service-interface-deployment=StructContainerDdsInterfaceDeployment, qos-profile=small_buffer_qos.xml, transport-plugins=FSHM, dds-event-qos-props=eventDdsDeployment, required-service-instance-id=10059
    IflytekFusionUssPerceptionInfo_DdsRequiredServiceInstance195: service-interface-deployment=StructContainerDdsInterfaceDeployment, qos-profile=customized_qos.xml, transport-plugins=FSHM, dds-event-qos-props=eventDdsDeployment, required-service-instance-id=10086
    IflytekFusionOccupancyObjects_DdsRequiredServiceInstance196: service-interface-deployment=StructContainerDdsInterfaceDeployment, qos-profile=large_buffer_qos.xml, transport-plugins=FSHM, dds-event-qos-props=eventDdsDeployment, required-service-instance-id=10091
    IflytekFusionRoadFusionCompress_DdsRequiredServiceInstance197: service-interface-deployment=StructContainerDdsInterfaceDeployment, qos-profile=small_buffer_qos.xml, transport-plugins=FSHM, dds-event-qos-props=eventDdsDeployment, required-service-instance-id=10004
    IflytekFusionGroundLine_DdsRequiredServiceInstance198: service-interface-deployment=StructContainerDdsInterfaceDeployment, qos-profile=default_qos.xml, transport-plugins=FSHM, dds-event-qos-props=eventDdsDeployment, required-service-instance-id=10068
    IflytekFusionSpeedBump_DdsRequiredServiceInstance199: service-interface-deployment=StructContainerDdsInterfaceDeployment, qos-profile=small_buffer_qos.xml, transport-plugins=FSHM, dds-event-qos-props=eventDdsDeployment, required-service-instance-id=10094
    IflytekUssUsswaveInfo_DdsRequiredServiceInstance200: service-interface-deployment=StructContainerDdsInterfaceDeployment, qos-profile=small_buffer_qos.xml, transport-plugins=FSHM, dds-event-qos-props=eventDdsDeployment, required-service-instance-id=10018
    IflytekRadarFlPerceptionInfo_DdsRequiredServiceInstance201: service-interface-deployment=StructContainerDdsInterfaceDeployment, qos-profile=small_buffer_qos.xml, transport-plugins=FSHM, dds-event-qos-props=eventDdsDeployment, required-service-instance-id=10022
    IflytekRadarFrPerceptionInfo_DdsRequiredServiceInstance202: service-interface-deployment=StructContainerDdsInterfaceDeployment, qos-profile=small_buffer_qos.xml, transport-plugins=FSHM, dds-event-qos-props=eventDdsDeployment, required-service-instance-id=10026
    IflytekRadarRlPerceptionInfo_DdsRequiredServiceInstance203: service-interface-deployment=StructContainerDdsInterfaceDeployment, qos-profile=small_buffer_qos.xml, transport-plugins=FSHM, dds-event-qos-props=eventDdsDeployment, required-service-instance-id=10028
    IflytekRadarRrPerceptionInfo_DdsRequiredServiceInstance204: service-interface-deployment=StructContainerDdsInterfaceDeployment, qos-profile=small_buffer_qos.xml, transport-plugins=FSHM, dds-event-qos-props=eventDdsDeployment, required-service-instance-id=10030
    IflytekAdasFunctionAdas_DdsRequiredServiceInstance205: service-interface-deployment=StructContainerDdsInterfaceDeployment, qos-profile=small_buffer_qos.xml, transport-plugins=FSHM, dds-event-qos-props=eventDdsDeployment, required-service-instance-id=10151
    IflytekControlControlCommand_DdsRequiredServiceInstance206: service-interface-deployment=StructContainerDdsInterfaceDeployment, qos-profile=small_buffer_qos.xml, transport-plugins=FSHM, dds-event-qos-props=eventDdsDeployment, required-service-instance-id=10080
    IflytekAlarmInfoFmAService_DdsRequiredServiceInstance207: service-interface-deployment=StructContainerDdsInterfaceDeployment, qos-profile=small_buffer_qos.xml, transport-plugins=FSHM, dds-event-qos-props=eventDdsDeployment, required-service-instance-id=10155
    IflytekDTCInfoFmAService_DdsRequiredServiceInstance208: service-interface-deployment=StructContainerDdsInterfaceDeployment, qos-profile=default_qos.xml, transport-plugins=FSHM, dds-event-qos-props=eventDdsDeployment, required-service-instance-id=10156
    IflytekSensorCameraSideFr_DdsRequiredCalibration: service-interface-deployment=CameraStructContainerDdsInterfaceDeployment, qos-profile=small_buffer_qos.xml, transport-plugins=NDSHM, dds-event-qos-props=DdsEventDeployment, required-service-instance-id=10052
    IflytekSensorCameraRear_DdsRequiredCalibration: service-interface-deployment=CameraStructContainerDdsInterfaceDeployment, qos-profile=small_buffer_qos.xml, transport-plugins=NDSHM, dds-event-qos-props=DdsEventDeployment, required-service-instance-id=10055
  required someip service instance IflytekPostSaleCalibrationActivation_RequiredSomeipSocBCommunication: service-interface-deployment=ClientServiceContainerInterfaceDeployment, required-service-instance-id=10013
    someip required event group eventGroup1: event-group=ClientServiceContainerInterfaceDeployment/SomeipEventGroup
  required someip service instance IflytekPostSaleCalibrationStop_RequiredSomeipSocBCommunication: service-interface-deployment=ClientServiceContainerInterfaceDeployment, required-service-instance-id=10014
    someip required event group eventGroup1: event-group=ClientServiceContainerInterfaceDeployment/SomeipEventGroup
  required someip service instance IflytekPostSaleCalibrationResult_RequiredSomeipSocBCommunication: service-interface-deployment=ClientServiceContainerInterfaceDeployment, required-service-instance-id=10016
    someip required event group eventGroup1: event-group=ClientServiceContainerInterfaceDeployment/SomeipEventGroup
  33 x dds required service instance, all with domain-id=30:
    IflytekAlarmInfoToBCamera_DdsRequiredCameraNodePanoramaView: service-interface-deployment=StructContainerDdsInterfaceDeployment, qos-profile=small_buffer_qos.xml, transport-plugins=FSHM, dds-event-qos-props=eventDdsDeployment, required-service-instance-id=10108
    IflytekAlarmInfoToACamera_DdsRequiredCameraNodeAroundView: service-interface-deployment=StructContainerDdsInterfaceDeployment, qos-profile=small_buffer_qos.xml, transport-plugins=FSHM, dds-event-qos-props=eventDdsDeployment, required-service-instance-id=10109
    IflytekSystemVersion_DdsRequiredSocACommunication: service-interface-deployment=StructContainerDdsInterfaceDeployment, qos-profile=small_buffer_qos.xml, transport-plugins=FSHM, dds-event-qos-props=eventDdsDeployment, required-service-instance-id=10159
    IflytekFdlTrigger_DdsRequiredSocBCommunication: service-interface-deployment=StructContainerDdsInterfaceDeployment, qos-profile=small_buffer_qos.xml, transport-plugins=FSHM, dds-event-qos-props=eventDdsDeployment, required-service-instance-id=10161
    IflytekFdlTriggerAck_DdsRequiredSocACommunication: service-interface-deployment=StructContainerDdsInterfaceDeployment, qos-profile=small_buffer_qos.xml, transport-plugins=FSHM, dds-event-qos-props=eventDdsDeployment, required-service-instance-id=10163
    IflytekFmAMcuSentinel_DdsRequiredComServicePncNode: service-interface-deployment=StructContainerDdsInterfaceDeployment, qos-profile=small_buffer_qos.xml, transport-plugins=FSHM, dds-event-qos-props=eventDdsDeployment, required-service-instance-id=10166
    IflytekFmACameraSentinel_DdsRequiredCameraNodeAroundView: service-interface-deployment=StructContainerDdsInterfaceDeployment, qos-profile=default_qos.xml, transport-plugins=FSHM, dds-event-qos-props=eventDdsDeployment, required-service-instance-id=10168
    IflytekPlanningDebugInfo_DdsRequiredSocACommunication: service-interface-deployment=StructContainerDdsInterfaceDeployment, qos-profile=default_qos.xml, transport-plugins=FSHM, dds-event-qos-props=eventDdsDeployment, required-service-instance-id=10169
    IflytekControlDebugInfo_DdsRequiredSocACommunication: service-interface-deployment=StructContainerDdsInterfaceDeployment, qos-profile=customized_qos.xml, transport-plugins=FSHM, dds-event-qos-props=eventDdsDeployment, required-service-instance-id=10170
    IflytekAdasFunctionDebugInfo_DdsRequiredSocACommunication: service-interface-deployment=StructContainerDdsInterfaceDeployment, qos-profile=small_buffer_qos.xml, transport-plugins=FSHM, dds-event-qos-props=eventDdsDeployment, required-service-instance-id=10177
    IflytekRadarPerception4dTargetMcu_DdsRequiredServiceInstance217: service-interface-deployment=StructContainerDdsInterfaceDeployment, qos-profile=default_qos.xml, transport-plugins=FSHM, dds-event-qos-props=eventDdsDeployment, required-service-instance-id=10179
    IflytekRadarPerception4dTargetMcu_DdsRequiredServiceInstance218: service-interface-deployment=StructContainerDdsInterfaceDeployment, qos-profile=default_qos.xml, transport-plugins=FSHM, dds-event-qos-props=eventDdsDeployment, required-service-instance-id=10180
    IflytekEngineerInner_DdsRequiredFiniteStateManager: service-interface-deployment=StructContainerDdsInterfaceDeployment, qos-profile=small_buffer_qos.xml, transport-plugins=FSHM, dds-event-qos-props=eventDdsDeployment, required-service-instance-id=10181
    IflytekEngineerInner_DdsRequiredSocBCommunication: service-interface-deployment=StructContainerDdsInterfaceDeployment, qos-profile=small_buffer_qos.xml, transport-plugins=FSHM, dds-event-qos-props=eventDdsDeployment, required-service-instance-id=10181
    IflytekFmAMcuDegradeFunciton_DdsRequiredServiceInstance221: service-interface-deployment=StructContainerDdsInterfaceDeployment, qos-profile=default_qos.xml, transport-plugins=FSHM, dds-event-qos-props=eventDdsDeployment, required-service-instance-id=10183
    IflytekFmADegradeFunciton_DdsRequiredServiceInstance222: service-interface-deployment=StructContainerDdsInterfaceDeployment, qos-profile=small_buffer_qos.xml, transport-plugins=FSHM, dds-event-qos-props=eventDdsDeployment, required-service-instance-id=10184
    IflytekFmADegradeFunciton_DdsRequiredServiceInstance223: service-interface-deployment=StructContainerDdsInterfaceDeployment, qos-profile=small_buffer_qos.xml, transport-plugins=FSHM, dds-event-qos-props=eventDdsDeployment, required-service-instance-id=10184
    IflytekFmADegradeFunciton_DdsRequiredServiceInstance224: service-interface-deployment=StructContainerDdsInterfaceDeployment, qos-profile=small_buffer_qos.xml, transport-plugins=FSHM, dds-event-qos-props=eventDdsDeployment, required-service-instance-id=10185
    IflytekCameraPerceptionPanoramaView2DBoundingBoxes_DdsRequiredServiceInstance225: service-interface-deployment=StructContainerDdsInterfaceDeployment, qos-profile=default_qos.xml, transport-plugins=FSHM, dds-event-qos-props=eventDdsDeployment, required-service-instance-id=10186
    IflytekCameraPerceptionPanoramaView2DBoundingBoxes_DdsRequiredServiceInstance226: service-interface-deployment=StructContainerDdsInterfaceDeployment, qos-profile=default_qos.xml, transport-plugins=FSHM, dds-event-qos-props=eventDdsDeployment, required-service-instance-id=10187
    IflytekCameraPerceptionPanoramaView2DBoundingBoxes_DdsRequiredServiceInstance227: service-interface-deployment=StructContainerDdsInterfaceDeployment, qos-profile=default_qos.xml, transport-plugins=FSHM, dds-event-qos-props=eventDdsDeployment, required-service-instance-id=10186
    IflytekCameraPerceptionAroundView2DBoundingBoxes_DdsRequiredServiceInstance228: service-interface-deployment=StructContainerDdsInterfaceDeployment, qos-profile=customized_qos.xml, transport-plugins=FSHM, dds-event-qos-props=eventDdsDeployment, required-service-instance-id=10188
    IflytekSensorCameraFront120FullResolutionClearH265_DdsRequiredServiceInstance229: service-interface-deployment=CameraStructContainerDdsInterfaceDeployment, qos-profile=small_buffer_qos.xml, transport-plugins=NDSHM, dds-event-qos-props=DdsEventDeployment, required-service-instance-id=10189
    IflytekSensorCameraRearFullResolutionH265MDCA_DdsRequiredSocACommunication: service-interface-deployment=CameraStructContainerDdsInterfaceDeployment, qos-profile=small_buffer_qos.xml, transport-plugins=NDSHM, dds-event-qos-props=DdsEventDeployment, required-service-instance-id=10135
    IflytekFmAMcuSentinel_DdsRequiredServiceInstance231: service-interface-deployment=StructContainerDdsInterfaceDeployment, qos-profile=small_buffer_qos.xml, transport-plugins=FSHM, dds-event-qos-props=eventDdsDeployment, required-service-instance-id=10166
    IflytekMcuFmASentinel_DdsRequiredServiceInstance232: service-interface-deployment=StructContainerDdsInterfaceDeployment, qos-profile=small_buffer_qos.xml, transport-plugins=FSHM, dds-event-qos-props=eventDdsDeployment, required-service-instance-id=10165
    IflytekCameraPerceptionAroundView2DBoundingBoxes_DdsRequiredServiceInstance233: service-interface-deployment=StructContainerDdsInterfaceDeployment, qos-profile=customized_qos.xml, transport-plugins=FSHM, dds-event-qos-props=eventDdsDeployment, required-service-instance-id=10188
    IflytekCameraPerception3dOccupancyObjects_DdsRequiredServiceInstance234: service-interface-deployment=StructContainerDdsInterfaceDeployment, qos-profile=large_buffer_qos.xml, transport-plugins=FSHM, dds-event-qos-props=eventDdsDeployment, required-service-instance-id=10212
    IflytekSensorTboxTime_DdsRequiredSocACommunication: service-interface-deployment=StructContainerDdsInterfaceDeployment, qos-profile=large_buffer_qos.xml, transport-plugins=FSHM, dds-event-qos-props=eventDdsDeployment, required-service-instance-id=10011
    IflytekSensorTboxTime_DdsRequiredGnssServiceNode: service-interface-deployment=StructContainerDdsInterfaceDeployment, qos-profile=large_buffer_qos.xml, transport-plugins=FSHM, dds-event-qos-props=eventDdsDeployment, required-service-instance-id=10032
    IflytekVehicleService_DdsRequiredCameraNodeAroundView: service-interface-deployment=StructContainerDdsInterfaceDeployment, qos-profile=small_buffer_qos.xml, transport-plugins=FSHM, dds-event-qos-props=eventDdsDeployment, required-service-instance-id=10009
    IflytekFsmSocState_DdsRequiredCameraNodeAroundView: service-interface-deployment=StructContainerDdsInterfaceDeployment, qos-profile=small_buffer_qos.xml, transport-plugins=FSHM, dds-event-qos-props=eventDdsDeployment, required-service-instance-id=10110
    IflytekFdlUploadState_DdsRequiredSocBCommunication: service-interface-deployment=StructContainerDdsInterfaceDeployment, qos-profile=small_buffer_qos.xml, transport-plugins=FSHM, dds-event-qos-props=eventDdsDeployment, required-service-instance-id=10154
  required someip service instance IflytekFdlNetStatCheck_RequiredSomeipSocBCommunication: service-interface-deployment=ClientServiceContainerInterfaceDeployment, required-service-instance-id=10042
    someip required event group eventGroup1: event-group=ClientServiceContainerInterfaceDeployment/SomeipEventGroup
  12 x dds required service instance, all with service-interface-deployment=StructContainerDdsInterfaceDeployment, domain-id=30, transport-plugins=FSHM, dds-event-qos-props=eventDdsDeployment:
    IflytekDiskSpaceInfoPhmBOta_DdsRequiredSocBCommunication: qos-profile=default_qos.xml, required-service-instance-id=10219
    IflytekDiskCleanRequest_DdsRequiredSocACommunication: qos-profile=small_buffer_qos.xml, required-service-instance-id=10221
    IflytekDiskStatePhmAFdl_DdsRequiredSocACommunication: qos-profile=default_qos.xml, required-service-instance-id=10223
    IflytekDiskCleanRequestPhmAFdl_DdsRequiredServiceInstance243: qos-profile=small_buffer_qos.xml, required-service-instance-id=10225
    IflytekEhpParkingMap_DdsRequiredSocACommunication: qos-profile=customized_qos.xml, required-service-instance-id=10046
    IflytekEhpParkingMap_DdsRequiredLocalization: qos-profile=customized_qos.xml, required-service-instance-id=10047
    IflytekEhpParkingMap_DdsRequiredEhr: qos-profile=customized_qos.xml, required-service-instance-id=10047
    IflytekEhpParkingMap_DdsRequiredFiniteStateManager: qos-profile=customized_qos.xml, required-service-instance-id=10047
    IflytekEhpParkingMapFileInfo_DdsRequiredSocACommunication: qos-profile=small_buffer_qos.xml, required-service-instance-id=10114
    IflytekEhpMapManager_DdsRequiredSocACommunication: qos-profile=small_buffer_qos.xml, required-service-instance-id=10235
    IflytekEhpMapManager_DdsRequiredFiniteStateManager: qos-profile=small_buffer_qos.xml, required-service-instance-id=10236
    IflytekCameraAroundErrorStatus_DdsRequiredComServicePncNode: qos-profile=small_buffer_qos.xml, required-service-instance-id=10238
  required someip service instance IflytekOtaLogUploadRequest_RequiredSomeipSocBCommunication: service-interface-deployment=ClientServiceContainerInterfaceDeployment, required-service-instance-id=10045
    someip required event group eventGroup1: event-group=ClientServiceContainerInterfaceDeployment/SomeipEventGroup
  11 x dds required service instance, all with domain-id=30:
    IflytekSystemAProcessLoading_DdsRequiredSocACommunication: service-interface-deployment=StructContainerDdsInterfaceDeployment, qos-profile=default_qos.xml, transport-plugins=FSHM, dds-event-qos-props=eventDdsDeployment, required-service-instance-id=10230
    IflytekCameraPerceptionDrivableSpaceGrid_DdsRequiredPlanning: service-interface-deployment=StructContainerDdsInterfaceDeployment, qos-profile=default_qos.xml, transport-plugins=FSHM, dds-event-qos-props=eventDdsDeployment, required-service-instance-id=10101
    IflytekCameraPerceptionDrivableSpaceGrid_DdsRequiredSocACommunication: service-interface-deployment=StructContainerDdsInterfaceDeployment, qos-profile=default_qos.xml, transport-plugins=FSHM, dds-event-qos-props=eventDdsDeployment, required-service-instance-id=10101
    IflytekCameraPerceptionDrivableSpaceGrid_DdsRequiredFiniteStateManager: service-interface-deployment=StructContainerDdsInterfaceDeployment, qos-profile=default_qos.xml, transport-plugins=FSHM, dds-event-qos-props=eventDdsDeployment, required-service-instance-id=10167
    IflytekCameraPerceptionObstacleFeature_DdsRequiredSocBCommunication: service-interface-deployment=CameraStructContainerDdsInterfaceDeployment, qos-profile=small_buffer_qos.xml, transport-plugins=NDSHM, dds-event-qos-props=DdsEventDeployment, required-service-instance-id=10048
    IflytekCameraPerceptionLaneFeature_DdsRequiredSocBCommunication: service-interface-deployment=CameraStructContainerDdsInterfaceDeployment, qos-profile=small_buffer_qos.xml, transport-plugins=NDSHM, dds-event-qos-props=DdsEventDeployment, required-service-instance-id=10049
    IflytekFusionOccupancyObjects_DdsRequiredFiniteStateManager: service-interface-deployment=StructContainerDdsInterfaceDeployment, qos-profile=large_buffer_qos.xml, transport-plugins=FSHM, dds-event-qos-props=eventDdsDeployment, required-service-instance-id=10142
    IflytekEhpParkingMapToHmi_DdsRequiredSocACommunication: service-interface-deployment=StructContainerDdsInterfaceDeployment, qos-profile=customized_qos.xml, transport-plugins=FSHM, dds-event-qos-props=eventDdsDeployment, required-service-instance-id=10216
    IflytekCanTxInfo_DdsRequiredSocACommunication: service-interface-deployment=StructContainerDdsInterfaceDeployment, qos-profile=small_buffer_qos.xml, transport-plugins=FSHM, dds-event-qos-props=eventDdsDeployment, required-service-instance-id=10242
    IflytekMegaMappingStatus_DdsRequiredStaticFusion: service-interface-deployment=StructContainerDdsInterfaceDeployment, qos-profile=small_buffer_qos.xml, transport-plugins=FSHM, dds-event-qos-props=eventDdsDeployment, required-service-instance-id=10090
    IflytekAdasFunctionAdas_DdsRequiredFiniteStateManager: service-interface-deployment=StructContainerDdsInterfaceDeployment, qos-profile=small_buffer_qos.xml, transport-plugins=FSHM, dds-event-qos-props=eventDdsDeployment, required-service-instance-id=10152
package /serviceInterface
  dds service interface deployment FmAlarmReceiveService_DdsDeployment: service-interface=FmAlarmReceiveService, service-interface-id=3
    dds method deployment ReportAlarmDdsDeployment: method=ReportAlarm, dds-rpc-service=ReportAlarmRpcServiceDeployment
    dds rpc service deployment ReportAlarmRpcServiceDeployment: reply-topic-name=ReplyTopicOfReportAlarm, request-topic-name=RequestTopicOfReportAlarm
  someip service interface deployment StructContainerInterface_SomeIpDeployment: service-interface=StructContainerInterface, service-interface-id=1
    someip event deployment eventSomeipDeployment: event=StructContainerInterface/event, event-id=1, transport-protocol=TCP
    someip event group SomeipEventGroup: event-group-id=1, event=eventSomeipDeployment
  dds service interface deployment ClientServiceContainerInterface_DdsDeployment: service-interface=ClientServiceContainerInterface, service-interface-id=4
    dds method deployment methodDdsDeployment: method=method, dds-rpc-service=methodRpcServiceDeployment
    dds rpc service deployment methodRpcServiceDeployment: reply-topic-name=ReplyTopicOfMethod, request-topic-name=RequestTopicOfMethod
