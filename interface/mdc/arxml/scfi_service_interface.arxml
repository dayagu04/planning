[part 2 of 3: packages /HuaweiMDC/exe_manifests/InstanceToPortMappings to /HuaweiMDC/interface_manifests/datatypes]
AUTOSAR XML (schema 00048)
package /HuaweiMDC/exe_manifests/InstanceToPortMappings
  493 x service instance to port prototype mapping:
    IflytekFusionRoadFusion_compress_DdsProvidedServiceInstance5_PortMapping: port-prototype=static_fusion_libExecutable4Prototype.IflytekFusionRoadFusionCompress, process=static_fusion_libProcessDesign5, service-instance=IflytekFusionRoadFusion_compress_DdsProvidedServiceInstance5
    IflytekFusionParkingSlot_DdsProvidedServiceInstance6_PortMapping: port-prototype=static_fusion_libExecutable4Prototype.IflytekFusionParkingSlot, process=static_fusion_libProcessDesign5, service-instance=IflytekFusionParkingSlot_DdsProvidedServiceInstance6
    IflytekLocalizationEgomotion_DdsProvidedServiceInstance17_PortMapping: port-prototype=localization_libExecutable7Prototype.IflytekLocalizationEgomotion, process=localization_libProcessDesign8, service-instance=IflytekLocalizationEgomotion_DdsProvidedLocalization
    IflytekSensorCameraPanoramaImageFront_DdsProvidedServiceInstance51_PortMapping: port-prototype=camera_node_panorama_view_libExecutable16Prototype.IflytekSensorCameraFront30, process=camera_node_panorama_view_libProcessDesign17, service-instance=IflytekSensorCameraPanoramaImageFront_DdsProvidedServiceInstance51
    IflytekSensorCameraPanoramaImageFront_DdsRequiredServiceInstance81_PortMapping: port-prototype=panorama_view_camera_perception_libExecutable10Prototype.IflytekSensorCameraFront30, process=panorama_view_camera_perception_libProcessDesign11, service-instance=IflytekSensorCameraFront30_DdsRequiredServiceInstance81
    IflytekSensorCameraPanoramaImageFl_DdsProvidedServiceInstance52_PortMapping: port-prototype=camera_node_panorama_view_libExecutable16Prototype.IflytekSensorCameraSideFl, process=camera_node_panorama_view_libProcessDesign17, service-instance=IflytekSensorCameraPanoramaImageFl_DdsProvidedServiceInstance52
    IflytekSensorCameraPanoramaImageFl_DdsRequiredServiceInstance82_PortMapping: port-prototype=panorama_view_camera_perception_libExecutable10Prototype.IflytekSensorCameraSideFl, process=panorama_view_camera_perception_libProcessDesign11, service-instance=IflytekSensorCameraSideFl_DdsRequiredServiceInstance82
    IflytekSensorCameraPanoramaImageFr_DdsProvidedServiceInstance53_PortMapping: port-prototype=camera_node_panorama_view_libExecutable16Prototype.IflytekSensorCameraSideFr, process=camera_node_panorama_view_libProcessDesign17, service-instance=IflytekSensorCameraPanoramaImageFr_DdsProvidedServiceInstance53
    IflytekSensorCameraPanoramaImageFr_DdsRequiredServiceInstance83_PortMapping: port-prototype=panorama_view_camera_perception_libExecutable10Prototype.IflytekSensorCameraSideFr, process=panorama_view_camera_perception_libProcessDesign11, service-instance=IflytekSensorCameraSideFr_DdsRequiredServiceInstance83
    IflytekSensorCameraPanoramaImageRl_DdsProvidedServiceInstance54_PortMapping: port-prototype=camera_node_panorama_view_libExecutable16Prototype.IflytekSensorCameraSideRl, process=camera_node_panorama_view_libProcessDesign17, service-instance=IflytekSensorCameraPanoramaImageRl_DdsProvidedServiceInstance54
    IflytekSensorCameraPanoramaImageRl_DdsRequiredServiceInstance84_PortMapping: port-prototype=panorama_view_camera_perception_libExecutable10Prototype.IflytekSensorCameraSideRl, process=panorama_view_camera_perception_libProcessDesign11, service-instance=IflytekSensorCameraSideRl_DdsRequiredServiceInstance84
    IflytekSensorCameraPanoramaImageRr_DdsProvidedServiceInstance55_PortMapping: port-prototype=camera_node_panorama_view_libExecutable16Prototype.IflytekSensorCameraSideRr, process=camera_node_panorama_view_libProcessDesign17, service-instance=IflytekSensorCameraPanoramaImageRr_DdsProvidedServiceInstance55
    IflytekSensorCameraPanoramaImageRr_DdsRequiredServiceInstance85_PortMapping: port-prototype=panorama_view_camera_perception_libExecutable10Prototype.IflytekSensorCameraSideRr, process=panorama_view_camera_perception_libProcessDesign11, service-instance=IflytekSensorCameraSideRr_DdsRequiredServiceInstance85
    IflytekSensorCameraPanoramaImageRear_DdsProvidedServiceInstance56_PortMapping: port-prototype=camera_node_panorama_view_libExecutable16Prototype.IflytekSensorCameraRear, process=camera_node_panorama_view_libProcessDesign17, service-instance=IflytekSensorCameraRear_DdsProvidedServiceInstance56
    IflytekSensorGnss_DdsProvidedServiceInstance57_PortMapping: port-prototype=gnss_service_node_libExecutable17Prototype.IflytekSensorGnss, process=gnss_service_node_libProcessDesign18, service-instance=IflytekSensorGnss_DdsProvidedGnssServiceNode
    IflytekSensorGnss_DdsRequiredServiceInstance87_PortMapping: port-prototype=localization_libExecutable7Prototype.IflytekSensorGnss, process=localization_libProcessDesign8, service-instance=IflytekSensorGnss_DdsRequiredServiceInstance87
    IflytekSensorPboxImu_DdsRequiredServiceInstance90_PortMapping: port-prototype=localization_libExecutable7Prototype, process=localization_libProcessDesign8
    IflytekSensorPboxImu_DdsRequiredServiceInstance120_PortMapping: process=diagnosis_b_libProcessDesign22
    IflytekCameraPerceptionDebugInfo_DdsRequiredServiceInstance135_PortMapping: process=diagnosis_b_libProcessDesign22
    struct_container_DdsProvidedServiceInstance62_PortMapping: port-prototype=common_swc_libExecutable22Prototype.structContainer, process=common_swc_libProcessDesign23, service-instance=struct_container_DdsProvidedServiceInstance62
    RPortPrototype1_DdsRequiredServiceInstance154_PortMapping: port-prototype=common_swc_libExecutable23Prototype.structContainer, process=common_swc_libProcessDesign24, service-instance=RPortPrototype1_DdsRequiredServiceInstance154
    struct_container_DdsProvidedServiceInstance63_PortMapping: port-prototype=common_swc_libExecutable23Prototype.structContainer, process=common_swc_libProcessDesign24, service-instance=struct_container_DdsProvidedServiceInstance63
    RPortPrototype1_DdsRequiredServiceInstance155_PortMapping: port-prototype=common_swc_libExecutable22Prototype.structContainer, process=common_swc_libProcessDesign23, service-instance=RPortPrototype1_DdsRequiredServiceInstance155
    camera_struct_container_DdsProvidedServiceInstance64_PortMapping: port-prototype=common_swc_libExecutable22Prototype.cameraStructContainer, process=common_swc_libProcessDesign23, service-instance=camera_struct_container_DdsProvidedServiceInstance64
    RPortPrototype1_DdsRequiredServiceInstance156_PortMapping: port-prototype=common_swc_libExecutable23Prototype.cameraStructContainer, process=common_swc_libProcessDesign24, service-instance=RPortPrototype1_DdsRequiredServiceInstance156
    camera_struct_container_DdsProvidedServiceInstance65_PortMapping: port-prototype=common_swc_libExecutable23Prototype.cameraStructContainer, process=common_swc_libProcessDesign24, service-instance=camera_struct_container_DdsProvidedServiceInstance65
    RPortPrototype1_DdsRequiredServiceInstance157_PortMapping: port-prototype=common_swc_libExecutable22Prototype.cameraStructContainer, process=common_swc_libProcessDesign23, service-instance=RPortPrototype1_DdsRequiredServiceInstance157
    IflytekSensorCameraFront120_DdsProvidedServiceInstance66_PortMapping: port-prototype=camera_node_panorama_view_libExecutable16Prototype.IflytekSensorCameraFront120, process=camera_node_panorama_view_libProcessDesign17, service-instance=IflytekSensorCameraFront120_DdsProvidedServiceInstance66
    RPortPrototype1_DdsRequiredServiceInstance172_PortMapping: port-prototype=panorama_view_camera_perception_libExecutable10Prototype.IflytekSensorCameraFront120, process=panorama_view_camera_perception_libProcessDesign11, service-instance=IflytekSensorCameraFront120_DdsRequiredServiceInstance172
    IflytekSensorCameraFront120Eagle_DdsProvidedServiceInstance67_PortMapping: port-prototype=camera_node_panorama_view_libExecutable16Prototype.IflytekSensorCameraFront120Eagle, process=camera_node_panorama_view_libProcessDesign17, service-instance=IflytekSensorCameraFront120Eagle_DdsProvidedServiceInstance67
    RPortPrototype1_DdsRequiredServiceInstance173_PortMapping: port-prototype=panorama_view_camera_perception_libExecutable10Prototype.IflytekSensorCameraFront120Eagle, process=panorama_view_camera_perception_libProcessDesign11, service-instance=IflytekSensorCameraFront120Eagle_DdsRequiredServiceInstance173
    RPortPrototype1_DdsRequiredServiceInstance170_PortMapping: port-prototype=ehr_libExecutable8Prototype.IflytekSdmapSdmapInfo, process=ehr_libProcessDesign9, service-instance=IflytekSdmapSdmapInfo_DdsRequiredServiceInstance170
    IflytekEhrSdmapInfo_DdsProvidedServiceInstance59_PortMapping: port-prototype=ehr_libExecutable8Prototype.IflytekEhrSdmapInfo, process=ehr_libProcessDesign9, service-instance=IflytekEhrSdmapInfo_DdsProvidedServiceInstance59
    RPortPrototype1_DdsRequiredServiceInstance167_PortMapping: port-prototype=control_libExecutable2Prototype, process=control_libProcessDesign3
    RPortPrototype1_DdsRequiredServiceInstance167_PortMapping: port-prototype=static_fusion_libExecutable4Prototype.IflytekMegaLocalMap, process=static_fusion_libProcessDesign5, service-instance=IflytekMegaLocalMap_DdsRequiredServiceInstance167
    RPortPrototype1_DdsRequiredServiceInstance165_PortMapping: port-prototype=uss_perception_libExecutable12Prototype, process=uss_perception_libProcessDesign13
    RPortPrototype1_DdsRequiredServiceInstance173_PortMapping: port-prototype=soc_b_communication_libExecutable19Prototype.IflytekEhrSdmapInfo, process=soc_b_communication_libProcessDesign20, service-instance=IflytekEhrSdmapInfo_DdsRequiredServiceInstance173
    IflytekEhrSdmapInfo_DdsProvidedServiceInstance66_PortMapping: port-prototype=soc_a_communication_libExecutable18Prototype.IflytekEhrSdmapInfo, process=soc_a_communication_libProcessDesign19, service-instance=IflytekEhrSdmapInfo_DdsProvidedServiceInstance66
    RPortPrototype1_DdsRequiredServiceInstance176_PortMapping: port-prototype=ehr_libExecutable8Prototype.IflytekLocalizationEgomotion, process=ehr_libProcessDesign9, service-instance=IflytekLocalizationEgomotion_DdsRequiredServiceInstance176
    IflytekSensorCameraSurroundImageFront_DdsProvidedServiceInstance61_PortMapping: port-prototype=camera_node_around_view_libExecutable15Prototype.IflytekSensorCameraSurroundResizeImageFront, process=camera_node_around_view_libProcessDesign16, service-instance=IflytekSensorCameraSurroundResizeImageFront_DdsProvidedServiceInstance61
    IflytekSensorCameraSurroundImageLeft_DdsProvidedServiceInstance62_PortMapping: port-prototype=camera_node_around_view_libExecutable15Prototype.IflytekSensorCameraSurroundResizeImageLeft, process=camera_node_around_view_libProcessDesign16, service-instance=IflytekSensorCameraSurroundResizeImageLeft_DdsProvidedCameraNodeAroundView
    IflytekSensorCameraSurroundImageRight_DdsProvidedServiceInstance63_PortMapping: port-prototype=camera_node_around_view_libExecutable15Prototype.IflytekSensorCameraSurroundResizeImageRight, process=camera_node_around_view_libProcessDesign16, service-instance=IflytekSensorCameraSurroundResizeImageRight_DdsProvidedCameraNodeAroundView
    IflytekSensorCameraSurroundImageRear_DdsProvidedServiceInstance64_PortMapping: port-prototype=camera_node_around_view_libExecutable15Prototype.IflytekSensorCameraSurroundResizeImageRear, process=camera_node_around_view_libProcessDesign16, service-instance=IflytekSensorCameraSurroundResizeImageRear_DdsProvidedCameraNodeAroundView
    PPortPrototype1_ProvidedSomeipServiceInstance1_PortMapping: port-prototype=common_swc_libExecutable22Prototype, process=common_swc_libProcessDesign23
    RPortPrototype1_RequiredSomeipServiceInstance1_PortMapping: port-prototype=common_swc_libExecutable23Prototype, process=common_swc_libProcessDesign24
    PPortPrototype1_ProvidedSomeipServiceInstance2_PortMapping: port-prototype=common_swc_libExecutable23Prototype, process=common_swc_libProcessDesign24
    RPortPrototype2_RequiredSomeipServiceInstance2_PortMapping: port-prototype=common_swc_libExecutable22Prototype, process=common_swc_libProcessDesign23
    RPortPrototype1_RequiredSomeipServiceInstance3_PortMapping: port-prototype=camera_node_around_view_libExecutable15Prototype.IflytekAlarmInfoCameraNodeAroundView, process=camera_node_around_view_libProcessDesign16, service-instance=IflytekAlarmInfoCameraNodeAroundView_RequiredSomeipCameraNodeAroundView
    RPortPrototype1_RequiredSomeipServiceInstance4_PortMapping: port-prototype=soc_a_communication_libExecutable18Prototype.IflytekAlarmInfoSocACommunication, process=soc_a_communication_libProcessDesign19, service-instance=IflytekAlarmInfoSocACommunication_RequiredSomeipServiceInstance4
    RPortPrototype1_RequiredSomeipServiceInstance5_PortMapping: port-prototype=gnss_service_node_libExecutable17Prototype.IflytekAlarmInfoGnssServiceNode, process=gnss_service_node_libProcessDesign18, service-instance=IflytekAlarmInfoGnssServiceNode_RequiredSomeipServiceInstance5
    RPortPrototype1_RequiredSomeipServiceInstance6_PortMapping: port-prototype=ehr_libExecutable8Prototype.IflytekAlarmInfoEhr, process=ehr_libProcessDesign9, service-instance=IflytekAlarmInfoEhr_RequiredSomeipServiceInstance6
    RPortPrototype1_RequiredSomeipServiceInstance8_PortMapping: port-prototype=localization_libExecutable7Prototype.IflytekAlarmInfoLocalization, process=localization_libProcessDesign8, service-instance=IflytekAlarmInfoLocalization_RequiredSomeipServiceInstance8
    RPortPrototype1_RequiredSomeipServiceInstance9_PortMapping: port-prototype=soc_b_communication_libExecutable19Prototype.IflytekAlarmInfoSocBCommunication, process=soc_b_communication_libProcessDesign20, service-instance=IflytekAlarmInfoSocBCommunication_RequiredSomeipServiceInstance9
    RPortPrototype1_RequiredSomeipServiceInstance14_PortMapping: port-prototype=camera_node_panorama_view_libExecutable16Prototype.IflytekAlarmInfoCameraNodePanoramaView, process=camera_node_panorama_view_libProcessDesign17, service-instance=IflytekAlarmInfoCameraNodePanoramaView_RequiredSomeipServiceInstance14
    RPortPrototype1_RequiredSomeipServiceInstance15_PortMapping: port-prototype=panorama_view_camera_perception_libExecutable10Prototype.IflytekAlarmInfoPanoramaViewCameraPerception, process=panorama_view_camera_perception_libProcessDesign11, service-instance=IflytekAlarmInfoPanoramaViewCameraPerception_RequiredSomeipServiceInstance15
    RPortPrototype1_RequiredSomeipServiceInstance23_PortMapping: port-prototype=common_swc_libExecutable22Prototype, process=common_swc_libProcessDesign23
    RPortPrototype1_RequiredSomeipServiceInstance21_PortMapping: port-prototype=common_swc_libExecutable23Prototype, process=common_swc_libProcessDesign24
    PPortPrototype1_ProvidedSomeipServiceInstance1_PortMapping: port-prototype=common_swc_libExecutable22Prototype.alarmInfo, process=common_swc_libProcessDesign23, service-instance=alarmInfo_ProvidedSomeipServiceInstance1
    RPortPrototype1_RequiredSomeipServiceInstance20_PortMapping: port-prototype=common_swc_libExecutable23Prototype.alarmInfo, process=common_swc_libProcessDesign24, service-instance=alarmInfo_RequiredSomeipServiceInstance20
    PPortPrototype1_ProvidedSomeipServiceInstance2_PortMapping: port-prototype=common_swc_libExecutable23Prototype.alarmInfo, process=common_swc_libProcessDesign24, service-instance=alarmInfo_ProvidedSomeipServiceInstance2
    RPortPrototype2_RequiredSomeipServiceInstance21_PortMapping: port-prototype=common_swc_libExecutable22Prototype.alarmInfo1, process=common_swc_libProcessDesign23, service-instance=alarmInfo_RequiredSomeipServiceInstance21
    IflytekCameraPerceptionTrafficSignRecognition_DdsProvidedServiceInstance68_PortMapping: port-prototype=panorama_view_camera_perception_libExecutable10Prototype.IflytekCameraPerceptionTrafficSignRecognition, process=panorama_view_camera_perception_libProcessDesign11, service-instance=IflytekCameraPerceptionTrafficSignRecognition_DdsProvidedServiceInstance68
    IflytekLocalizationEgomotion_DdsProvidedServiceInstance70_PortMapping: port-prototype=soc_a_communication_libExecutable18Prototype.IflytekLocalizationEgomotion, process=soc_a_communication_libProcessDesign19, service-instance=IflytekLocalizationEgomotion_DdsProvidedServiceInstance70
    RPortPrototype1_RequiredSomeipServiceInstance20_PortMapping: port-prototype=static_fusion_libExecutable4Prototype.IflytekAlarmInfoStaticFusion, process=static_fusion_libProcessDesign5, service-instance=IflytekAlarmInfoStaticFusion_RequiredSomeipServiceInstance20
    RPortPrototype1_DdsRequiredServiceInstance134_PortMapping: port-prototype=static_fusion_libExecutable4Prototype.IflytekLocalizationEgomotion, process=static_fusion_libProcessDesign5, service-instance=IflytekLocalizationEgomotion_DdsRequiredServiceInstance134
    RPortPrototype1_DdsRequiredServiceInstance134_PortMapping: port-prototype=static_fusion_libExecutable4Prototype.IflytekEhrSdmapInfo, process=static_fusion_libProcessDesign5, service-instance=IflytekEhrSdmapInfo_DdsRequiredServiceInstance134
    RPortPrototype1_DdsRequiredServiceInstance135_PortMapping: port-prototype=static_fusion_libExecutable4Prototype.IflytekCameraPerceptionLaneLines, process=static_fusion_libProcessDesign5, service-instance=IflytekCameraPerceptionLaneLines_DdsRequiredServiceInstance135
    RPortPrototype1_DdsRequiredServiceInstance135_PortMapping: port-prototype=static_fusion_libExecutable4Prototype.IflytekCameraPerceptionLaneTopo, process=static_fusion_libProcessDesign5, service-instance=IflytekCameraPerceptionLaneTopo_DdsRequiredServiceInstance135
    RPortPrototype1_DdsRequiredServiceInstance135_PortMapping: port-prototype=static_fusion_libExecutable4Prototype.IflytekCameraPerceptionParkingSlotList, process=static_fusion_libProcessDesign5, service-instance=IflytekCameraPerceptionParkingSlotList_DdsRequiredServiceInstance135
    RPortPrototype1_DdsRequiredServiceInstance136_PortMapping: port-prototype=static_fusion_libExecutable4Prototype.IflytekCameraPerceptionGroundLine, process=static_fusion_libProcessDesign5, service-instance=IflytekCameraPerceptionGroundLine_DdsRequiredServiceInstance136
    RPortPrototype1_DdsRequiredServiceInstance137_PortMapping: port-prototype=static_fusion_libExecutable4Prototype.IflytekCameraPerceptionParkingLaneLine, process=static_fusion_libProcessDesign5, service-instance=IflytekCameraPerceptionParkingLaneLine_DdsRequiredServiceInstance137
    RPortPrototype1_DdsRequiredServiceInstance135_PortMapping: port-prototype=static_fusion_libExecutable4Prototype.IflytekCameraPerceptionDeceler, process=static_fusion_libProcessDesign5, service-instance=IflytekCameraPerceptionDeceler_DdsRequiredServiceInstance135
    RPortPrototype1_DdsRequiredServiceInstance139_PortMapping: port-prototype=soc_b_communication_libExecutable19Prototype.IflytekLocalizationEgomotion, process=soc_b_communication_libProcessDesign20, service-instance=IflytekLocalizationEgomotion_DdsRequiredServiceInstance139
    RPortPrototype1_DdsRequiredServiceInstance138_PortMapping: port-prototype=localization_libExecutable7Prototype.IflytekEhrSdmapInfo, process=localization_libProcessDesign8, service-instance=IflytekEhrSdmapInfo_DdsRequiredServiceInstance138
    RPortPrototype1_DdsRequiredServiceInstance140_PortMapping: port-prototype=soc_b_communication_libExecutable19Prototype.IflytekSensorGnss, process=soc_b_communication_libProcessDesign20, service-instance=IflytekSensorGnss_DdsRequiredServiceInstance140
    IflytekLocalizationSemanticInfo_DdsProvidedServiceInstance75_PortMapping: port-prototype=localization_libExecutable7Prototype.IflytekLocalizationSemanticInfo, process=localization_libProcessDesign8, service-instance=IflytekLocalizationSemanticInfo_DdsProvidedServiceInstance75
    RPortPrototype1_DdsRequiredServiceInstance142_PortMapping: port-prototype=soc_b_communication_libExecutable19Prototype.IflytekLocalizationSemanticInfo, process=soc_b_communication_libProcessDesign20, service-instance=IflytekLocalizationSemanticInfo_DdsRequiredServiceInstance142
    IflytekLocalizationSemanticInfo_DdsProvidedServiceInstance76_PortMapping: port-prototype=soc_a_communication_libExecutable18Prototype.IflytekLocalizationSemanticInfo, process=soc_a_communication_libProcessDesign19, service-instance=IflytekLocalizationSemanticInfo_DdsProvidedServiceInstance76
    RPortPrototype1_DdsRequiredServiceInstance143_PortMapping: port-prototype=soc_a_communication_libExecutable18Prototype.IflytekMegaMappingStatus, process=soc_a_communication_libProcessDesign19, service-instance=IflytekMegaMappingStatus_DdsRequiredServiceInstance143
    RPortPrototype1_DdsRequiredServiceInstance145_PortMapping: port-prototype=soc_a_communication_libExecutable18Prototype.IflytekMegaLocalMap, process=soc_a_communication_libProcessDesign19, service-instance=IflytekMegaLocalMap_DdsRequiredServiceInstance145
    IflytekMegaLocalMap_DdsProvidedServiceInstance78_PortMapping: port-prototype=soc_b_communication_libExecutable19Prototype.IflytekMegaLocalMap, process=soc_b_communication_libProcessDesign20, service-instance=IflytekMegaLocalMap_DdsProvidedServiceInstance78
    RPortPrototype1_DdsRequiredServiceInstance146_PortMapping: port-prototype=localization_libExecutable7Prototype.IflytekMegaLocalMap, process=localization_libProcessDesign8, service-instance=IflytekMegaLocalMap_DdsRequiredServiceInstance146
    IflytekEhrStaticMap_DdsProvidedServiceInstance80_PortMapping: port-prototype=ehr_libExecutable8Prototype.IflytekEhrStaticMap, process=ehr_libProcessDesign9, service-instance=IflytekEhrStaticMap_DdsProvidedServiceInstance80
    RPortPrototype1_DdsRequiredServiceInstance152_PortMapping: port-prototype=soc_b_communication_libExecutable19Prototype.IflytekEhrStaticMap, process=soc_b_communication_libProcessDesign20, service-instance=IflytekEhrStaticMap_DdsRequiredServiceInstance152
    IflytekEhrStaticMap_DdsProvidedServiceInstance81_PortMapping: port-prototype=soc_a_communication_libExecutable18Prototype.IflytekEhrStaticMap, process=soc_a_communication_libProcessDesign19, service-instance=IflytekEhrStaticMap_DdsProvidedServiceInstance81
    RPortPrototype1_DdsRequiredServiceInstance153_PortMapping: port-prototype=static_fusion_libExecutable4Prototype.IflytekEhrStaticMap, process=static_fusion_libProcessDesign5, service-instance=IflytekEhrStaticMap_DdsRequiredServiceInstance153
    IflytekSensorCameraFront120FullResolutionH265_DdsProvidedServiceInstance87_PortMapping: port-prototype=camera_node_panorama_view_libExecutable16Prototype.IflytekSensorCameraFront120FullResolutionH265, process=camera_node_panorama_view_libProcessDesign17, service-instance=IflytekSensorCameraFront120FullResolutionH265_DdsProvidedServiceInstance87
    RPortPrototype1_DdsRequiredServiceInstance161_PortMapping: port-prototype=soc_b_communication_libExecutable19Prototype.IflytekSensorCameraFront120FullResolutionH265, process=soc_b_communication_libProcessDesign20, service-instance=IflytekSensorCameraFront120FullResolutionH265_DdsRequiredServiceInstance161
    IflytekSensorCameraFront120FullResolutionH265_DdsProvidedServiceInstance88_PortMapping: port-prototype=soc_a_communication_libExecutable18Prototype.IflytekSensorCameraFront120FullResolutionH265, process=soc_a_communication_libProcessDesign19, service-instance=IflytekSensorCameraFront120FullResolutionH265_DdsProvidedServiceInstance88
    clientServiceContainer_ProvidedSomeipServiceInstance3_PortMapping: port-prototype=common_swc_libExecutable23Prototype.clientServiceContainer, process=common_swc_libProcessDesign24, service-instance=clientServiceContainer_ProvidedSomeipServiceInstance3
    RPortPrototype1_RequiredSomeipServiceInstance21_PortMapping: port-prototype=common_swc_libExecutable22Prototype.clientServiceContainer1, process=common_swc_libProcessDesign23, service-instance=clientServiceContainer_RequiredSomeipServiceInstance21
    clientServiceContainer_ProvidedSomeipServiceInstance4_PortMapping: port-prototype=common_swc_libExecutable22Prototype.clientServiceContainer, process=common_swc_libProcessDesign23, service-instance=clientServiceContainer_ProvidedSomeipServiceInstance4
    RPortPrototype1_RequiredSomeipServiceInstance22_PortMapping: port-prototype=common_swc_libExecutable23Prototype.clientServiceContainer, process=common_swc_libProcessDesign24, service-instance=clientServiceContainer_RequiredSomeipServiceInstance22
    IflytekSensorGetSurroundCalibrationIntrlParam_ProvidedSomeipServiceInstance6_PortMapping: port-prototype=camera_node_around_view_libExecutable15Prototype.IflytekSensorGetSurroundCameraIntriParam, process=camera_node_around_view_libProcessDesign16, service-instance=IflytekSensorGetSurroundCameraIntriParam_ProvidedSomeipCameraNodeAroundView
    IflytekSensorGetPanoramaCalibrationIntrlParam_ProvidedSomeipServiceInstance7_PortMapping: port-prototype=camera_node_panorama_view_libExecutable16Prototype.IflytekSensorGetPanoramaCameraIntriParam, process=camera_node_panorama_view_libProcessDesign17, service-instance=IflytekSensorGetPanoramaCameraIntriParam_ProvidedSomeipServiceInstance7
    RPortPrototype1_RequiredSomeipServiceInstance24_PortMapping: port-prototype=soc_b_communication_libExecutable19Prototype.IflytekSensorGetPanoramaCameraIntriParam, process=soc_b_communication_libProcessDesign20, service-instance=IflytekSensorGetPanoramaCameraIntriParam_RequiredSomeipServiceInstance24
    IflytekSensorGetPanoramaCalibrationIntrlParam_ProvidedSomeipServiceInstance8_PortMapping: port-prototype=soc_a_communication_libExecutable18Prototype.IflytekSensorGetPanoramaCameraIntriParam, process=soc_a_communication_libProcessDesign19, service-instance=IflytekSensorGetPanoramaCameraIntriParam_ProvidedSomeipServiceInstance8
    IflytekSensorWriteCalibrationFile_ProvidedSomeipServiceInstance9_PortMapping: port-prototype=soc_a_communication_libExecutable18Prototype.IflytekSensorWriteFile, process=soc_a_communication_libProcessDesign19, service-instance=IflytekSensorWriteFile_ProvidedSomeipServiceInstance9
    IflytekAlarmInfoSoc_DdsProvidedServiceInstance93_PortMapping: port-prototype=soc_a_communication_libExecutable18Prototype.IflytekAlarmInfoSoc, process=soc_a_communication_libProcessDesign19, service-instance=IflytekAlarmInfoSoc_DdsProvidedServiceInstance93
    RPortPrototype1_DdsRequiredServiceInstance166_PortMapping: port-prototype=soc_b_communication_libExecutable19Prototype.IflytekAlarmInfoSoc, process=soc_b_communication_libProcessDesign20, service-instance=IflytekAlarmInfoSoc_DdsRequiredServiceInstance166
    IflytekSensorCameraSurroundFrontFullResolutionH265_DdsProvidedServiceInstance93_PortMapping: port-prototype=camera_node_around_view_libExecutable15Prototype.IflytekSensorCameraSurroundFrontFullResolutionH265, process=camera_node_around_view_libProcessDesign16, service-instance=IflytekSensorCameraSurroundFrontFullResolutionH265_DdsProvidedCameraNodeAroundView
    IflytekSensorCameraSurroundLeftFullResolutionH265_DdsProvidedServiceInstance94_PortMapping: port-prototype=camera_node_around_view_libExecutable15Prototype.IflytekSensorCameraSurroundLeftFullResolutionH265, process=camera_node_around_view_libProcessDesign16, service-instance=IflytekSensorCameraSurroundLeftFullResolutionH265_DdsProvidedCameraNodeAroundView
    IflytekSensorCameraSurroundRearFullResolutionH265_DdsProvidedServiceInstance95_PortMapping: port-prototype=camera_node_around_view_libExecutable15Prototype.IflytekSensorCameraSurroundRearFullResolutionH265, process=camera_node_around_view_libProcessDesign16, service-instance=IflytekSensorCameraSurroundRearFullResolutionH265_DdsProvidedCameraNodeAroundView
    IflytekSensorCameraSurroundRightFullResolutionH265_DdsProvidedServiceInstance96_PortMapping: port-prototype=camera_node_around_view_libExecutable15Prototype.IflytekSensorCameraSurroundRightFullResolutionH265, process=camera_node_around_view_libProcessDesign16, service-instance=IflytekSensorCameraSurroundRightFullResolutionH265_DdsProvidedCameraNodeAroundView
    IflytekSensorCameraFront30FullResolutionH265_DdsProvidedServiceInstance97_PortMapping: port-prototype=camera_node_panorama_view_libExecutable16Prototype.IflytekSensorCameraFront30FullResolutionH265, process=camera_node_panorama_view_libProcessDesign17, service-instance=IflytekSensorCameraFront30FullResolutionH265_DdsProvidedServiceInstance97
    RPortPrototype1_DdsRequiredServiceInstance163_PortMapping: port-prototype=soc_b_communication_libExecutable19Prototype.IflytekSensorCameraFront30FullResolutionH265, process=soc_b_communication_libProcessDesign20, service-instance=IflytekSensorCameraFront30FullResolutionH265_DdsRequiredServiceInstance163
    IflytekSensorCameraSideFlFullResolutionH265_DdsProvidedServiceInstance98_PortMapping: port-prototype=camera_node_panorama_view_libExecutable16Prototype.IflytekSensorCameraSideFlFullResolutionH265, process=camera_node_panorama_view_libProcessDesign17, service-instance=IflytekSensorCameraSideFlFullResolutionH265_DdsProvidedServiceInstance98
    RPortPrototype1_DdsRequiredServiceInstance164_PortMapping: port-prototype=soc_b_communication_libExecutable19Prototype.IflytekSensorCameraSideFlFullResolutionH265, process=soc_b_communication_libProcessDesign20, service-instance=IflytekSensorCameraSideFlFullResolutionH265_DdsRequiredServiceInstance164
    IflytekSensorCameraSideFrFullResolutionH265_DdsProvidedServiceInstance99_PortMapping: port-prototype=camera_node_panorama_view_libExecutable16Prototype.IflytekSensorCameraSideFrFullResolutionH265, process=camera_node_panorama_view_libProcessDesign17, service-instance=IflytekSensorCameraSideFrFullResolutionH265_DdsProvidedServiceInstance99
    RPortPrototype1_DdsRequiredServiceInstance165_PortMapping: port-prototype=soc_b_communication_libExecutable19Prototype.IflytekSensorCameraSideFrFullResolutionH265, process=soc_b_communication_libProcessDesign20, service-instance=IflytekSensorCameraSideFrFullResolutionH265_DdsRequiredServiceInstance165
    IflytekSensorCameraSideRlFullResolutionH265_DdsProvidedServiceInstance100_PortMapping: port-prototype=camera_node_panorama_view_libExecutable16Prototype.IflytekSensorCameraSideRlFullResolutionH265, process=camera_node_panorama_view_libProcessDesign17, service-instance=IflytekSensorCameraSideRlFullResolutionH265_DdsProvidedServiceInstance100
    RPortPrototype1_DdsRequiredServiceInstance166_PortMapping: port-prototype=soc_b_communication_libExecutable19Prototype.IflytekSensorCameraSideRlFullResolutionH265, process=soc_b_communication_libProcessDesign20, service-instance=IflytekSensorCameraSideRlFullResolutionH265_DdsRequiredServiceInstance166
    IflytekSensorCameraSideRrFullResolutionH265_DdsProvidedServiceInstance101_PortMapping: port-prototype=camera_node_panorama_view_libExecutable16Prototype.IflytekSensorCameraSideRrFullResolutionH265, process=camera_node_panorama_view_libProcessDesign17, service-instance=IflytekSensorCameraSideRrFullResolutionH265_DdsProvidedServiceInstance101
    RPortPrototype1_DdsRequiredServiceInstance167_PortMapping: port-prototype=soc_b_communication_libExecutable19Prototype.IflytekSensorCameraSideRrFullResolutionH265, process=soc_b_communication_libProcessDesign20, service-instance=IflytekSensorCameraSideRrFullResolutionH265_DdsRequiredServiceInstance167
    IflytekSensorCameraFront30FullResolutionH265_DdsProvidedServiceInstance104_PortMapping: port-prototype=soc_a_communication_libExecutable18Prototype.IflytekSensorCameraFront30FullResolutionH265, process=soc_a_communication_libProcessDesign19, service-instance=IflytekSensorCameraFront30FullResolutionH265_DdsProvidedServiceInstance104
    IflytekSensorCameraSideFlFullResolutionH265_DdsProvidedServiceInstance105_PortMapping: port-prototype=soc_a_communication_libExecutable18Prototype.IflytekSensorCameraSideFlFullResolutionH265, process=soc_a_communication_libProcessDesign19, service-instance=IflytekSensorCameraSideFlFullResolutionH265_DdsProvidedServiceInstance105
    IflytekSensorCameraSideFrFullResolutionH265_DdsProvidedServiceInstance106_PortMapping: port-prototype=soc_a_communication_libExecutable18Prototype.IflytekSensorCameraSideFrFullResolutionH265, process=soc_a_communication_libProcessDesign19, service-instance=IflytekSensorCameraSideFrFullResolutionH265_DdsProvidedServiceInstance106
    IflytekSensorCameraSideRlFullResolutionH265_DdsProvidedServiceInstance107_PortMapping: port-prototype=soc_a_communication_libExecutable18Prototype.IflytekSensorCameraSideRlFullResolutionH265, process=soc_a_communication_libProcessDesign19, service-instance=IflytekSensorCameraSideRlFullResolutionH265_DdsProvidedServiceInstance107
    IflytekSensorCameraSideRrFullResolutionH265_DdsProvidedServiceInstance108_PortMapping: port-prototype=soc_a_communication_libExecutable18Prototype.IflytekSensorCameraSideRrFullResolutionH265, process=soc_a_communication_libProcessDesign19, service-instance=IflytekSensorCameraSideRrFullResolutionH265_DdsProvidedServiceInstance108
    RPortPrototype1_DdsRequiredServiceInstance174_PortMapping: port-prototype=panorama_view_camera_perception_libExecutable10Prototype.IflytekRadarFmPerception4dPointCloud, process=panorama_view_camera_perception_libProcessDesign11, service-instance=IflytekRadarFmPerception4dPointCloud_DdsRequiredServiceInstance174
    RPortPrototype1_DdsRequiredServiceInstance175_PortMapping: port-prototype=panorama_view_camera_perception_libExecutable10Prototype.IflytekRadarFmPerception4dTarget, process=panorama_view_camera_perception_libProcessDesign11, service-instance=IflytekRadarFmPerception4dTarget_DdsRequiredServiceInstance175
    RPortPrototype1_DdsRequiredServiceInstance177_PortMapping: port-prototype=panorama_view_camera_perception_libExecutable10Prototype.IflytekLocalizationEgomotion, process=panorama_view_camera_perception_libProcessDesign11, service-instance=IflytekLocalizationEgomotion_DdsRequiredServiceInstance177
    RPortPrototype1_DdsRequiredServiceInstance172_PortMapping: port-prototype=soc_a_communication_libExecutable18Prototype.IflytekCameraPerceptionObjects, process=soc_a_communication_libProcessDesign19, service-instance=IflytekCameraPerceptionObjects_DdsRequiredServiceInstance172
    IflytekSensorCameraRearFullResolutionH265MDCA_DdsProvidedServiceInstance111_PortMapping: port-prototype=camera_node_around_view_libExecutable15Prototype.IflytekSensorCameraRearFullResolutionH265MDCA, process=camera_node_around_view_libProcessDesign16, service-instance=IflytekSensorCameraRearFullResolutionH265MDCA_DdsProvidedCameraNodeAroundView
    IflytekSensorCameraRearMDCA_DdsProvidedServiceInstance112_PortMapping: port-prototype=camera_node_around_view_libExecutable15Prototype.IflytekSensorCameraRearMDCA, process=camera_node_around_view_libProcessDesign16, service-instance=IflytekSensorCameraRearMDCA_DdsProvidedCameraNodeAroundView
    RPortPrototype1_DdsRequiredServiceInstance177_PortMapping: port-prototype=soc_a_communication_libExecutable18Prototype.IflytekSensorCameraRearMDCA, process=soc_a_communication_libProcessDesign19, service-instance=IflytekSensorCameraRearMDCA_DdsRequiredServiceInstance177
    IflytekSensorCameraRearMDCA_DdsProvidedServiceInstance113_PortMapping: port-prototype=soc_b_communication_libExecutable19Prototype.IflytekSensorCameraRearMDCA, process=soc_b_communication_libProcessDesign20, service-instance=IflytekSensorCameraRearMDCA_DdsProvidedServiceInstance113
    RPortPrototype1_DdsRequiredServiceInstance184_PortMapping: port-prototype=soc_b_communication_libExecutable19Prototype.IflytekCameraPerceptionTrafficSignRecognition, process=soc_b_communication_libProcessDesign20, service-instance=IflytekCameraPerceptionTrafficSignRecognition_DdsRequiredServiceInstance184
    RPortPrototype1_DdsRequiredServiceInstance188_PortMapping: port-prototype=soc_b_communication_libExecutable19Prototype.IflytekRadarFmPerception4dTarget, process=soc_b_communication_libProcessDesign20, service-instance=IflytekRadarFmPerception4dTarget_DdsRequiredServiceInstance188
    RPortPrototype1_DdsRequiredServiceInstance197_PortMapping: port-prototype=camera_node_panorama_view_libExecutable16Prototype.IflytekSensorCameraRearMDCA, process=camera_node_panorama_view_libProcessDesign17, service-instance=IflytekSensorCameraRearMDCA_DdsRequiredServiceInstance197
    RPortPrototype1_RequiredSomeipServiceInstance22_PortMapping: port-prototype=camera_node_panorama_view_libExecutable16Prototype.IflytekConfigManager, process=camera_node_panorama_view_libProcessDesign17, service-instance=IflytekConfigManager_RequiredSomeipServiceInstance22
    IflytekAlarmInfoMdcB_ProvidedSomeipServiceInstance13_PortMapping: port-prototype=camera_node_panorama_view_libExecutable16Prototype.IflytekAlarmInfoMdcB, process=camera_node_panorama_view_libProcessDesign17, service-instance=IflytekAlarmInfoMdcB_ProvidedSomeipServiceInstance13
    IflytekEhrSdpromapInfo_DdsProvidedServiceInstance144_PortMapping: port-prototype=ehr_libExecutable8Prototype.IflytekEhrSdpromapInfo, process=ehr_libProcessDesign9, service-instance=IflytekEhrSdpromapInfo_DdsProvidedServiceInstance144
    RPortPrototype1_DdsRequiredServiceInstance199_PortMapping: port-prototype=localization_libExecutable7Prototype.IflytekEhrSdpromapInfo, process=localization_libProcessDesign8, service-instance=IflytekEhrSdpromapInfo_DdsRequiredServiceInstance199
    IflytekEhrSdpromapInfo_DdsProvidedServiceInstance145_PortMapping: port-prototype=soc_a_communication_libExecutable18Prototype.IflytekEhrSdpromapInfo, process=soc_a_communication_libProcessDesign19, service-instance=IflytekEhrSdpromapInfo_DdsProvidedServiceInstance145
    RPortPrototype1_DdsRequiredServiceInstance202_PortMapping: port-prototype=static_fusion_libExecutable4Prototype.IflytekEhrSdpromapInfo, process=static_fusion_libProcessDesign5, service-instance=IflytekEhrSdpromapInfo_DdsRequiredServiceInstance202
    RPortPrototype1_DdsRequiredServiceInstance203_PortMapping: port-prototype=soc_b_communication_libExecutable19Prototype.IflytekEhrSdpromapInfo, process=soc_b_communication_libProcessDesign20, service-instance=IflytekEhrSdpromapInfo_DdsRequiredServiceInstance203
    IflytekCameraPerceptionOccGrid_DdsProvidedServiceInstance146_PortMapping: port-prototype=panorama_view_camera_perception_libExecutable10Prototype.IflytekCameraPerceptionOccGrid, process=panorama_view_camera_perception_libProcessDesign11, service-instance=IflytekCameraPerceptionOccGrid_DdsProvidedServiceInstance146
    RPortPrototype1_DdsRequiredServiceInstance206_PortMapping: port-prototype=soc_b_communication_libExecutable19Prototype.IflytekCameraPerceptionOccGrid, process=soc_b_communication_libProcessDesign20, service-instance=IflytekCameraPerceptionOccGrid_DdsRequiredServiceInstance206
    RPortPrototype1_DdsRequiredServiceInstance87_PortMapping: port-prototype=calibration_libExecutable20Prototype.IflytekSensorCameraSideRr, process=calibration_libProcessDesign21, service-instance=IflytekSensorCameraSideRr_DdsRequiredServiceInstance87
    RPortPrototype1_DdsRequiredServiceInstance88_PortMapping: port-prototype=calibration_libExecutable20Prototype.IflytekSensorCameraSideRl, process=calibration_libProcessDesign21, service-instance=IflytekSensorCameraSideRl_DdsRequiredServiceInstance88
    RPortPrototype1_DdsRequiredServiceInstance90_PortMapping: port-prototype=calibration_libExecutable20Prototype.IflytekSensorCameraSideFl, process=calibration_libProcessDesign21, service-instance=IflytekSensorCameraSideFl_DdsRequiredServiceInstance90
    RPortPrototype1_DdsRequiredServiceInstance91_PortMapping: port-prototype=calibration_libExecutable20Prototype.IflytekSensorCameraFront30, process=calibration_libProcessDesign21, service-instance=IflytekSensorCameraFront30_DdsRequiredServiceInstance91
    RPortPrototype1_DdsRequiredServiceInstance92_PortMapping: port-prototype=calibration_libExecutable20Prototype.IflytekSensorCameraFront120FullResolutionH265, process=calibration_libProcessDesign21, service-instance=IflytekSensorCameraFront120FullResolutionH265_DdsRequiredServiceInstance92
    RPortPrototype1_DdsRequiredServiceInstance93_PortMapping: port-prototype=soc_a_communication_libExecutable18Prototype.IflytekSensorCameraSurroundResizeImageFront, process=soc_a_communication_libProcessDesign19, service-instance=IflytekSensorCameraSurroundResizeImageFront_DdsRequiredServiceInstance93
    RPortPrototype2_DdsRequiredServiceInstance94_PortMapping: port-prototype=soc_a_communication_libExecutable18Prototype.IflytekSensorCameraSurroundResizeImageLeft, process=soc_a_communication_libProcessDesign19, service-instance=IflytekSensorCameraSurroundResizeImageLeft_DdsRequiredServiceInstance94
    RPortPrototype3_DdsRequiredServiceInstance95_PortMapping: port-prototype=soc_a_communication_libExecutable18Prototype.IflytekSensorCameraSurroundResizeImageRear, process=soc_a_communication_libProcessDesign19, service-instance=IflytekSensorCameraSurroundResizeImageRear_DdsRequiredServiceInstance95
    RPortPrototype4_DdsRequiredServiceInstance96_PortMapping: port-prototype=soc_a_communication_libExecutable18Prototype.IflytekSensorCameraSurroundResizeImageRight, process=soc_a_communication_libProcessDesign19, service-instance=IflytekSensorCameraSurroundResizeImageRight_DdsRequiredServiceInstance96
    IflytekSensorCameraSurroundResizeImageRear_DdsProvidedServiceInstance73_PortMapping: port-prototype=soc_b_communication_libExecutable19Prototype.IflytekSensorCameraSurroundResizeImageRear, process=soc_b_communication_libProcessDesign20, service-instance=IflytekSensorCameraSurroundResizeImageRear_DdsProvidedServiceInstance73
    RPortPrototype3_DdsRequiredServiceInstance99_PortMapping: port-prototype=calibration_libExecutable20Prototype.IflytekSensorCameraSurroundResizeImageRear, process=calibration_libProcessDesign21, service-instance=IflytekSensorCameraSurroundResizeImageRear_DdsRequiredServiceInstance99
    IflytekSensorCameraSurroundResizeImageRight_DdsProvidedServiceInstance74_PortMapping: port-prototype=soc_b_communication_libExecutable19Prototype.IflytekSensorCameraSurroundResizeImageRight, process=soc_b_communication_libProcessDesign20, service-instance=IflytekSensorCameraSurroundResizeImageRight_DdsProvidedServiceInstance74
    RPortPrototype4_DdsRequiredServiceInstance100_PortMapping: port-prototype=calibration_libExecutable20Prototype.IflytekSensorCameraSurroundResizeImageRight, process=calibration_libProcessDesign21, service-instance=IflytekSensorCameraSurroundResizeImageRight_DdsRequiredServiceInstance100
    RPortPrototype1_RequiredSomeipServiceInstance16_PortMapping: port-prototype=calibration_libExecutable20Prototype.IflytekAlarmInfoCalibration, process=calibration_libProcessDesign21, service-instance=IflytekAlarmInfoCalibration_RequiredSomeipServiceInstance16
    IflytekSensorImu_DdsProvidedServiceInstance74_PortMapping: port-prototype=com_service_pnc_node_libExecutable1Prototype.IflytekSensorImu, process=com_service_pnc_node_libProcessDesign2, service-instance=IflytekSensorImu_DdsProvidedComServicePncNode
    RPortPrototype1_DdsRequiredServiceInstance101_PortMapping: port-prototype=soc_a_communication_libExecutable18Prototype.IflytekSensorImu, process=soc_a_communication_libProcessDesign19, service-instance=IflytekSensorImu_DdsRequiredServiceInstance101
    IflytekVehicleService_DdsProvidedServiceInstance75_PortMapping: port-prototype=com_service_pnc_node_libExecutable1Prototype.IflytekVehicleService, process=com_service_pnc_node_libProcessDesign2, service-instance=IflytekVehicleService_DdsProvidedComServicePncNode
    RPortPrototype2_DdsRequiredServiceInstance102_PortMapping: port-prototype=soc_a_communication_libExecutable18Prototype.IflytekVehicleService, process=soc_a_communication_libProcessDesign19, service-instance=IflytekVehicleService_DdsRequiredServiceInstance102
    IflytekHmiMcuToSocBsw_DdsProvidedServiceInstance77_PortMapping: port-prototype=com_service_pnc_node_libExecutable1Prototype.IflytekHmiMcuToSocBsw, process=com_service_pnc_node_libProcessDesign2, service-instance=IflytekHmiMcuToSocBsw_DdsProvidedComServicePncNode
    RPortPrototype1_DdsRequiredServiceInstance104_PortMapping: port-prototype=soc_a_communication_libExecutable18Prototype.IflytekHmiMcuToSocBsw, process=soc_a_communication_libProcessDesign19, service-instance=IflytekHmiMcuToSocBsw_DdsRequiredServiceInstance104
    IflytekUssUsswaveInfo_DdsProvidedServiceInstance78_PortMapping: port-prototype=com_service_pnc_node_libExecutable1Prototype.IflytekUssUsswaveInfo, process=com_service_pnc_node_libProcessDesign2, service-instance=IflytekUssUsswaveInfo_DdsProvidedComServicePncNode
    IflytekSensorMcuToFmInfo_DdsProvidedServiceInstance79_PortMapping: port-prototype=com_service_pnc_node_libExecutable1Prototype.IflytekSensorMcuToFmInfo, process=com_service_pnc_node_libProcessDesign2, service-instance=IflytekSensorMcuToFmInfo_DdsProvidedComServicePncNode
    IflytekAlarmInfoMcu_DdsProvidedServiceInstance80_PortMapping: port-prototype=com_service_pnc_node_libExecutable1Prototype.IflytekAlarmInfoMcu, process=com_service_pnc_node_libProcessDesign2, service-instance=IflytekAlarmInfoMcu_DdsProvidedComServicePncNode
    IflytekRadarFmPerceptionInfo_DdsProvidedServiceInstance81_PortMapping: port-prototype=com_service_pnc_node_libExecutable1Prototype.IflytekRadarFmPerceptionInfo, process=com_service_pnc_node_libProcessDesign2, service-instance=IflytekRadarFmPerceptionInfo_DdsProvidedComServicePncNode
    RPortPrototype1_DdsRequiredServiceInstance106_PortMapping: port-prototype=obstacle_fusion_libExecutable3Prototype.IflytekRadarFmPerceptionInfo, process=obstacle_fusion_libProcessDesign4, service-instance=IflytekRadarFmPerceptionInfo_DdsRequiredServiceInstance106
    IflytekRadarFlPerceptionInfo_DdsProvidedServiceInstance82_PortMapping: port-prototype=com_service_pnc_node_libExecutable1Prototype.IflytekRadarFlPerceptionInfo, process=com_service_pnc_node_libProcessDesign2, service-instance=IflytekRadarFlPerceptionInfo_DdsProvidedComServicePncNode
    RPortPrototype2_DdsRequiredServiceInstance107_PortMapping: port-prototype=obstacle_fusion_libExecutable3Prototype.IflytekRadarFlPerceptionInfo, process=obstacle_fusion_libProcessDesign4, service-instance=IflytekRadarFlPerceptionInfo_DdsRequiredServiceInstance107
    IflytekRadarFrPerceptionInfo_DdsProvidedServiceInstance83_PortMapping: port-prototype=com_service_pnc_node_libExecutable1Prototype.IflytekRadarFrPerceptionInfo, process=com_service_pnc_node_libProcessDesign2, service-instance=IflytekRadarFrPerceptionInfo_DdsProvidedComServicePncNode
    RPortPrototype3_DdsRequiredServiceInstance108_PortMapping: port-prototype=obstacle_fusion_libExecutable3Prototype.IflytekRadarFrPerceptionInfo, process=obstacle_fusion_libProcessDesign4, service-instance=IflytekRadarFrPerceptionInfo_DdsRequiredServiceInstance108
    IflytekRadarRlPerceptionInfo_DdsProvidedServiceInstance84_PortMapping: port-prototype=com_service_pnc_node_libExecutable1Prototype.IflytekRadarRlPerceptionInfo, process=com_service_pnc_node_libProcessDesign2, service-instance=IflytekRadarRlPerceptionInfo_DdsProvidedComServicePncNode
    RPortPrototype4_DdsRequiredServiceInstance109_PortMapping: port-prototype=obstacle_fusion_libExecutable3Prototype.IflytekRadarRlPerceptionInfo, process=obstacle_fusion_libProcessDesign4, service-instance=IflytekRadarRlPerceptionInfo_DdsRequiredServiceInstance109
    IflytekRadarRrPerceptionInfo_DdsProvidedServiceInstance85_PortMapping: port-prototype=com_service_pnc_node_libExecutable1Prototype.IflytekRadarRrPerceptionInfo, process=com_service_pnc_node_libProcessDesign2, service-instance=IflytekRadarRrPerceptionInfo_DdsProvidedComServicePncNode
    RPortPrototype5_DdsRequiredServiceInstance110_PortMapping: port-prototype=obstacle_fusion_libExecutable3Prototype.IflytekRadarRrPerceptionInfo, process=obstacle_fusion_libProcessDesign4, service-instance=IflytekRadarRrPerceptionInfo_DdsRequiredServiceInstance110
    IflytekSensorImu_DdsProvidedServiceInstance88_PortMapping: port-prototype=soc_b_communication_libExecutable19Prototype.IflytekSensorImu, process=soc_b_communication_libProcessDesign20, service-instance=IflytekSensorImu_DdsProvidedServiceInstance88
    RPortPrototype1_DdsRequiredServiceInstance113_PortMapping: port-prototype=localization_libExecutable7Prototype.IflytekSensorImu, process=localization_libProcessDesign8, service-instance=IflytekSensorImu_DdsRequiredServiceInstance113
    IflytekVehicleService_DdsProvidedServiceInstance89_PortMapping: port-prototype=soc_b_communication_libExecutable19Prototype.IflytekVehicleService, process=soc_b_communication_libProcessDesign20, service-instance=IflytekVehicleService_DdsProvidedServiceInstance89
    RPortPrototype1_DdsRequiredServiceInstance114_PortMapping: port-prototype=localization_libExecutable7Prototype.IflytekVehicleService, process=localization_libProcessDesign8, service-instance=IflytekVehicleService_DdsRequiredServiceInstance114
    RPortPrototype1_DdsRequiredServiceInstance115_PortMapping: port-prototype=panorama_view_camera_perception_libExecutable10Prototype.IflytekVehicleService, process=panorama_view_camera_perception_libProcessDesign11, service-instance=IflytekVehicleService_DdsRequiredServiceInstance115
    IflytekHmiMcuToSocBsw_DdsProvidedServiceInstance90_PortMapping: port-prototype=soc_b_communication_libExecutable19Prototype.IflytekHmiMcuToSocBsw, process=soc_b_communication_libProcessDesign20, service-instance=IflytekHmiMcuToSocBsw_DdsProvidedServiceInstance90
    RPortPrototype1_DdsRequiredServiceInstance116_PortMapping: port-prototype=calibration_libExecutable20Prototype.IflytekSensorImu, process=calibration_libProcessDesign21, service-instance=IflytekSensorImu_DdsRequiredServiceInstance116
    RPortPrototype1_DdsRequiredServiceInstance117_PortMapping: port-prototype=calibration_libExecutable20Prototype.IflytekVehicleService, process=calibration_libProcessDesign21, service-instance=IflytekVehicleService_DdsRequiredServiceInstance117
    RPortPrototype1_DdsRequiredServiceInstance118_PortMapping: port-prototype=calibration_libExecutable20Prototype.IflytekLocalizationEgomotion, process=calibration_libProcessDesign21, service-instance=IflytekLocalizationEgomotion_DdsRequiredServiceInstance118
    IflytekCameraPerceptionObjects_DdsProvidedServiceInstance91_PortMapping: port-prototype=soc_b_communication_libExecutable19Prototype.IflytekCameraPerceptionObjects, process=soc_b_communication_libProcessDesign20, service-instance=IflytekCameraPerceptionObjects_DdsProvidedServiceInstance91
    RPortPrototype1_DdsRequiredServiceInstance119_PortMapping: port-prototype=calibration_libExecutable20Prototype.IflytekCameraPerceptionObjects, process=calibration_libProcessDesign21, service-instance=IflytekCameraPerceptionObjects_DdsRequiredServiceInstance119
    IflytekFusionObjects_DdsProvidedServiceInstance92_PortMapping: port-prototype=soc_b_communication_libExecutable19Prototype.IflytekFusionObjects, process=soc_b_communication_libProcessDesign20, service-instance=IflytekFusionObjects_DdsProvidedServiceInstance92
    RPortPrototype1_DdsRequiredServiceInstance120_PortMapping: port-prototype=calibration_libExecutable20Prototype.IflytekFusionObjects, process=calibration_libProcessDesign21, service-instance=IflytekFusionObjects_DdsRequiredServiceInstance120
    IflytekCalibrationCalibInfo_DdsProvidedServiceInstance94_PortMapping: port-prototype=calibration_libExecutable20Prototype.IflytekCalibrationCalibInfo, process=calibration_libProcessDesign21, service-instance=IflytekCalibrationCalibInfo_DdsProvidedCalibration
    RPortPrototype1_DdsRequiredServiceInstance122_PortMapping: port-prototype=soc_b_communication_libExecutable19Prototype.IflytekCalibrationCalibInfo, process=soc_b_communication_libProcessDesign20, service-instance=IflytekCalibrationCalibInfo_DdsRequiredSocBCommunication
    IflytekMegaMappingStatus_DdsProvidedServiceInstance94_PortMapping: port-prototype=soc_b_communication_libExecutable19Prototype.IflytekMegaMappingStatus, process=soc_b_communication_libProcessDesign20, service-instance=IflytekMegaMappingStatus_DdsProvidedServiceInstance94
    IflytekFusionObjectsCompress_DdsProvidedServiceInstance95_PortMapping: port-prototype=obstacle_fusion_libExecutable3Prototype.IflytekFusionObjectsCompress, process=obstacle_fusion_libProcessDesign4, service-instance=IflytekFusionObjectsCompress_DdsProvidedServiceInstance95
    RPortPrototype1_DdsRequiredServiceInstance126_PortMapping: port-prototype=com_service_pnc_node_libExecutable1Prototype.IflytekFusionObjectsCompress, process=com_service_pnc_node_libProcessDesign2, service-instance=IflytekFusionObjectsCompress_DdsRequiredComServicePncNode
    RPortPrototype1_DdsRequiredServiceInstance126_PortMapping: port-prototype=com_service_pnc_node_libExecutable1Prototype.IflytekFmMcuInfo, process=com_service_pnc_node_libProcessDesign2, service-instance=IflytekFmMcuInfo_DdsRequiredComServicePncNode
    RPortPrototype1_DdsRequiredServiceInstance127_PortMapping: port-prototype=com_service_pnc_node_libExecutable1Prototype.IflytekFusionRoadFusionCompress, process=com_service_pnc_node_libProcessDesign2, service-instance=IflytekFusionRoadFusionCompress_DdsRequiredComServicePncNode
    RPortPrototype1_DdsRequiredServiceInstance128_PortMapping: port-prototype=soc_b_communication_libExecutable19Prototype.IflytekHmiSocToMcuBsw, process=soc_b_communication_libProcessDesign20, service-instance=IflytekHmiSocToMcuBsw_DdsRequiredServiceInstance128
    IflytekHmiSocToMcuBsw_DdsProvidedServiceInstance96_PortMapping: port-prototype=soc_a_communication_libExecutable18Prototype.IflytekHmiSocToMcuBsw, process=soc_a_communication_libProcessDesign19, service-instance=IflytekHmiSocToMcuBsw_DdsProvidedServiceInstance96
    RPortPrototype1_DdsRequiredServiceInstance129_PortMapping: port-prototype=com_service_pnc_node_libExecutable1Prototype.IflytekHmiSocToMcuBsw, process=com_service_pnc_node_libProcessDesign2, service-instance=IflytekHmiSocToMcuBsw_DdsRequiredComServicePncNode
    RPortPrototype1_RequiredSomeipServiceInstance17_PortMapping: port-prototype=com_service_pnc_node_libExecutable1Prototype.IflytekAlarmInfoComServicePncNode, process=com_service_pnc_node_libProcessDesign2, service-instance=IflytekAlarmInfoComServicePncNode_RequiredSomeipComServicePncNode
    RPortPrototype1_DdsRequiredServiceInstance130_PortMapping: port-prototype=com_service_pnc_node_libExecutable1Prototype.IflytekLocalizationEgomotion, process=com_service_pnc_node_libProcessDesign2, service-instance=IflytekLocalizationEgomotion_DdsRequiredComServicePncNode
    IflytekPlanningPlan_DdsProvidedServiceInstance98_PortMapping: port-prototype=planning_libExecutable13Prototype.IflytekPlanningPlan, process=planning_libProcessDesign14, service-instance=IflytekPlanningPlan_DdsProvidedServiceInstance98
    RPortPrototype1_DdsRequiredServiceInstance132_PortMapping: port-prototype=com_service_pnc_node_libExecutable1Prototype.IflytekPlanningPlan, process=com_service_pnc_node_libProcessDesign2, service-instance=IflytekPlanningPlan_DdsRequiredComServicePncNode
    IflytekControlControlCommand_DdsProvidedServiceInstance99_PortMapping: port-prototype=control_libExecutable2Prototype.IflytekControlControlCommand, process=control_libProcessDesign3, service-instance=IflytekControlControlCommand_DdsProvidedServiceInstance99
    RPortPrototype1_DdsRequiredServiceInstance133_PortMapping: port-prototype=com_service_pnc_node_libExecutable1Prototype.IflytekControlControlCommand, process=com_service_pnc_node_libProcessDesign2, service-instance=IflytekControlControlCommand_DdsRequiredComServicePncNode
    RPortPrototype1_DdsRequiredServiceInstance134_PortMapping: port-prototype=obstacle_fusion_libExecutable3Prototype.IflytekUssUsswaveInfo, process=obstacle_fusion_libProcessDesign4, service-instance=IflytekUssUsswaveInfo_DdsRequiredServiceInstance134
    IflytekRadarFmPerception4dTarget_DdsProvidedServiceInstance100_PortMapping: port-prototype=soc_a_communication_libExecutable18Prototype.IflytekRadarFmPerception4dTarget, process=soc_a_communication_libProcessDesign19, service-instance=IflytekRadarFmPerception4dTarget_DdsProvidedServiceInstance100
    RPortPrototype1_DdsRequiredServiceInstance135_PortMapping: port-prototype=obstacle_fusion_libExecutable3Prototype.IflytekRadarFmPerception4dTarget, process=obstacle_fusion_libProcessDesign4, service-instance=IflytekRadarFmPerception4dTarget_DdsRequiredServiceInstance135
    RPortPrototype1_DdsRequiredServiceInstance137_PortMapping: port-prototype=obstacle_fusion_libExecutable3Prototype.IflytekVehicleService, process=obstacle_fusion_libProcessDesign4, service-instance=IflytekVehicleService_DdsRequiredServiceInstance137
    RPortPrototype1_DdsRequiredServiceInstance138_PortMapping: port-prototype=obstacle_fusion_libExecutable3Prototype.IflytekLocalizationEgomotion, process=obstacle_fusion_libProcessDesign4, service-instance=IflytekLocalizationEgomotion_DdsRequiredServiceInstance138
    RPortPrototype1_DdsRequiredServiceInstance139_PortMapping: port-prototype=planning_libExecutable13Prototype.IflytekPredictionPredictionResult, process=planning_libProcessDesign14, service-instance=IflytekPredictionPredictionResult_DdsRequiredServiceInstance139
    IflytekFusionUssPerceptionInfo_DdsProvidedServiceInstance102_PortMapping: port-prototype=obstacle_fusion_libExecutable3Prototype.IflytekFusionUssPerceptionInfo, process=obstacle_fusion_libProcessDesign4, service-instance=IflytekFusionUssPerceptionInfo_DdsProvidedServiceInstance102
    RPortPrototype1_DdsRequiredServiceInstance140_PortMapping: port-prototype=planning_libExecutable13Prototype.IflytekFusionUssPerceptionInfo, process=planning_libProcessDesign14, service-instance=IflytekFusionUssPerceptionInfo_DdsRequiredServiceInstance140
    IflytekFusionSpatialParkingSlot_DdsProvidedServiceInstance103_PortMapping: port-prototype=obstacle_fusion_libExecutable3Prototype.IflytekFusionSpatialParkingSlot, process=obstacle_fusion_libProcessDesign4, service-instance=IflytekFusionSpatialParkingSlot_DdsProvidedServiceInstance103
    IflytekFusionOccupancyObjects_DdsProvidedServiceInstance103_PortMapping: port-prototype=obstacle_fusion_libExecutable3Prototype.IflytekFusionOccupancyObjects, process=obstacle_fusion_libProcessDesign4, service-instance=IflytekFusionOccupancyObjects_DdsProvidedServiceInstance103
    RPortPrototype1_DdsRequiredServiceInstance141_PortMapping: port-prototype=planning_libExecutable13Prototype.IflytekFusionOccupancyObjects, process=planning_libProcessDesign14, service-instance=IflytekFusionOccupancyObjects_DdsRequiredServiceInstance141
    IflytekFusionObjects_DdsProvidedServiceInstance104_PortMapping: port-prototype=obstacle_fusion_libExecutable3Prototype.IflytekFusionObjects, process=obstacle_fusion_libProcessDesign4, service-instance=IflytekFusionObjects_DdsProvidedServiceInstance104
    RPortPrototype1_DdsRequiredServiceInstance142_PortMapping: port-prototype=soc_a_communication_libExecutable18Prototype.IflytekFusionObjects, process=soc_a_communication_libProcessDesign19, service-instance=IflytekFusionObjects_DdsRequiredServiceInstance142
    RPortPrototype1_DdsRequiredServiceInstance143_PortMapping: port-prototype=planning_libExecutable13Prototype.IflytekFusionObjects, process=planning_libProcessDesign14, service-instance=IflytekFusionObjects_DdsRequiredServiceInstance143
    RPortPrototype1_DdsRequiredServiceInstance145_PortMapping: port-prototype=obstacle_fusion_libExecutable3Prototype.IflytekFusionParkingSlot, process=obstacle_fusion_libProcessDesign4, service-instance=IflytekFusionParkingSlot_DdsRequiredServiceInstance145
    RPortPrototype1_DdsRequiredServiceInstance146_PortMapping: port-prototype=planning_libExecutable13Prototype.IflytekFusionParkingSlot, process=planning_libProcessDesign14, service-instance=IflytekFusionParkingSlot_DdsRequiredServiceInstance146
    RPortPrototype1_DdsRequiredServiceInstance148_PortMapping: port-prototype=obstacle_fusion_libExecutable3Prototype.IflytekCameraPerceptionOccupancyObjects, process=obstacle_fusion_libProcessDesign4, service-instance=IflytekCameraPerceptionOccupancyObjects_DdsRequiredServiceInstance148
    RPortPrototype1_DdsRequiredServiceInstance149_PortMapping: port-prototype=obstacle_fusion_libExecutable3Prototype.IflytekCameraPerception3dGeneralObjects, process=obstacle_fusion_libProcessDesign4, service-instance=IflytekCameraPerception3dGeneralObjects_DdsRequiredServiceInstance149
    RPortPrototype1_DdsRequiredServiceInstance150_PortMapping: port-prototype=obstacle_fusion_libExecutable3Prototype.IflytekCameraPerceptionObjects, process=obstacle_fusion_libProcessDesign4, service-instance=IflytekCameraPerceptionObjects_DdsRequiredServiceInstance150
    RPortPrototype1_RequiredSomeipServiceInstance18_PortMapping: port-prototype=obstacle_fusion_libExecutable3Prototype.IflytekAlarmInfoObstacleFusion, process=obstacle_fusion_libProcessDesign4, service-instance=IflytekAlarmInfoObstacleFusion_RequiredSomeipServiceInstance18
    RPortPrototype1_DdsRequiredServiceInstance151_PortMapping: port-prototype=planning_libExecutable13Prototype.IflytekEhrStaticMap, process=planning_libProcessDesign14, service-instance=IflytekEhrStaticMap_DdsRequiredServiceInstance151
    RPortPrototype1_DdsRequiredServiceInstance152_PortMapping: port-prototype=planning_libExecutable13Prototype.IflytekEhrSdmapInfo, process=planning_libProcessDesign14, service-instance=IflytekEhrSdmapInfo_DdsRequiredServiceInstance152
    RPortPrototype1_DdsRequiredServiceInstance153_PortMapping: port-prototype=planning_libExecutable13Prototype.IflytekEhrSdpromapInfo, process=planning_libProcessDesign14, service-instance=IflytekEhrSdpromapInfo_DdsRequiredServiceInstance153
    RPortPrototype1_DdsRequiredServiceInstance154_PortMapping: port-prototype=planning_libExecutable13Prototype.IflytekLocalizationEgomotion, process=planning_libProcessDesign14, service-instance=IflytekLocalizationEgomotion_DdsRequiredServiceInstance154
    RPortPrototype1_DdsRequiredServiceInstance155_PortMapping: port-prototype=planning_libExecutable13Prototype.IflytekUssUsswaveInfo, process=planning_libProcessDesign14, service-instance=IflytekUssUsswaveInfo_DdsRequiredServiceInstance155
    RPortPrototype1_DdsRequiredServiceInstance156_PortMapping: port-prototype=planning_libExecutable13Prototype.IflytekVehicleService, process=planning_libProcessDesign14, service-instance=IflytekVehicleService_DdsRequiredServiceInstance156
    IflytekFusionGroundLine_DdsProvidedServiceInstance103_PortMapping: port-prototype=static_fusion_libExecutable4Prototype.IflytekFusionGroundLine, process=static_fusion_libProcessDesign5, service-instance=IflytekFusionGroundLine_DdsProvidedServiceInstance103
    RPortPrototype1_DdsRequiredServiceInstance157_PortMapping: port-prototype=planning_libExecutable13Prototype.IflytekFusionGroundLine, process=planning_libProcessDesign14, service-instance=IflytekFusionGroundLine_DdsRequiredServiceInstance157
    IflytekFusionSpeedBump_DdsProvidedServiceInstance103_PortMapping: port-prototype=static_fusion_libExecutable4Prototype.IflytekFusionSpeedBump, process=static_fusion_libProcessDesign5, service-instance=IflytekFusionSpeedBump_DdsProvidedServiceInstance103
    RPortPrototype1_DdsRequiredServiceInstance157_PortMapping: port-prototype=planning_libExecutable13Prototype.IflytekFusionSpeedBump, process=planning_libProcessDesign14, service-instance=IflytekFusionSpeedBump_DdsRequiredServiceInstance157
    IflytekCameraPerceptionScene_DdsProvidedServiceInstance104_PortMapping: port-prototype=panorama_view_camera_perception_libExecutable10Prototype.IflytekCameraPerceptionScene, process=panorama_view_camera_perception_libProcessDesign11, service-instance=IflytekCameraPerceptionScene_DdsProvidedServiceInstance104
    RPortPrototype1_DdsRequiredServiceInstance158_PortMapping: port-prototype=soc_b_communication_libExecutable19Prototype.IflytekCameraPerceptionScene, process=soc_b_communication_libProcessDesign20, service-instance=IflytekCameraPerceptionScene_DdsRequiredServiceInstance158
    IflytekCameraPerceptionScene_DdsProvidedServiceInstance105_PortMapping: port-prototype=soc_a_communication_libExecutable18Prototype.IflytekCameraPerceptionScene, process=soc_a_communication_libProcessDesign19, service-instance=IflytekCameraPerceptionScene_DdsProvidedServiceInstance105
    RPortPrototype1_DdsRequiredServiceInstance157_PortMapping: port-prototype=planning_libExecutable13Prototype.IflytekCameraPerceptionScene, process=planning_libProcessDesign14, service-instance=IflytekCameraPerceptionScene_DdsRequiredServiceInstance157
    IflytekCameraPerceptionOccGrid_DdsProvidedServiceInstance107_PortMapping: port-prototype=soc_a_communication_libExecutable18Prototype.IflytekCameraPerceptionOccGrid, process=soc_a_communication_libProcessDesign19, service-instance=IflytekCameraPerceptionOccGrid_DdsProvidedServiceInstance107
    RPortPrototype1_DdsRequiredServiceInstance159_PortMapping: port-prototype=planning_libExecutable13Prototype.IflytekCameraPerceptionOccGrid, process=planning_libProcessDesign14, service-instance=IflytekCameraPerceptionOccGrid_DdsRequiredServiceInstance159
    RPortPrototype1_DdsRequiredServiceInstance161_PortMapping: port-prototype=planning_libExecutable13Prototype.IflytekControlControlCommand, process=planning_libProcessDesign14, service-instance=IflytekControlControlCommand_DdsRequiredServiceInstance161
    RPortPrototype1_DdsRequiredServiceInstance162_PortMapping: port-prototype=control_libExecutable2Prototype.IflytekPlanningPlan, process=control_libProcessDesign3, service-instance=IflytekPlanningPlan_DdsRequiredServiceInstance162
    IflytekPlanningHmi_DdsProvidedServiceInstance109_PortMapping: port-prototype=planning_libExecutable13Prototype.IflytekPlanningHmi, process=planning_libProcessDesign14, service-instance=IflytekPlanningHmi_DdsProvidedServiceInstance109
    RPortPrototype1_DdsRequiredServiceInstance164_PortMapping: port-prototype=control_libExecutable2Prototype, process=control_libProcessDesign3, service-instance=IflytekPlanningHmi_DdsRequiredServiceInstance164
    RPortPrototype1_RequiredSomeipServiceInstance19_PortMapping: port-prototype=planning_libExecutable13Prototype.IflytekAlarmInfoPlanning, process=planning_libProcessDesign14, service-instance=IflytekAlarmInfoPlanning_RequiredSomeipServiceInstance19
    RPortPrototype1_RequiredSomeipServiceInstance20_PortMapping: port-prototype=control_libExecutable2Prototype.IflytekAlarmInfoControl, process=control_libProcessDesign3, service-instance=IflytekAlarmInfoControl_RequiredSomeipServiceInstance20
    RPortPrototype1_DdsRequiredServiceInstance166_PortMapping: port-prototype=control_libExecutable2Prototype.IflytekLocalizationEgomotion, process=control_libProcessDesign3, service-instance=IflytekLocalizationEgomotion_DdsRequiredServiceInstance166
    RPortPrototype1_DdsRequiredServiceInstance167_PortMapping: port-prototype=control_libExecutable2Prototype.IflytekVehicleService, process=control_libProcessDesign3, service-instance=IflytekVehicleService_DdsRequiredServiceInstance167
    RPortPrototype1_DdsRequiredServiceInstance178_PortMapping: port-prototype=static_fusion_libExecutable4Prototype.IflytekVehicleService, process=static_fusion_libProcessDesign5, service-instance=IflytekVehicleService_DdsRequiredServiceInstance178
    RPortPrototype1_DdsRequiredServiceInstance183_PortMapping: port-prototype=panorama_view_camera_perception_libExecutable10Prototype, process=panorama_view_camera_perception_libProcessDesign11
    RPortPrototype1_DdsRequiredServiceInstance183_PortMapping: port-prototype=static_fusion_libExecutable4Prototype, process=static_fusion_libProcessDesign5
    IflytekSensorCameraSurroundResizeImageLeft_DdsProvidedServiceInstance110_PortMapping: port-prototype=soc_b_communication_libExecutable19Prototype.IflytekSensorCameraSurroundResizeImageLeft, process=soc_b_communication_libProcessDesign20, service-instance=IflytekSensorCameraSurroundResizeImageLeft_DdsProvidedServiceInstance110
    RPortPrototype1_DdsRequiredServiceInstance176_PortMapping: port-prototype=calibration_libExecutable20Prototype.IflytekSensorCameraSurroundResizeImageLeft, process=calibration_libProcessDesign21, service-instance=IflytekSensorCameraSurroundResizeImageLeft_DdsRequiredServiceInstance176
    IflytekSensorCameraSurroundResizeImageFront_DdsProvidedServiceInstance110_PortMapping: port-prototype=soc_b_communication_libExecutable19Prototype.IflytekSensorCameraSurroundResizeImageFront, process=soc_b_communication_libProcessDesign20, service-instance=IflytekSensorCameraSurroundResizeImageFront_DdsProvidedServiceInstance110
    RPortPrototype1_DdsRequiredServiceInstance176_PortMapping: port-prototype=calibration_libExecutable20Prototype.IflytekSensorCameraSurroundResizeImageFront, process=calibration_libProcessDesign21, service-instance=IflytekSensorCameraSurroundResizeImageFront_DdsRequiredServiceInstance176
    RPortPrototype1_RequiredSomeipServiceInstance22_PortMapping: port-prototype=camera_node_around_view_libExecutable15Prototype.IflytekConfigManager, process=camera_node_around_view_libProcessDesign16, service-instance=IflytekConfigManager_RequiredSomeipCameraNodeAroundView
    IflytekAlarmInfoMdcA_ProvidedSomeipServiceInstance13_PortMapping: port-prototype=camera_node_around_view_libExecutable15Prototype.IflytekAlarmInfoMdcA, process=camera_node_around_view_libProcessDesign16, service-instance=IflytekAlarmInfoMdcA_ProvidedSomeipCameraNodeAroundView
    RPortPrototype1_DdsRequiredServiceInstance176_PortMapping: port-prototype=panorama_view_camera_perception_libExecutable10Prototype, process=panorama_view_camera_perception_libProcessDesign11
    RPortPrototype1_DdsRequiredServiceInstance175_PortMapping: port-prototype=panorama_view_camera_perception_libExecutable10Prototype.IflytekSensorCameraRear, process=panorama_view_camera_perception_libProcessDesign11, service-instance=IflytekSensorCameraRear_DdsRequiredPanoramaViewCameraPerception
    RPortPrototype1_DdsRequiredServiceInstance174_PortMapping: port-prototype=static_fusion_libExecutable4Prototype.IflytekPlanningHmi, process=static_fusion_libProcessDesign5, service-instance=IflytekPlanningHmi_DdsRequiredStaticFusion
    RPortPrototype1_DdsRequiredServiceInstance172_PortMapping: port-prototype=control_libExecutable2Prototype.IflytekPlanningHmi, process=control_libProcessDesign3, service-instance=IflytekPlanningHmi_DdsRequiredControl
    RPortPrototype1_RequiredSomeipServiceInstance21_PortMapping: port-prototype=finite_state_manager_libExecutable5Prototype.IflytekAlarmInfoFiniteStateManager, process=finite_state_manager_libProcessDesign6, service-instance=IflytekAlarmInfoFiniteStateManager_RequiredSomeipServiceInstance21
    RPortPrototype1_DdsRequiredServiceInstance143_PortMapping: port-prototype=finite_state_manager_libExecutable5Prototype.IflytekVehicleService, process=finite_state_manager_libProcessDesign6, service-instance=IflytekVehicleService_DdsRequiredServiceInstance143
    RPortPrototype1_DdsRequiredServiceInstance144_PortMapping: port-prototype=finite_state_manager_libExecutable5Prototype.IflytekSensorGnss, process=finite_state_manager_libProcessDesign6, service-instance=IflytekSensorGnss_DdsRequiredServiceInstance144
    RPortPrototype1_RequiredSomeipServiceInstance22_PortMapping: port-prototype=finite_state_manager_libExecutable5Prototype.IflytekConfigManager, process=finite_state_manager_libProcessDesign6, service-instance=IflytekConfigManager_RequiredSomeipServiceInstance22
    RPortPrototype1_DdsRequiredServiceInstance145_PortMapping: port-prototype=finite_state_manager_libExecutable5Prototype.IflytekEhrSdmapInfo, process=finite_state_manager_libProcessDesign6, service-instance=IflytekEhrSdmapInfo_DdsRequiredServiceInstance145
    RPortPrototype1_DdsRequiredServiceInstance146_PortMapping: port-prototype=finite_state_manager_libExecutable5Prototype.IflytekEhrSdpromapInfo, process=finite_state_manager_libProcessDesign6, service-instance=IflytekEhrSdpromapInfo_DdsRequiredServiceInstance146
    RPortPrototype1_DdsRequiredServiceInstance149_PortMapping: port-prototype=finite_state_manager_libExecutable5Prototype.IflytekLocalizationEgomotion, process=finite_state_manager_libProcessDesign6, service-instance=IflytekLocalizationEgomotion_DdsRequiredServiceInstance149
    RPortPrototype1_DdsRequiredServiceInstance150_PortMapping: port-prototype=finite_state_manager_libExecutable5Prototype.IflytekLocalizationSemanticInfo, process=finite_state_manager_libProcessDesign6, service-instance=IflytekLocalizationSemanticInfo_DdsRequiredServiceInstance150
    RPortPrototype1_DdsRequiredServiceInstance151_PortMapping: port-prototype=finite_state_manager_libExecutable5Prototype.IflytekMegaMappingStatus, process=finite_state_manager_libProcessDesign6, service-instance=IflytekMegaMappingStatus_DdsRequiredServiceInstance151
    RPortPrototype1_DdsRequiredServiceInstance152_PortMapping: port-prototype=soc_a_communication_libExecutable18Prototype.IflytekCameraPerceptionLaneLines, process=soc_a_communication_libProcessDesign19, service-instance=IflytekCameraPerceptionLaneLines_DdsRequiredServiceInstance152
    IflytekCameraPerceptionLaneLines_DdsProvidedServiceInstance100_PortMapping: port-prototype=soc_b_communication_libExecutable19Prototype.IflytekCameraPerceptionLaneLines, process=soc_b_communication_libProcessDesign20, service-instance=IflytekCameraPerceptionLaneLines_DdsProvidedServiceInstance100
    RPortPrototype1_DdsRequiredServiceInstance153_PortMapping: port-prototype=finite_state_manager_libExecutable5Prototype.IflytekCameraPerceptionLaneLines, process=finite_state_manager_libProcessDesign6, service-instance=IflytekCameraPerceptionLaneLines_DdsRequiredServiceInstance153
    RPortPrototype1_DdsRequiredServiceInstance154_PortMapping: port-prototype=soc_a_communication_libExecutable18Prototype.IflytekCameraPerceptionGroundLine, process=soc_a_communication_libProcessDesign19, service-instance=IflytekCameraPerceptionGroundLine_DdsRequiredServiceInstance154
    IflytekCameraPerceptionGroundLine_DdsProvidedServiceInstance101_PortMapping: port-prototype=soc_b_communication_libExecutable19Prototype.IflytekCameraPerceptionGroundLine, process=soc_b_communication_libProcessDesign20, service-instance=IflytekCameraPerceptionGroundLine_DdsProvidedServiceInstance101
    RPortPrototype1_DdsRequiredServiceInstance155_PortMapping: port-prototype=finite_state_manager_libExecutable5Prototype.IflytekCameraPerceptionGroundLine, process=finite_state_manager_libProcessDesign6, service-instance=IflytekCameraPerceptionGroundLine_DdsRequiredServiceInstance155
    RPortPrototype1_DdsRequiredServiceInstance156_PortMapping: port-prototype=soc_a_communication_libExecutable18Prototype.IflytekCameraPerceptionDeceler, process=soc_a_communication_libProcessDesign19, service-instance=IflytekCameraPerceptionDeceler_DdsRequiredServiceInstance156
    IflytekCameraPerceptionDeceler_DdsProvidedServiceInstance102_PortMapping: port-prototype=soc_b_communication_libExecutable19Prototype.IflytekCameraPerceptionDeceler, process=soc_b_communication_libProcessDesign20, service-instance=IflytekCameraPerceptionDeceler_DdsProvidedServiceInstance102
    RPortPrototype1_DdsRequiredServiceInstance157_PortMapping: port-prototype=finite_state_manager_libExecutable5Prototype.IflytekCameraPerceptionDeceler, process=finite_state_manager_libProcessDesign6, service-instance=IflytekCameraPerceptionDeceler_DdsRequiredServiceInstance157
    RPortPrototype1_DdsRequiredServiceInstance162_PortMapping: port-prototype=soc_a_communication_libExecutable18Prototype.IflytekFusionParkingSlot, process=soc_a_communication_libProcessDesign19, service-instance=IflytekFusionParkingSlot_DdsRequiredServiceInstance162
    IflytekFusionParkingSlot_DdsProvidedServiceInstance104_PortMapping: port-prototype=soc_b_communication_libExecutable19Prototype.IflytekFusionParkingSlot, process=soc_b_communication_libProcessDesign20, service-instance=IflytekFusionParkingSlot_DdsProvidedServiceInstance104
    RPortPrototype1_DdsRequiredServiceInstance163_PortMapping: port-prototype=finite_state_manager_libExecutable5Prototype.IflytekFusionParkingSlot, process=finite_state_manager_libProcessDesign6, service-instance=IflytekFusionParkingSlot_DdsRequiredServiceInstance163
    RPortPrototype1_DdsRequiredServiceInstance164_PortMapping: port-prototype=soc_a_communication_libExecutable18Prototype.IflytekFusionSpatialParkingSlot, process=soc_a_communication_libProcessDesign19, service-instance=IflytekFusionSpatialParkingSlot_DdsRequiredServiceInstance164
    IflytekFusionSpatialParkingSlot_DdsProvidedServiceInstance105_PortMapping: port-prototype=soc_b_communication_libExecutable19Prototype.IflytekFusionSpatialParkingSlot, process=soc_b_communication_libProcessDesign20, service-instance=IflytekFusionSpatialParkingSlot_DdsProvidedServiceInstance105
    RPortPrototype1_DdsRequiredServiceInstance165_PortMapping: port-prototype=finite_state_manager_libExecutable5Prototype.IflytekFusionSpatialParkingSlot, process=finite_state_manager_libProcessDesign6, service-instance=IflytekFusionSpatialParkingSlot_DdsRequiredServiceInstance165
    RPortPrototype1_DdsRequiredServiceInstance166_PortMapping: port-prototype=finite_state_manager_libExecutable5Prototype.IflytekFusionObjects, process=finite_state_manager_libProcessDesign6, service-instance=IflytekFusionObjects_DdsRequiredServiceInstance166
    RPortPrototype1_DdsRequiredServiceInstance167_PortMapping: port-prototype=finite_state_manager_libExecutable5Prototype.IflytekCalibrationCalibInfo, process=finite_state_manager_libProcessDesign6, service-instance=IflytekCalibrationCalibInfo_DdsRequiredServiceInstance167
    RPortPrototype1_DdsRequiredServiceInstance168_PortMapping: port-prototype=soc_a_communication_libExecutable18Prototype.IflytekPlanningHmi, process=soc_a_communication_libProcessDesign19, service-instance=IflytekPlanningHmi_DdsRequiredServiceInstance168
    RPortPrototype1_DdsRequiredServiceInstance169_PortMapping: port-prototype=soc_a_communication_libExecutable18Prototype.IflytekPlanningPlan, process=soc_a_communication_libProcessDesign19, service-instance=IflytekPlanningPlan_DdsRequiredServiceInstance169
    IflytekPlanningHmi_DdsProvidedServiceInstance106_PortMapping: port-prototype=soc_b_communication_libExecutable19Prototype.IflytekPlanningHmi, process=soc_b_communication_libProcessDesign20, service-instance=IflytekPlanningHmi_DdsProvidedServiceInstance106
    RPortPrototype1_DdsRequiredServiceInstance170_PortMapping: port-prototype=finite_state_manager_libExecutable5Prototype.IflytekPlanningHmi, process=finite_state_manager_libProcessDesign6, service-instance=IflytekPlanningHmi_DdsRequiredServiceInstance170
    IflytekPlanningPlan_DdsProvidedServiceInstance107_PortMapping: port-prototype=soc_b_communication_libExecutable19Prototype.IflytekPlanningPlan, process=soc_b_communication_libProcessDesign20, service-instance=IflytekPlanningPlan_DdsProvidedServiceInstance107
    RPortPrototype2_DdsRequiredServiceInstance171_PortMapping: port-prototype=finite_state_manager_libExecutable5Prototype.IflytekPlanningPlan, process=finite_state_manager_libProcessDesign6, service-instance=IflytekPlanningPlan_DdsRequiredServiceInstance171
    RPortPrototype1_DdsRequiredServiceInstance172_PortMapping: port-prototype=finite_state_manager_libExecutable5Prototype.IflytekHmiInner, process=finite_state_manager_libProcessDesign6, service-instance=IflytekHmiInner_DdsRequiredServiceInstance172
    IflytekFsmSocState_DdsProvidedServiceInstance108_PortMapping: port-prototype=finite_state_manager_libExecutable5Prototype.IflytekFsmSocState, process=finite_state_manager_libProcessDesign6, service-instance=IflytekFsmSocState_DdsProvidedServiceInstance108
    RPortPrototype1_DdsRequiredServiceInstance173_PortMapping: port-prototype=soc_b_communication_libExecutable19Prototype.IflytekFsmSocState, process=soc_b_communication_libProcessDesign20, service-instance=IflytekFsmSocState_DdsRequiredServiceInstance173
    RPortPrototype1_DdsRequiredServiceInstance174_PortMapping: port-prototype=ehr_libExecutable8Prototype.IflytekFsmSocState, process=ehr_libProcessDesign9, service-instance=IflytekFsmSocState_DdsRequiredServiceInstance174
    RPortPrototype1_DdsRequiredServiceInstance175_PortMapping: port-prototype=localization_libExecutable7Prototype.IflytekFsmSocState, process=localization_libProcessDesign8, service-instance=IflytekFsmSocState_DdsRequiredServiceInstance175
    RPortPrototype1_DdsRequiredServiceInstance176_PortMapping: port-prototype=panorama_view_camera_perception_libExecutable10Prototype.IflytekFsmSocState, process=panorama_view_camera_perception_libProcessDesign11, service-instance=IflytekFsmSocState_DdsRequiredServiceInstance176
    RPortPrototype1_DdsRequiredServiceInstance177_PortMapping: port-prototype=calibration_libExecutable20Prototype.IflytekFsmSocState, process=calibration_libProcessDesign21, service-instance=IflytekFsmSocState_DdsRequiredServiceInstance177
    IflytekFsmHmiSocOuter_DdsProvidedServiceInstance109_PortMapping: port-prototype=finite_state_manager_libExecutable5Prototype.IflytekFsmHmiSocOuter, process=finite_state_manager_libProcessDesign6, service-instance=IflytekFsmHmiSocOuter_DdsProvidedServiceInstance109
    IflytekFsmSocState_DdsProvidedServiceInstance110_PortMapping: port-prototype=soc_a_communication_libExecutable18Prototype.IflytekFsmSocState, process=soc_a_communication_libProcessDesign19, service-instance=IflytekFsmSocState_DdsProvidedSocACommunication
    RPortPrototype1_DdsRequiredServiceInstance178_PortMapping: port-prototype=planning_libExecutable13Prototype.IflytekFsmSocState, process=planning_libProcessDesign14, service-instance=IflytekFsmSocState_DdsRequiredServiceInstance178
    RPortPrototype1_DdsRequiredServiceInstance179_PortMapping: port-prototype=obstacle_fusion_libExecutable3Prototype.IflytekFsmSocState, process=obstacle_fusion_libProcessDesign4, service-instance=IflytekFsmSocState_DdsRequiredServiceInstance179
    RPortPrototype1_DdsRequiredServiceInstance180_PortMapping: port-prototype=static_fusion_libExecutable4Prototype.IflytekFsmSocState, process=static_fusion_libProcessDesign5, service-instance=IflytekFsmSocState_DdsRequiredServiceInstance180
    RPortPrototype1_DdsRequiredServiceInstance181_PortMapping: port-prototype=control_libExecutable2Prototype.IflytekFsmSocState, process=control_libProcessDesign3, service-instance=IflytekFsmSocState_DdsRequiredServiceInstance181
    RPortPrototype1_DdsRequiredServiceInstance182_PortMapping: port-prototype=com_service_pnc_node_libExecutable1Prototype.IflytekFsmSocState, process=com_service_pnc_node_libProcessDesign2, service-instance=IflytekFsmSocState_DdsRequiredComServicePncNode
    RPortPrototype1_DdsRequiredServiceInstance183_PortMapping: port-prototype=soc_a_communication_libExecutable18Prototype.IflytekSensorCameraSurroundFrontFullResolutionH265, process=soc_a_communication_libProcessDesign19, service-instance=IflytekSensorCameraSurroundFrontFullResolutionH265_DdsRequiredServiceInstance183
    RPortPrototype1_DdsRequiredServiceInstance184_PortMapping: port-prototype=soc_a_communication_libExecutable18Prototype.IflytekSensorCameraSurroundLeftFullResolutionH265, process=soc_a_communication_libProcessDesign19, service-instance=IflytekSensorCameraSurroundLeftFullResolutionH265_DdsRequiredServiceInstance184
    RPortPrototype1_DdsRequiredServiceInstance185_PortMapping: port-prototype=soc_a_communication_libExecutable18Prototype.IflytekSensorCameraSurroundRearFullResolutionH265, process=soc_a_communication_libProcessDesign19, service-instance=IflytekSensorCameraSurroundRearFullResolutionH265_DdsRequiredServiceInstance185
    RPortPrototype1_DdsRequiredServiceInstance186_PortMapping: port-prototype=soc_a_communication_libExecutable18Prototype.IflytekSensorCameraSurroundRightFullResolutionH265, process=soc_a_communication_libProcessDesign19, service-instance=IflytekSensorCameraSurroundRightFullResolutionH265_DdsRequiredServiceInstance186
    IflytekSensorCameraSurroundFrontFullResolutionH265_DdsProvidedServiceInstance111_PortMapping: port-prototype=soc_b_communication_libExecutable19Prototype.IflytekSensorCameraSurroundFrontFullResolutionH265, process=soc_b_communication_libProcessDesign20, service-instance=IflytekSensorCameraSurroundFrontFullResolutionH265_DdsProvidedServiceInstance111
    IflytekSensorCameraSurroundLeftFullResolutionH265_DdsProvidedServiceInstance112_PortMapping: port-prototype=soc_b_communication_libExecutable19Prototype.IflytekSensorCameraSurroundLeftFullResolutionH265, process=soc_b_communication_libProcessDesign20, service-instance=IflytekSensorCameraSurroundLeftFullResolutionH265_DdsProvidedServiceInstance112
    IflytekSensorCameraSurroundRearFullResolutionH265_DdsProvidedServiceInstance113_PortMapping: port-prototype=soc_b_communication_libExecutable19Prototype.IflytekSensorCameraSurroundRearFullResolutionH265, process=soc_b_communication_libProcessDesign20, service-instance=IflytekSensorCameraSurroundRearFullResolutionH265_DdsProvidedServiceInstance113
    IflytekSensorCameraSurroundRightFullResolutionH265_DdsProvidedServiceInstance114_PortMapping: port-prototype=soc_b_communication_libExecutable19Prototype.IflytekSensorCameraSurroundRightFullResolutionH265, process=soc_b_communication_libProcessDesign20, service-instance=IflytekSensorCameraSurroundRightFullResolutionH265_DdsProvidedServiceInstance114
    IflytekSensorCameraRearFullResolutionH265_DdsProvidedServiceInstance115_PortMapping: port-prototype=camera_node_panorama_view_libExecutable16Prototype.IflytekSensorCameraRearFullResolutionH265, process=camera_node_panorama_view_libProcessDesign17, service-instance=IflytekSensorCameraRearFullResolutionH265_DdsProvidedServiceInstance115
    IflytekFusionRoadFusion_DdsProvidedServiceInstance115_PortMapping: port-prototype=soc_b_communication_libExecutable19Prototype.IflytekFusionRoadFusion, process=soc_b_communication_libProcessDesign20, service-instance=IflytekFusionRoadFusion_DdsProvidedServiceInstance115
    RPortPrototype1_DdsRequiredServiceInstance186_PortMapping: port-prototype=finite_state_manager_libExecutable5Prototype.IflytekFusionRoadFusion, process=finite_state_manager_libProcessDesign6, service-instance=IflytekFusionRoadFusion_DdsRequiredServiceInstance186
    IflytekCameraPerceptionTrafficSignRecognition_DdsProvidedServiceInstance115_PortMapping: port-prototype=soc_a_communication_libExecutable18Prototype.IflytekCameraPerceptionTrafficSignRecognition, process=soc_a_communication_libProcessDesign19, service-instance=IflytekCameraPerceptionTrafficSignRecognition_DdsProvidedServiceInstance115
    RPortPrototype1_DdsRequiredServiceInstance186_PortMapping: port-prototype=planning_libExecutable13Prototype.IflytekCameraPerceptionTrafficSignRecognition, process=planning_libProcessDesign14, service-instance=IflytekCameraPerceptionTrafficSignRecognition_DdsRequiredPlanning
    RPortPrototype1_DdsRequiredServiceInstance187_PortMapping: port-prototype=finite_state_manager_libExecutable5Prototype.IflytekCameraPerceptionTrafficSignRecognition, process=finite_state_manager_libProcessDesign6, service-instance=IflytekCameraPerceptionTrafficSignRecognition_DdsRequiredServiceInstance187
    RPortPrototype1_DdsRequiredServiceInstance188_PortMapping: port-prototype=soc_a_communication_libExecutable18Prototype.IflytekCameraPerceptionLaneTopo, process=soc_a_communication_libProcessDesign19, service-instance=IflytekCameraPerceptionLaneTopo_DdsRequiredServiceInstance188
    IflytekCameraPerceptionLaneTopo_DdsProvidedServiceInstance116_PortMapping: port-prototype=soc_b_communication_libExecutable19Prototype.IflytekCameraPerceptionLaneTopo, process=soc_b_communication_libProcessDesign20, service-instance=IflytekCameraPerceptionLaneTopo_DdsProvidedServiceInstance116
    RPortPrototype1_DdsRequiredServiceInstance189_PortMapping: port-prototype=soc_a_communication_libExecutable18Prototype.IflytekPredictionPredictionResult, process=soc_a_communication_libProcessDesign19, service-instance=IflytekPredictionPredictionResult_DdsRequiredServiceInstance189
    IflytekPredictionPredictionResult_DdsProvidedServiceInstance117_PortMapping: port-prototype=soc_b_communication_libExecutable19Prototype.IflytekPredictionPredictionResult, process=soc_b_communication_libProcessDesign20, service-instance=IflytekPredictionPredictionResult_DdsProvidedServiceInstance117
    RPortPrototype1_DdsRequiredServiceInstance190_PortMapping: port-prototype=soc_a_communication_libExecutable18Prototype.IflytekCameraPerceptionOccupancyObjects, process=soc_a_communication_libProcessDesign19, service-instance=IflytekCameraPerceptionOccupancyObjects_DdsRequiredServiceInstance190
    IflytekFusionRoadFusion_DdsProvidedServiceInstance118_PortMapping: port-prototype=static_fusion_libExecutable4Prototype.IflytekFusionRoadFusion, process=static_fusion_libProcessDesign5, service-instance=IflytekFusionRoadFusion_DdsProvidedServiceInstance118
    RPortPrototype1_DdsRequiredServiceInstance191_PortMapping: port-prototype=planning_libExecutable13Prototype.IflytekFusionRoadFusion, process=planning_libProcessDesign14, service-instance=IflytekFusionRoadFusion_DdsRequiredServiceInstance191
    IflytekCameraPerceptionOccupancyObjects_DdsProvidedServiceInstance119_PortMapping: port-prototype=soc_b_communication_libExecutable19Prototype.IflytekCameraPerceptionOccupancyObjects, process=soc_b_communication_libProcessDesign20, service-instance=IflytekCameraPerceptionOccupancyObjects_DdsProvidedSocBCommunication
    RPortPrototype1_DdsRequiredServiceInstance190_PortMapping: port-prototype=soc_a_communication_libExecutable18Prototype.IflytekFusionRoadFusion, process=soc_a_communication_libProcessDesign19, service-instance=IflytekFusionRoadFusion_DdsRequiredServiceInstance190
    RPortPrototype1_DdsRequiredServiceInstance191_PortMapping: port-prototype=soc_a_communication_libExecutable18Prototype.IflytekCameraPerception3dGeneralObjects, process=soc_a_communication_libProcessDesign19, service-instance=IflytekCameraPerception3dGeneralObjects_DdsRequiredServiceInstance191
    IflytekCameraPerception3dGeneralObjects_DdsProvidedServiceInstance119_PortMapping: port-prototype=soc_b_communication_libExecutable19Prototype.IflytekCameraPerception3dGeneralObjects, process=soc_b_communication_libProcessDesign20, service-instance=IflytekCameraPerception3dGeneralObjects_DdsProvidedServiceInstance119
    RPortPrototype1_DdsRequiredServiceInstance192_PortMapping: port-prototype=soc_a_communication_libExecutable18Prototype.IflytekCameraPerceptionParkingSlotList, process=soc_a_communication_libProcessDesign19, service-instance=IflytekCameraPerceptionParkingSlotList_DdsRequiredServiceInstance192
    IflytekCameraPerceptionParkingSlotList_DdsProvidedServiceInstance120_PortMapping: port-prototype=soc_b_communication_libExecutable19Prototype.IflytekCameraPerceptionParkingSlotList, process=soc_b_communication_libProcessDesign20, service-instance=IflytekCameraPerceptionParkingSlotList_DdsProvidedServiceInstance120
    RPortPrototype1_DdsRequiredServiceInstance193_PortMapping: port-prototype=soc_a_communication_libExecutable18Prototype.IflytekCameraPerceptionParkingLaneLine, process=soc_a_communication_libProcessDesign19, service-instance=IflytekCameraPerceptionParkingLaneLine_DdsRequiredServiceInstance193
    IflytekCameraPerceptionParkingLaneLine_DdsProvidedServiceInstance121_PortMapping: port-prototype=soc_b_communication_libExecutable19Prototype.IflytekCameraPerceptionParkingLaneLine, process=soc_b_communication_libProcessDesign20, service-instance=IflytekCameraPerceptionParkingLaneLine_DdsProvidedServiceInstance121
    RPortPrototype1_DdsRequiredServiceInstance194_PortMapping: port-prototype=soc_a_communication_libExecutable18Prototype.IflytekFusionObjectsCompress, process=soc_a_communication_libProcessDesign19, service-instance=IflytekFusionObjectsCompress_DdsRequiredServiceInstance194
    IflytekFusionObjectsCompress_DdsProvidedServiceInstance122_PortMapping: port-prototype=soc_b_communication_libExecutable19Prototype.IflytekFusionObjectsCompress, process=soc_b_communication_libProcessDesign20, service-instance=IflytekFusionObjectsCompress_DdsProvidedServiceInstance122
    RPortPrototype1_DdsRequiredServiceInstance195_PortMapping: port-prototype=soc_a_communication_libExecutable18Prototype.IflytekFusionUssPerceptionInfo, process=soc_a_communication_libProcessDesign19, service-instance=IflytekFusionUssPerceptionInfo_DdsRequiredServiceInstance195
    IflytekFusionUssPerceptionInfo_DdsProvidedServiceInstance123_PortMapping: port-prototype=soc_b_communication_libExecutable19Prototype.IflytekFusionUssPerceptionInfo, process=soc_b_communication_libProcessDesign20, service-instance=IflytekFusionUssPerceptionInfo_DdsProvidedServiceInstance123
    RPortPrototype1_DdsRequiredServiceInstance196_PortMapping: port-prototype=soc_a_communication_libExecutable18Prototype.IflytekFusionOccupancyObjects, process=soc_a_communication_libProcessDesign19, service-instance=IflytekFusionOccupancyObjects_DdsRequiredServiceInstance196
    IflytekFusionOccupancyObjects_DdsProvidedServiceInstance124_PortMapping: port-prototype=soc_b_communication_libExecutable19Prototype.IflytekFusionOccupancyObjects, process=soc_b_communication_libProcessDesign20, service-instance=IflytekFusionOccupancyObjects_DdsProvidedSocBCommunication
    RPortPrototype1_DdsRequiredServiceInstance197_PortMapping: port-prototype=soc_a_communication_libExecutable18Prototype.IflytekFusionRoadFusionCompress, process=soc_a_communication_libProcessDesign19, service-instance=IflytekFusionRoadFusionCompress_DdsRequiredServiceInstance197
    IflytekFusionRoadFusionCompress_DdsProvidedServiceInstance125_PortMapping: port-prototype=soc_b_communication_libExecutable19Prototype.IflytekFusionRoadFusionCompress, process=soc_b_communication_libProcessDesign20, service-instance=IflytekFusionRoadFusionCompress_DdsProvidedServiceInstance125
    RPortPrototype1_DdsRequiredServiceInstance198_PortMapping: port-prototype=soc_a_communication_libExecutable18Prototype.IflytekFusionGroundLine, process=soc_a_communication_libProcessDesign19, service-instance=IflytekFusionGroundLine_DdsRequiredServiceInstance198
    IflytekFusionGroundLine_DdsProvidedServiceInstance126_PortMapping: port-prototype=soc_b_communication_libExecutable19Prototype.IflytekFusionGroundLine, process=soc_b_communication_libProcessDesign20, service-instance=IflytekFusionGroundLine_DdsProvidedServiceInstance126
    RPortPrototype1_DdsRequiredServiceInstance199_PortMapping: port-prototype=soc_a_communication_libExecutable18Prototype.IflytekFusionSpeedBump, process=soc_a_communication_libProcessDesign19, service-instance=IflytekFusionSpeedBump_DdsRequiredServiceInstance199
    IflytekFusionSpeedBump_DdsProvidedServiceInstance127_PortMapping: port-prototype=soc_b_communication_libExecutable19Prototype.IflytekFusionSpeedBump, process=soc_b_communication_libProcessDesign20, service-instance=IflytekFusionSpeedBump_DdsProvidedServiceInstance127
    RPortPrototype1_DdsRequiredServiceInstance200_PortMapping: port-prototype=soc_a_communication_libExecutable18Prototype.IflytekUssUsswaveInfo, process=soc_a_communication_libProcessDesign19, service-instance=IflytekUssUsswaveInfo_DdsRequiredServiceInstance200
    IflytekUssUsswaveInfo_DdsProvidedServiceInstance128_PortMapping: port-prototype=soc_b_communication_libExecutable19Prototype.IflytekUssUsswaveInfo, process=soc_b_communication_libProcessDesign20, service-instance=IflytekUssUsswaveInfo_DdsProvidedServiceInstance128
    RPortPrototype1_DdsRequiredServiceInstance201_PortMapping: port-prototype=soc_a_communication_libExecutable18Prototype.IflytekRadarFlPerceptionInfo, process=soc_a_communication_libProcessDesign19, service-instance=IflytekRadarFlPerceptionInfo_DdsRequiredServiceInstance201
    RPortPrototype1_DdsRequiredServiceInstance202_PortMapping: port-prototype=soc_a_communication_libExecutable18Prototype.IflytekRadarFrPerceptionInfo, process=soc_a_communication_libProcessDesign19, service-instance=IflytekRadarFrPerceptionInfo_DdsRequiredServiceInstance202
    IflytekRadarFlPerceptionInfo_DdsProvidedServiceInstance129_PortMapping: port-prototype=soc_b_communication_libExecutable19Prototype.IflytekRadarFlPerceptionInfo, process=soc_b_communication_libProcessDesign20, service-instance=IflytekRadarFlPerceptionInfo_DdsProvidedServiceInstance129
    RPortPrototype1_DdsRequiredServiceInstance203_PortMapping: port-prototype=soc_a_communication_libExecutable18Prototype.IflytekRadarRlPerceptionInfo, process=soc_a_communication_libProcessDesign19, service-instance=IflytekRadarRlPerceptionInfo_DdsRequiredServiceInstance203
    IflytekRadarFrPerceptionInfo_DdsProvidedServiceInstance130_PortMapping: port-prototype=soc_b_communication_libExecutable19Prototype.IflytekRadarFrPerceptionInfo, process=soc_b_communication_libProcessDesign20, service-instance=IflytekRadarFrPerceptionInfo_DdsProvidedServiceInstance130
    IflytekRadarRlPerceptionInfo_DdsProvidedServiceInstance131_PortMapping: port-prototype=soc_b_communication_libExecutable19Prototype.IflytekRadarRlPerceptionInfo, process=soc_b_communication_libProcessDesign20, service-instance=IflytekRadarRlPerceptionInfo_DdsProvidedServiceInstance131
    RPortPrototype1_DdsRequiredServiceInstance204_PortMapping: port-prototype=soc_a_communication_libExecutable18Prototype.IflytekRadarRrPerceptionInfo, process=soc_a_communication_libProcessDesign19, service-instance=IflytekRadarRrPerceptionInfo_DdsRequiredServiceInstance204
    IflytekRadarRrPerceptionInfo_DdsProvidedServiceInstance132_PortMapping: port-prototype=soc_b_communication_libExecutable19Prototype.IflytekRadarRrPerceptionInfo, process=soc_b_communication_libProcessDesign20, service-instance=IflytekRadarRrPerceptionInfo_DdsProvidedServiceInstance132
    IflytekAdasFunctionAdas_DdsProvidedServiceInstance133_PortMapping: port-prototype=com_service_pnc_node_libExecutable1Prototype.IflytekAdasFunctionAdas, process=com_service_pnc_node_libProcessDesign2, service-instance=IflytekAdasFunctionAdas_DdsProvidedComServicePncNode
    RPortPrototype1_DdsRequiredServiceInstance205_PortMapping: port-prototype=soc_a_communication_libExecutable18Prototype.IflytekAdasFunctionAdas, process=soc_a_communication_libProcessDesign19, service-instance=IflytekAdasFunctionAdas_DdsRequiredServiceInstance205
    IflytekAdasFunctionAdas_DdsProvidedServiceInstance134_PortMapping: port-prototype=soc_b_communication_libExecutable19Prototype.IflytekAdasFunctionAdas, process=soc_b_communication_libProcessDesign20, service-instance=IflytekAdasFunctionAdas_DdsProvidedSocBCommunication
    RPortPrototype1_DdsRequiredServiceInstance206_PortMapping: port-prototype=soc_a_communication_libExecutable18Prototype.IflytekControlControlCommand, process=soc_a_communication_libProcessDesign19, service-instance=IflytekControlControlCommand_DdsRequiredServiceInstance206
    IflytekControlControlCommand_DdsProvidedServiceInstance135_PortMapping: port-prototype=soc_b_communication_libExecutable19Prototype.IflytekControlControlCommand, process=soc_b_communication_libProcessDesign20, service-instance=IflytekControlControlCommand_DdsProvidedServiceInstance135
    RPortPrototype1_DdsRequiredServiceInstance207_PortMapping: port-prototype=soc_a_communication_libExecutable18Prototype.IflytekAlarmInfoFmAService, process=soc_a_communication_libProcessDesign19, service-instance=IflytekAlarmInfoFmAService_DdsRequiredServiceInstance207
    RPortPrototype2_DdsRequiredServiceInstance208_PortMapping: port-prototype=soc_a_communication_libExecutable18Prototype.IflytekDTCInfoFmAService, process=soc_a_communication_libProcessDesign19, service-instance=IflytekDTCInfoFmAService_DdsRequiredServiceInstance208
    IflytekDTCInfoFmAService_DdsProvidedServiceInstance136_PortMapping: port-prototype=soc_b_communication_libExecutable19Prototype.IflytekDTCInfoFmAService, process=soc_b_communication_libProcessDesign20, service-instance=IflytekDTCInfoFmAService_DdsProvidedServiceInstance136
    IflytekAlarmInfoFmAService_DdsProvidedServiceInstance137_PortMapping: port-prototype=soc_b_communication_libExecutable19Prototype.IflytekAlarmInfoFmAService, process=soc_b_communication_libProcessDesign20, service-instance=IflytekAlarmInfoFmAService_DdsProvidedSocBCommunication
    RPortPrototype1_DdsRequiredServiceInstance208_PortMapping: port-prototype=calibration_libExecutable20Prototype.IflytekSensorCameraSideFr, process=calibration_libProcessDesign21, service-instance=IflytekSensorCameraSideFr_DdsRequiredCalibration
    RPortPrototype1_DdsRequiredServiceInstance208_PortMapping: port-prototype=calibration_libExecutable20Prototype.IflytekSensorCameraRear, process=calibration_libProcessDesign21, service-instance=IflytekSensorCameraRear_DdsRequiredCalibration
    IflytekPostSaleCalibrationActivation_ProvidedSomeipServiceInstance11_PortMapping: port-prototype=calibration_libExecutable20Prototype.IflytekPostSaleCalibrationActivation, process=calibration_libProcessDesign21, service-instance=IflytekPostSaleCalibrationActivation_ProvidedSomeipServiceInstance11
    RPortPrototype1_RequiredSomeipServiceInstance23_PortMapping: port-prototype=soc_b_communication_libExecutable19Prototype.IflytekPostSaleCalibrationActivation, process=soc_b_communication_libProcessDesign20, service-instance=IflytekPostSaleCalibrationActivation_RequiredSomeipSocBCommunication
    IflytekPostSaleCalibrationStop_ProvidedSomeipServiceInstance12_PortMapping: port-prototype=calibration_libExecutable20Prototype.IflytekPostSaleCalibrationStop, process=calibration_libProcessDesign21, service-instance=IflytekPostSaleCalibrationStop_ProvidedSomeipServiceInstance12
    RPortPrototype1_RequiredSomeipServiceInstance24_PortMapping: port-prototype=soc_b_communication_libExecutable19Prototype.IflytekPostSaleCalibrationStop, process=soc_b_communication_libProcessDesign20, service-instance=IflytekPostSaleCalibrationStop_RequiredSomeipSocBCommunication
    IflytekPostSaleCalibrationResult_ProvidedSomeipServiceInstance13_PortMapping: port-prototype=calibration_libExecutable20Prototype.IflytekPostSaleCalibrationResult, process=calibration_libProcessDesign21, service-instance=IflytekPostSaleCalibrationResult_ProvidedSomeipServiceInstance13
    RPortPrototype1_RequiredSomeipServiceInstance25_PortMapping: port-prototype=soc_b_communication_libExecutable19Prototype.IflytekPostSaleCalibrationResult, process=soc_b_communication_libProcessDesign20, service-instance=IflytekPostSaleCalibrationResult_RequiredSomeipSocBCommunication
    IflytekPostSaleCalibrationActivation_ProvidedSomeipServiceInstance14_PortMapping: port-prototype=soc_a_communication_libExecutable18Prototype.IflytekPostSaleCalibrationActivation, process=soc_a_communication_libProcessDesign19, service-instance=IflytekPostSaleCalibrationActivation_ProvidedSomeipSocACommunication
    IflytekPostSaleCalibrationStop_ProvidedSomeipServiceInstance15_PortMapping: port-prototype=soc_a_communication_libExecutable18Prototype.IflytekPostSaleCalibrationStop, process=soc_a_communication_libProcessDesign19, service-instance=IflytekPostSaleCalibrationStop_ProvidedSomeipSocACommunication
    IflytekPostSaleCalibrationResult_ProvidedSomeipServiceInstance16_PortMapping: port-prototype=soc_a_communication_libExecutable18Prototype.IflytekPostSaleCalibrationResult, process=soc_a_communication_libProcessDesign19, service-instance=IflytekPostSaleCalibrationResult_ProvidedSomeipSocACommunication
    RPortPrototype1_DdsRequiredServiceInstance207_PortMapping: port-prototype=camera_node_panorama_view_libExecutable16Prototype.IflytekAlarmInfoToBCamera, process=camera_node_panorama_view_libProcessDesign17, service-instance=IflytekAlarmInfoToBCamera_DdsRequiredCameraNodePanoramaView
    RPortPrototype1_DdsRequiredServiceInstance208_PortMapping: port-prototype=camera_node_around_view_libExecutable15Prototype.IflytekAlarmInfoToACamera, process=camera_node_around_view_libProcessDesign16, service-instance=IflytekAlarmInfoToACamera_DdsRequiredCameraNodeAroundView
    IflytekSystemVersion_DdsProvidedServiceInstance137_PortMapping: port-prototype=static_fusion_libExecutable4Prototype.IflytekSystemVersion, process=static_fusion_libProcessDesign5, service-instance=IflytekSystemVersion_DdsProvidedStaticFusion
    RPortPrototype1_DdsRequiredServiceInstance209_PortMapping: port-prototype=soc_a_communication_libExecutable18Prototype.IflytekSystemVersion, process=soc_a_communication_libProcessDesign19, service-instance=IflytekSystemVersion_DdsRequiredSocACommunication
    IflytekSystemVersion_DdsProvidedServiceInstance138_PortMapping: port-prototype=soc_b_communication_libExecutable19Prototype.IflytekSystemVersion, process=soc_b_communication_libProcessDesign20, service-instance=IflytekSystemVersion_DdsProvidedSocBCommunication
    RPortPrototype1_DdsRequiredServiceInstance210_PortMapping: port-prototype=soc_b_communication_libExecutable19Prototype.IflytekFdlTrigger, process=soc_b_communication_libProcessDesign20, service-instance=IflytekFdlTrigger_DdsRequiredSocBCommunication
    IflytekFdlTriggerAck_DdsProvidedServiceInstance139_PortMapping: port-prototype=soc_b_communication_libExecutable19Prototype.IflytekFdlTriggerAck, process=soc_b_communication_libProcessDesign20, service-instance=IflytekFdlTriggerAck_DdsProvidedSocBCommunication
    RPortPrototype1_DdsRequiredServiceInstance211_PortMapping: port-prototype=soc_a_communication_libExecutable18Prototype.IflytekFdlTriggerAck, process=soc_a_communication_libProcessDesign19, service-instance=IflytekFdlTriggerAck_DdsRequiredSocACommunication
    IflytekFdlTrigger_DdsProvidedServiceInstance140_PortMapping: port-prototype=soc_a_communication_libExecutable18Prototype.IflytekFdlTrigger, process=soc_a_communication_libProcessDesign19, service-instance=IflytekFdlTrigger_DdsProvidedSocACommunication
    IflytekMcuFmASentinel_DdsProvidedServiceInstance141_PortMapping: port-prototype=com_service_pnc_node_libExecutable1Prototype.IflytekMcuFmASentinel, process=com_service_pnc_node_libProcessDesign2, service-instance=IflytekMcuFmASentinel_DdsProvidedComServicePncNode
    RPortPrototype1_DdsRequiredServiceInstance212_PortMapping: port-prototype=com_service_pnc_node_libExecutable1Prototype.IflytekFmAMcuSentinel, process=com_service_pnc_node_libProcessDesign2, service-instance=IflytekFmAMcuSentinel_DdsRequiredComServicePncNode
    RPortPrototype1_DdsRequiredServiceInstance213_PortMapping: port-prototype=camera_node_around_view_libExecutable15Prototype.IflytekFmACameraSentinel, process=camera_node_around_view_libProcessDesign16, service-instance=IflytekFmACameraSentinel_DdsRequiredCameraNodeAroundView
    IflytekPlanningDebugInfo_DdsProvidedServiceInstance143_PortMapping: port-prototype=planning_libExecutable13Prototype.IflytekPlanningDebugInfo, process=planning_libProcessDesign14, service-instance=IflytekPlanningDebugInfo_DdsProvidedPlanning
    RPortPrototype1_DdsRequiredServiceInstance214_PortMapping: port-prototype=soc_a_communication_libExecutable18Prototype.IflytekPlanningDebugInfo, process=soc_a_communication_libProcessDesign19, service-instance=IflytekPlanningDebugInfo_DdsRequiredSocACommunication
    IflytekControlDebugInfo_DdsProvidedServiceInstance144_PortMapping: port-prototype=control_libExecutable2Prototype.IflytekControlDebugInfo, process=control_libProcessDesign3, service-instance=IflytekControlDebugInfo_DdsProvidedControl
    RPortPrototype1_DdsRequiredServiceInstance215_PortMapping: port-prototype=soc_a_communication_libExecutable18Prototype.IflytekControlDebugInfo, process=soc_a_communication_libProcessDesign19, service-instance=IflytekControlDebugInfo_DdsRequiredSocACommunication
    IflytekPlanningDebugInfo_DdsProvidedServiceInstance145_PortMapping: port-prototype=soc_b_communication_libExecutable19Prototype.IflytekPlanningDebugInfo, process=soc_b_communication_libProcessDesign20, service-instance=IflytekPlanningDebugInfo_DdsProvidedSocBCommunication
    IflytekControlDebugInfo_DdsProvidedServiceInstance146_PortMapping: port-prototype=soc_b_communication_libExecutable19Prototype.IflytekControlDebugInfo, process=soc_b_communication_libProcessDesign20, service-instance=IflytekControlDebugInfo_DdsProvidedSocBCommunication
    IflytekAdasFunctionDebugInfo_DdsProvidedServiceInstance147_PortMapping: port-prototype=com_service_pnc_node_libExecutable1Prototype.IflytekAdasFunctionDebugInfo, process=com_service_pnc_node_libProcessDesign2, service-instance=IflytekAdasFunctionDebugInfo_DdsProvidedComServicePncNode
    RPortPrototype1_DdsRequiredServiceInstance216_PortMapping: port-prototype=soc_a_communication_libExecutable18Prototype.IflytekAdasFunctionDebugInfo, process=soc_a_communication_libProcessDesign19, service-instance=IflytekAdasFunctionDebugInfo_DdsRequiredSocACommunication
    IflytekAdasFunctionDebugInfo_DdsProvidedServiceInstance148_PortMapping: port-prototype=soc_b_communication_libExecutable19Prototype.IflytekAdasFunctionDebugInfo, process=soc_b_communication_libProcessDesign20, service-instance=IflytekAdasFunctionDebugInfo_DdsProvidedSocBCommunication
    RPortPrototype1_DdsRequiredServiceInstance217_PortMapping: port-prototype=soc_b_communication_libExecutable19Prototype.IflytekRadarPerception4dTargetMcu, process=soc_b_communication_libProcessDesign20, service-instance=IflytekRadarPerception4dTargetMcu_DdsRequiredServiceInstance217
    IflytekRadarPerception4dTargetMcu_DdsProvidedServiceInstance149_PortMapping: port-prototype=soc_a_communication_libExecutable18Prototype.IflytekRadarPerception4dTargetMcu, process=soc_a_communication_libProcessDesign19, service-instance=IflytekRadarPerception4dTargetMcu_DdsProvidedServiceInstance149
    RPortPrototype1_DdsRequiredServiceInstance218_PortMapping: port-prototype=com_service_pnc_node_libExecutable1Prototype.IflytekRadarPerception4dTargetMcu, process=com_service_pnc_node_libProcessDesign2, service-instance=IflytekRadarPerception4dTargetMcu_DdsRequiredServiceInstance218
    RPortPrototype1_DdsRequiredServiceInstance219_PortMapping: port-prototype=finite_state_manager_libExecutable5Prototype.IflytekEngineerInner, process=finite_state_manager_libProcessDesign6, service-instance=IflytekEngineerInner_DdsRequiredFiniteStateManager
    RPortPrototype1_DdsRequiredServiceInstance220_PortMapping: port-prototype=soc_b_communication_libExecutable19Prototype.IflytekEngineerInner, process=soc_b_communication_libProcessDesign20, service-instance=IflytekEngineerInner_DdsRequiredSocBCommunication
    IflytekEngineerInner_DdsProvidedServiceInstance150_PortMapping: port-prototype=soc_a_communication_libExecutable18Prototype.IflytekEngineerInner, process=soc_a_communication_libProcessDesign19, service-instance=IflytekEngineerInner_DdsProvidedSocACommunication
    RPortPrototype1_DdsRequiredServiceInstance221_PortMapping: port-prototype=com_service_pnc_node_libExecutable1Prototype.IflytekFmAMcuDegradeFunciton, process=com_service_pnc_node_libProcessDesign2, service-instance=IflytekFmAMcuDegradeFunciton_DdsRequiredServiceInstance221
    RPortPrototype1_DdsRequiredServiceInstance222_PortMapping: port-prototype=planning_libExecutable13Prototype.IflytekFmADegradeFunciton, process=planning_libProcessDesign14, service-instance=IflytekFmADegradeFunciton_DdsRequiredServiceInstance222
    RPortPrototype1_DdsRequiredServiceInstance223_PortMapping: port-prototype=soc_a_communication_libExecutable18Prototype.IflytekFmADegradeFunciton, process=soc_a_communication_libProcessDesign19, service-instance=IflytekFmADegradeFunciton_DdsRequiredServiceInstance223
    IflytekFmADegradeFunciton_DdsProvidedServiceInstance151_PortMapping: port-prototype=soc_b_communication_libExecutable19Prototype.IflytekFmADegradeFunciton, process=soc_b_communication_libProcessDesign20, service-instance=IflytekFmADegradeFunciton_DdsProvidedServiceInstance151
    RPortPrototype1_DdsRequiredServiceInstance224_PortMapping: port-prototype=finite_state_manager_libExecutable5Prototype.IflytekFmADegradeFunciton, process=finite_state_manager_libProcessDesign6, service-instance=IflytekFmADegradeFunciton_DdsRequiredServiceInstance224
    RPortPrototype1_DdsRequiredServiceInstance225_PortMapping: port-prototype=soc_a_communication_libExecutable18Prototype.IflytekCameraPerceptionPanoramaView2DBoundingBoxes, process=soc_a_communication_libProcessDesign19, service-instance=IflytekCameraPerceptionPanoramaView2DBoundingBoxes_DdsRequiredServiceInstance225
    IflytekCameraPerceptionPanoramaView2DBoundingBoxes_DdsProvidedServiceInstance152_PortMapping: port-prototype=soc_b_communication_libExecutable19Prototype.IflytekCameraPerceptionPanoramaView2DBoundingBoxes, process=soc_b_communication_libProcessDesign20, service-instance=IflytekCameraPerceptionPanoramaView2DBoundingBoxes_DdsProvidedServiceInstance152
    RPortPrototype1_DdsRequiredServiceInstance226_PortMapping: port-prototype=camera_node_panorama_view_libExecutable16Prototype.IflytekCameraPerceptionPanoramaView2DBoundingBoxes, process=camera_node_panorama_view_libProcessDesign17, service-instance=IflytekCameraPerceptionPanoramaView2DBoundingBoxes_DdsRequiredServiceInstance226
    RPortPrototype1_DdsRequiredServiceInstance227_PortMapping: port-prototype=camera_node_around_view_libExecutable15Prototype.IflytekCameraPerceptionPanoramaView2DBoundingBoxes, process=camera_node_around_view_libProcessDesign16, service-instance=IflytekCameraPerceptionPanoramaView2DBoundingBoxes_DdsRequiredServiceInstance227
    RPortPrototype1_DdsRequiredServiceInstance228_PortMapping: port-prototype=camera_node_around_view_libExecutable15Prototype.IflytekCameraPerceptionAroundView2DBoundingBoxes, process=camera_node_around_view_libProcessDesign16, service-instance=IflytekCameraPerceptionAroundView2DBoundingBoxes_DdsRequiredServiceInstance228
    IflytekSensorCameraFront120FullResolutionClearH265_DdsProvidedServiceInstance153_PortMapping: port-prototype=camera_node_panorama_view_libExecutable16Prototype.IflytekSensorCameraFront120FullResolutionClearH265, process=camera_node_panorama_view_libProcessDesign17, service-instance=IflytekSensorCameraFront120FullResolutionClearH265_DdsProvidedServiceInstance153
    RPortPrototype1_DdsRequiredServiceInstance229_PortMapping: port-prototype=calibration_libExecutable20Prototype.IflytekSensorCameraFront120FullResolutionClearH265, process=calibration_libProcessDesign21, service-instance=IflytekSensorCameraFront120FullResolutionClearH265_DdsRequiredServiceInstance229
    RPortPrototype1_DdsRequiredServiceInstance230_PortMapping: port-prototype=soc_a_communication_libExecutable18Prototype.IflytekSensorCameraRearFullResolutionH265MDCA, process=soc_a_communication_libProcessDesign19, service-instance=IflytekSensorCameraRearFullResolutionH265MDCA_DdsRequiredSocACommunication
    IflytekSensorCameraRearFullResolutionH265MDCA_DdsProvidedServiceInstance154_PortMapping: port-prototype=soc_b_communication_libExecutable19Prototype.IflytekSensorCameraRearFullResolutionH265MDCA, process=soc_b_communication_libProcessDesign20, service-instance=IflytekSensorCameraRearFullResolutionH265MDCA_DdsProvidedSocBCommunication
    RPortPrototype1_DdsRequiredServiceInstance231_PortMapping: port-prototype=soc_a_communication_libExecutable18Prototype.IflytekFmAMcuSentinel, process=soc_a_communication_libProcessDesign19, service-instance=IflytekFmAMcuSentinel_DdsRequiredServiceInstance231
    IflytekFmAMcuSentinel_DdsProvidedServiceInstance155_PortMapping: port-prototype=soc_b_communication_libExecutable19Prototype.IflytekFmAMcuSentinel, process=soc_b_communication_libProcessDesign20, service-instance=IflytekFmAMcuSentinel_DdsProvidedServiceInstance155
    RPortPrototype1_DdsRequiredServiceInstance232_PortMapping: port-prototype=soc_a_communication_libExecutable18Prototype.IflytekMcuFmASentinel, process=soc_a_communication_libProcessDesign19, service-instance=IflytekMcuFmASentinel_DdsRequiredServiceInstance232
    IflytekMcuFmASentinel_DdsProvidedServiceInstance156_PortMapping: port-prototype=soc_b_communication_libExecutable19Prototype.IflytekMcuFmASentinel, process=soc_b_communication_libProcessDesign20, service-instance=IflytekMcuFmASentinel_DdsProvidedServiceInstance156
    RPortPrototype1_DdsRequiredServiceInstance233_PortMapping: port-prototype=soc_a_communication_libExecutable18Prototype.IflytekCameraPerceptionAroundView2DBoundingBoxes, process=soc_a_communication_libProcessDesign19, service-instance=IflytekCameraPerceptionAroundView2DBoundingBoxes_DdsRequiredServiceInstance233
    IflytekCameraPerceptionAroundView2DBoundingBoxes_DdsProvidedServiceInstance157_PortMapping: port-prototype=soc_b_communication_libExecutable19Prototype.IflytekCameraPerceptionAroundView2DBoundingBoxes, process=soc_b_communication_libProcessDesign20, service-instance=IflytekCameraPerceptionAroundView2DBoundingBoxes_DdsProvidedServiceInstance157
    IflytekEhrPhmReport_DdsProvidedServiceInstance158_PortMapping: port-prototype=ehr_libExecutable8Prototype.IflytekEhrPhmReport, process=ehr_libProcessDesign9, service-instance=IflytekEhrPhmReport_DdsProvidedEhr
    IflytekLocalizationPhmReport_DdsProvidedServiceInstance159_PortMapping: port-prototype=localization_libExecutable7Prototype.IflytekLocalizationPhmReport, process=localization_libProcessDesign8, service-instance=IflytekLocalizationPhmReport_DdsProvidedLocalization
    IflytekGnssPhmReport_DdsProvidedServiceInstance160_PortMapping: port-prototype=gnss_service_node_libExecutable17Prototype.IflytekGnssPhmReport, process=gnss_service_node_libProcessDesign18, service-instance=IflytekGnssPhmReport_DdsProvidedGnssServiceNode
    IflytekCameraPerceptionPanoramaPhmReport_DdsProvidedServiceInstance161_PortMapping: port-prototype=panorama_view_camera_perception_libExecutable10Prototype.IflytekCameraPerceptionPanoramaPhmReport, process=panorama_view_camera_perception_libProcessDesign11, service-instance=IflytekCameraPerceptionPanoramaPhmReport_DdsProvidedPanoramaViewCameraPerception
    IflytekFsmPhmReport_DdsProvidedServiceInstance162_PortMapping: port-prototype=finite_state_manager_libExecutable5Prototype.IflytekFsmPhmReport, process=finite_state_manager_libProcessDesign6, service-instance=IflytekFsmPhmReport_DdsProvidedFiniteStateManager
    IflytekCameraPanoramaPhmReport_DdsProvidedServiceInstance163_PortMapping: port-prototype=camera_node_panorama_view_libExecutable16Prototype.IflytekCameraPanoramaPhmReport, process=camera_node_panorama_view_libProcessDesign17, service-instance=IflytekCameraPanoramaPhmReport_DdsProvidedCameraNodePanoramaView
    IflytekFusionObstaclePhmReport_DdsProvidedServiceInstance164_PortMapping: port-prototype=obstacle_fusion_libExecutable3Prototype.IflytekFusionObstaclePhmReport, process=obstacle_fusion_libProcessDesign4, service-instance=IflytekFusionObstaclePhmReport_DdsProvidedObstacleFusion
    IflytekPlanningPhmReport_DdsProvidedServiceInstance165_PortMapping: port-prototype=planning_libExecutable13Prototype.IflytekPlanningPhmReport, process=planning_libProcessDesign14, service-instance=IflytekPlanningPhmReport_DdsProvidedPlanning
    IflytekComPncPhmReport_DdsProvidedServiceInstance166_PortMapping: port-prototype=com_service_pnc_node_libExecutable1Prototype.IflytekComPncPhmReport, process=com_service_pnc_node_libProcessDesign2, service-instance=IflytekComPncPhmReport_DdsProvidedComServicePncNode
    IflytekCameraAroundPhmReport_DdsProvidedServiceInstance167_PortMapping: port-prototype=camera_node_around_view_libExecutable15Prototype.IflytekCameraAroundPhmReport, process=camera_node_around_view_libProcessDesign16, service-instance=IflytekCameraAroundPhmReport_DdsProvidedCameraNodeAroundView
    IflytekControlPhmReport_DdsProvidedServiceInstance168_PortMapping: port-prototype=control_libExecutable2Prototype.IflytekControlPhmReport, process=control_libProcessDesign3, service-instance=IflytekControlPhmReport_DdsProvidedControl
    IflytekFusionStaticPhmReport_DdsProvidedServiceInstance169_PortMapping: port-prototype=static_fusion_libExecutable4Prototype.IflytekFusionStaticPhmReport, process=static_fusion_libProcessDesign5, service-instance=IflytekFusionStaticPhmReport_DdsProvidedStaticFusion
    RPortPrototype1_DdsRequiredServiceInstance234_PortMapping: port-prototype=soc_a_communication_libExecutable18Prototype.IflytekCameraPerception3dOccupancyObjects, process=soc_a_communication_libProcessDesign19, service-instance=IflytekCameraPerception3dOccupancyObjects_DdsRequiredServiceInstance234
    IflytekCameraPerception3dOccupancyObjects_DdsProvidedServiceInstance170_PortMapping: port-prototype=soc_b_communication_libExecutable19Prototype.IflytekCameraPerception3dOccupancyObjects, process=soc_b_communication_libProcessDesign20, service-instance=IflytekCameraPerception3dOccupancyObjects_DdsProvidedServiceInstance170
    IflytekSensorTboxTime_DdsProvidedServiceInstance169_PortMapping: port-prototype=com_service_pnc_node_libExecutable1Prototype.IflytekSensorTboxTime, process=com_service_pnc_node_libProcessDesign2, service-instance=IflytekSensorTboxTime_DdsProvidedComServicePncNode
    RPortPrototype1_DdsRequiredServiceInstance233_PortMapping: port-prototype=soc_a_communication_libExecutable18Prototype.IflytekSensorTboxTime, process=soc_a_communication_libProcessDesign19, service-instance=IflytekSensorTboxTime_DdsRequiredSocACommunication
    IflytekSensorTboxTime_DdsProvidedServiceInstance170_PortMapping: port-prototype=soc_b_communication_libExecutable19Prototype.IflytekSensorTboxTime, process=soc_b_communication_libProcessDesign20, service-instance=IflytekSensorTboxTime_DdsProvidedSocBCommunication
    RPortPrototype1_DdsRequiredServiceInstance234_PortMapping: port-prototype=gnss_service_node_libExecutable17Prototype.IflytekSensorTboxTime, process=gnss_service_node_libProcessDesign18, service-instance=IflytekSensorTboxTime_DdsRequiredGnssServiceNode
    RPortPrototype1_DdsRequiredServiceInstance235_PortMapping: port-prototype=camera_node_around_view_libExecutable15Prototype.IflytekVehicleService, process=camera_node_around_view_libProcessDesign16, service-instance=IflytekVehicleService_DdsRequiredCameraNodeAroundView
    RPortPrototype1_DdsRequiredServiceInstance236_PortMapping: port-prototype=camera_node_around_view_libExecutable15Prototype.IflytekFsmSocState, process=camera_node_around_view_libProcessDesign16, service-instance=IflytekFsmSocState_DdsRequiredCameraNodeAroundView
    IflytekCameraState_DdsProvidedServiceInstance171_PortMapping: port-prototype=camera_node_around_view_libExecutable15Prototype.IflytekCameraState, process=camera_node_around_view_libProcessDesign16, service-instance=IflytekCameraState_DdsProvidedCameraNodeAroundView
    RPortPrototype1_DdsRequiredServiceInstance239_PortMapping: port-prototype=soc_b_communication_libExecutable19Prototype.IflytekFdlUploadState, process=soc_b_communication_libProcessDesign20, service-instance=IflytekFdlUploadState_DdsRequiredSocBCommunication
    IflytekFdlUploadState_DdsProvidedServiceInstance173_PortMapping: port-prototype=soc_a_communication_libExecutable18Prototype.IflytekFdlUploadState, process=soc_a_communication_libProcessDesign19, service-instance=IflytekFdlUploadState_DdsProvidedServiceInstance173
    RPortPrototype1_RequiredSomeipServiceInstance26_PortMapping: port-prototype=soc_b_communication_libExecutable19Prototype.IflytekFdlNetStatCheck, process=soc_b_communication_libProcessDesign20, service-instance=IflytekFdlNetStatCheck_RequiredSomeipSocBCommunication
    IflytekFdlNetStatCheck_ProvidedSomeipServiceInstance17_PortMapping: port-prototype=soc_a_communication_libExecutable18Prototype.IflytekFdlNetStatCheck, process=soc_a_communication_libProcessDesign19, service-instance=IflytekFdlNetStatCheck_ProvidedSomeipSocACommunication
    RPortPrototype1_DdsRequiredServiceInstance240_PortMapping: port-prototype=soc_b_communication_libExecutable19Prototype.IflytekDiskSpaceInfoPhmBOta, process=soc_b_communication_libProcessDesign20, service-instance=IflytekDiskSpaceInfoPhmBOta_DdsRequiredSocBCommunication
    IflytekDiskSpaceInfoPhmBOta_DdsProvidedServiceInstance174_PortMapping: port-prototype=soc_a_communication_libExecutable18Prototype.IflytekDiskSpaceInfoPhmBOta, process=soc_a_communication_libProcessDesign19, service-instance=IflytekDiskSpaceInfoPhmBOta_DdsProvidedSocACommunication
    RPortPrototype1_DdsRequiredServiceInstance241_PortMapping: port-prototype=soc_a_communication_libExecutable18Prototype.IflytekDiskCleanRequest, process=soc_a_communication_libProcessDesign19, service-instance=IflytekDiskCleanRequest_DdsRequiredSocACommunication
    IflytekDiskCleanRequest_DdsProvidedServiceInstance175_PortMapping: port-prototype=soc_b_communication_libExecutable19Prototype.IflytekDiskCleanRequest, process=soc_b_communication_libProcessDesign20, service-instance=IflytekDiskCleanRequest_DdsProvidedSocBCommunication
    RPortPrototype1_DdsRequiredServiceInstance242_PortMapping: port-prototype=soc_a_communication_libExecutable18Prototype.IflytekDiskStatePhmAFdl, process=soc_a_communication_libProcessDesign19, service-instance=IflytekDiskStatePhmAFdl_DdsRequiredSocACommunication
    IflytekDiskStatePhmAFdl_DdsProvidedServiceInstance176_PortMapping: port-prototype=soc_b_communication_libExecutable19Prototype.IflytekDiskStatePhmAFdl, process=soc_b_communication_libProcessDesign20, service-instance=IflytekDiskStatePhmAFdl_DdsProvidedSocBCommunication
    RPortPrototype1_DdsRequiredServiceInstance243_PortMapping: port-prototype=soc_a_communication_libExecutable18Prototype.IflytekDiskCleanRequestPhmAFdl, process=soc_a_communication_libProcessDesign19, service-instance=IflytekDiskCleanRequestPhmAFdl_DdsRequiredServiceInstance243
    IflytekDiskCleanRequestPhmAFdl_DdsProvidedServiceInstance177_PortMapping: port-prototype=soc_b_communication_libExecutable19Prototype.IflytekDiskCleanRequestPhmAFdl, process=soc_b_communication_libProcessDesign20, service-instance=IflytekDiskCleanRequestPhmAFdl_DdsProvidedSocBCommunication
    IflytekCalibrationPhmReport_DdsProvidedServiceInstance178_PortMapping: port-prototype=calibration_libExecutable20Prototype.IflytekCalibrationPhmReport, process=calibration_libProcessDesign21, service-instance=IflytekCalibrationPhmReport_DdsProvidedCalibration
    IflytekCalibrationDebugInfo_DdsProvidedServiceInstance179_PortMapping: port-prototype=calibration_libExecutable20Prototype.IflytekCalibrationDebugInfo, process=calibration_libProcessDesign21, service-instance=IflytekCalibrationDebugInfo_DdsProvidedCalibration
    RPortPrototype1_DdsRequiredServiceInstance237_PortMapping: port-prototype=soc_a_communication_libExecutable18Prototype.IflytekEhpParkingMap, process=soc_a_communication_libProcessDesign19, service-instance=IflytekEhpParkingMap_DdsRequiredSocACommunication
    IflytekEhpParkingMap_DdsProvidedServiceInstance179_PortMapping: port-prototype=soc_b_communication_libExecutable19Prototype.IflytekEhpParkingMap, process=soc_b_communication_libProcessDesign20, service-instance=IflytekEhpParkingMap_DdsProvidedSocBCommunication
    RPortPrototype1_DdsRequiredServiceInstance238_PortMapping: port-prototype=localization_libExecutable7Prototype.IflytekEhpParkingMap, process=localization_libProcessDesign8, service-instance=IflytekEhpParkingMap_DdsRequiredLocalization
    RPortPrototype1_DdsRequiredServiceInstance239_PortMapping: port-prototype=ehr_libExecutable8Prototype.IflytekEhpParkingMap, process=ehr_libProcessDesign9, service-instance=IflytekEhpParkingMap_DdsRequiredEhr
    RPortPrototype1_DdsRequiredServiceInstance240_PortMapping: port-prototype=finite_state_manager_libExecutable5Prototype.IflytekEhpParkingMap, process=finite_state_manager_libProcessDesign6, service-instance=IflytekEhpParkingMap_DdsRequiredFiniteStateManager
    RPortPrototype1_DdsRequiredServiceInstance241_PortMapping: port-prototype=soc_a_communication_libExecutable18Prototype.IflytekEhpParkingMapFileInfo, process=soc_a_communication_libProcessDesign19, service-instance=IflytekEhpParkingMapFileInfo_DdsRequiredSocACommunication
    IflytekEhpParkingMapFileInfo_DdsProvidedServiceInstance180_PortMapping: port-prototype=soc_b_communication_libExecutable19Prototype.IflytekEhpParkingMapFileInfo, process=soc_b_communication_libProcessDesign20, service-instance=IflytekEhpParkingMapFileInfo_DdsProvidedSocBCommunication
    RPortPrototype1_DdsRequiredServiceInstance242_PortMapping: port-prototype=soc_a_communication_libExecutable18Prototype.IflytekEhpMapManager, process=soc_a_communication_libProcessDesign19, service-instance=IflytekEhpMapManager_DdsRequiredSocACommunication
    IflytekEhpMapManager_DdsProvidedServiceInstance181_PortMapping: port-prototype=soc_b_communication_libExecutable19Prototype.IflytekEhpMapManager, process=soc_b_communication_libProcessDesign20, service-instance=IflytekEhpMapManager_DdsProvidedSocBCommunication
    RPortPrototype1_DdsRequiredServiceInstance243_PortMapping: port-prototype=finite_state_manager_libExecutable5Prototype.IflytekEhpMapManager, process=finite_state_manager_libProcessDesign6, service-instance=IflytekEhpMapManager_DdsRequiredFiniteStateManager
    IflytekSensorGnss_DdsProvidedServiceInstance182_PortMapping: port-prototype=soc_a_communication_libExecutable18Prototype.IflytekSensorGnss, process=soc_a_communication_libProcessDesign19, service-instance=IflytekSensorGnss_DdsProvidedSocACommunication
    IflytekCameraAroundErrorStatus_DdsProvidedServiceInstance183_PortMapping: port-prototype=camera_node_around_view_libExecutable15Prototype.IflytekCameraAroundErrorStatus, process=camera_node_around_view_libProcessDesign16, service-instance=IflytekCameraAroundErrorStatus_DdsProvidedCameraNodeAroundView
    RPortPrototype1_DdsRequiredServiceInstance244_PortMapping: port-prototype=com_service_pnc_node_libExecutable1Prototype.IflytekCameraAroundErrorStatus, process=com_service_pnc_node_libProcessDesign2, service-instance=IflytekCameraAroundErrorStatus_DdsRequiredComServicePncNode
    RPortPrototype1_RequiredSomeipServiceInstance27_PortMapping: port-prototype=soc_b_communication_libExecutable19Prototype.IflytekOtaLogUploadRequest, process=soc_b_communication_libProcessDesign20, service-instance=IflytekOtaLogUploadRequest_RequiredSomeipSocBCommunication
    IflytekOtaLogUploadRequest_ProvidedSomeipServiceInstance18_PortMapping: port-prototype=soc_a_communication_libExecutable18Prototype.IflytekOtaLogUploadRequest, process=soc_a_communication_libProcessDesign19, service-instance=IflytekOtaLogUploadRequest_ProvidedSomeipSocACommunication
    IflytekCalibrationCalibInfo_DdsProvidedServiceInstance184_PortMapping: port-prototype=soc_a_communication_libExecutable18Prototype.IflytekCalibrationCalibInfo, process=soc_a_communication_libProcessDesign19, service-instance=IflytekCalibrationCalibInfo_DdsProvidedSocACommunication
    RPortPrototype1_DdsRequiredServiceInstance245_PortMapping: port-prototype=soc_a_communication_libExecutable18Prototype.IflytekSystemAProcessLoading, process=soc_a_communication_libProcessDesign19, service-instance=IflytekSystemAProcessLoading_DdsRequiredSocACommunication
    IflytekSystemAProcessLoading_DdsProvidedServiceInstance185_PortMapping: port-prototype=soc_b_communication_libExecutable19Prototype.IflytekSystemAProcessLoading, process=soc_b_communication_libProcessDesign20, service-instance=IflytekSystemAProcessLoading_DdsProvidedSocBCommunition
    RPortPrototype1_DdsRequiredServiceInstance238_PortMapping: port-prototype=planning_libExecutable13Prototype.IflytekCameraPerceptionDrivableSpaceGrid, process=planning_libProcessDesign14, service-instance=IflytekCameraPerceptionDrivableSpaceGrid_DdsRequiredPlanning
    RPortPrototype1_DdsRequiredServiceInstance239_PortMapping: port-prototype=soc_a_communication_libExecutable18Prototype.IflytekCameraPerceptionDrivableSpaceGrid, process=soc_a_communication_libProcessDesign19, service-instance=IflytekCameraPerceptionDrivableSpaceGrid_DdsRequiredSocACommunication
    IflytekCameraPerceptionDrivableSpaceGrid_DdsProvidedServiceInstance182_PortMapping: port-prototype=soc_b_communication_libExecutable19Prototype.IflytekCameraPerceptionDrivableSpaceGrid, process=soc_b_communication_libProcessDesign20, service-instance=IflytekCameraPerceptionDrivableSpaceGrid_DdsProvidedSocBCommunication
    RPortPrototype1_DdsRequiredServiceInstance240_PortMapping: port-prototype=finite_state_manager_libExecutable5Prototype.IflytekCameraPerceptionDrivableSpaceGrid, process=finite_state_manager_libProcessDesign6, service-instance=IflytekCameraPerceptionDrivableSpaceGrid_DdsRequiredFiniteStateManager
    IflytekCameraPerceptionObstacleFeature_DdsProvidedServiceInstance181_PortMapping: port-prototype=panorama_view_camera_perception_libExecutable10Prototype.IflytekCameraPerceptionObstacleFeature, process=panorama_view_camera_perception_libProcessDesign11, service-instance=IflytekCameraPerceptionObstacleFeature_DdsProvidedPanoramaViewCameraPerception
    RPortPrototype1_DdsRequiredServiceInstance240_PortMapping: port-prototype=soc_b_communication_libExecutable19Prototype.IflytekCameraPerceptionObstacleFeature, process=soc_b_communication_libProcessDesign20, service-instance=IflytekCameraPerceptionObstacleFeature_DdsRequiredSocBCommunication
    IflytekCameraPerceptionLaneFeature_DdsProvidedServiceInstance182_PortMapping: port-prototype=panorama_view_camera_perception_libExecutable10Prototype.IflytekCameraPerceptionLaneFeature, process=panorama_view_camera_perception_libProcessDesign11, service-instance=IflytekCameraPerceptionLaneFeature_DdsProvidedPanoramaViewCameraPerception
    RPortPrototype1_DdsRequiredServiceInstance241_PortMapping: port-prototype=soc_b_communication_libExecutable19Prototype.IflytekCameraPerceptionLaneFeature, process=soc_b_communication_libProcessDesign20, service-instance=IflytekCameraPerceptionLaneFeature_DdsRequiredSocBCommunication
    IflytekCameraPerceptionObstacleFeature_DdsProvidedServiceInstance183_PortMapping: port-prototype=soc_a_communication_libExecutable18Prototype.IflytekCameraPerceptionObstacleFeature, process=soc_a_communication_libProcessDesign19, service-instance=IflytekCameraPerceptionObstacleFeature_DdsProvidedSocACommunication
    IflytekCameraPerceptionLaneFeature_DdsProvidedServiceInstance184_PortMapping: port-prototype=soc_a_communication_libExecutable18Prototype.IflytekCameraPerceptionLaneFeature, process=soc_a_communication_libProcessDesign19, service-instance=IflytekCameraPerceptionLaneFeature_DdsProvidedSocACommunication
    RPortPrototype1_DdsRequiredServiceInstance242_PortMapping: port-prototype=finite_state_manager_libExecutable5Prototype.IflytekFusionOccupancyObjects, process=finite_state_manager_libProcessDesign6, service-instance=IflytekFusionOccupancyObjects_DdsRequiredFiniteStateManager
    RPortPrototype1_DdsRequiredServiceInstance243_PortMapping: port-prototype=soc_a_communication_libExecutable18Prototype.IflytekEhpParkingMapToHmi, process=soc_a_communication_libProcessDesign19, service-instance=IflytekEhpParkingMapToHmi_DdsRequiredSocACommunication
    IflytekEhpParkingMapToHmi_DdsProvidedServiceInstance185_PortMapping: port-prototype=soc_b_communication_libExecutable19Prototype.IflytekEhpParkingMapToHmi, process=soc_b_communication_libProcessDesign20, service-instance=IflytekEhpParkingMapToHmi_DdsProvidedSocBCommunication
    IflytekCanTxInfo_DdsProvidedServiceInstance186_PortMapping: port-prototype=com_service_pnc_node_libExecutable1Prototype.IflytekCanTxInfo, process=com_service_pnc_node_libProcessDesign2, service-instance=IflytekCanTxInfo_DdsProvidedComServicePncNode
    RPortPrototype1_DdsRequiredServiceInstance244_PortMapping: port-prototype=soc_a_communication_libExecutable18Prototype.IflytekCanTxInfo, process=soc_a_communication_libProcessDesign19, service-instance=IflytekCanTxInfo_DdsRequiredSocACommunication
    IflytekCanTxInfo_DdsProvidedServiceInstance187_PortMapping: port-prototype=soc_b_communication_libExecutable19Prototype.IflytekCanTxInfo, process=soc_b_communication_libProcessDesign20, service-instance=IflytekCanTxInfo_DdsProvidedSocBCommunication
    RPortPrototype1_DdsRequiredServiceInstance245_PortMapping: port-prototype=static_fusion_libExecutable4Prototype.IflytekMegaMappingStatus, process=static_fusion_libProcessDesign5, service-instance=IflytekMegaMappingStatus_DdsRequiredStaticFusion
    RPortPrototype1_DdsRequiredServiceInstance246_PortMapping: port-prototype=finite_state_manager_libExecutable5Prototype.IflytekAdasFunctionAdas, process=finite_state_manager_libProcessDesign6, service-instance=IflytekAdasFunctionAdas_DdsRequiredFiniteStateManager
package /HuaweiMDC/Common/Common
  composition sw component type com_service_pnc_node_libCompositionSwComponentType1
    component com_service_pnc_node_libPrototype: type=com_service_pnc_node_lib
  composition sw component type control_libCompositionSwComponentType2
    component control_libPrototype: type=control_lib
  composition sw component type obstacle_fusion_libCompositionSwComponentType3
    component obstacle_fusion_libPrototype: type=obstacle_fusion_lib
  composition sw component type static_fusion_libCompositionSwComponentType4
    component static_fusion_libPrototype: type=static_fusion_lib
  composition sw component type finite_state_manager_libCompositionSwComponentType5
    component finite_state_manager_libPrototype: type=finite_state_manager_lib
  composition sw component type localization_libCompositionSwComponentType7
    component localization_libPrototype: type=localization_lib
  composition sw component type ehr_libCompositionSwComponentType8
    component ehr_libPrototype: type=ehr_lib
  composition sw component type panorama_view_camera_perception_libCompositionSwComponentType10
    component panorama_view_camera_perception_libPrototype: type=panorama_view_camera_perception_lib
  composition sw component type uss_perception_libCompositionSwComponentType12
    component uss_perception_libPrototype: type=uss_perception_lib
  composition sw component type planning_libCompositionSwComponentType13
    component planning_libPrototype: type=planning_lib
  composition sw component type camera_node_around_view_libCompositionSwComponentType15
    component camera_node_around_view_libPrototype: type=camera_node_around_view_lib
  composition sw component type camera_node_panorama_view_libCompositionSwComponentType16
    component camera_node_panorama_view_libPrototype: type=camera_node_panorama_view_lib
  composition sw component type gnss_service_node_libCompositionSwComponentType17
    component gnss_service_node_libPrototype: type=gnss_service_node_lib
  composition sw component type soc_a_communication_libCompositionSwComponentType18
    component soc_a_communication_libPrototype: type=soc_a_communication_lib
  composition sw component type soc_b_communication_libCompositionSwComponentType19
    component soc_b_communication_libPrototype: type=soc_b_communication_lib
  composition sw component type common_swc_libCompositionSwComponentType22
    component common_swc_libPrototype: type=common_swc_lib
  composition sw component type common_swc_libCompositionSwComponentType23
    component common_swc_libPrototype: type=common_swc_lib
  composition sw component type calibration_libCompositionSwComponentType20
    component calibration_libPrototype: type=calibration_lib
package /HuaweiMDC/interface_manifests/interfaces
  service interface StructContainerInterface
    namespaces:
      symbol props iflyauto
      symbol props struct_container
    events:
      data event: type=ByteVector
  service interface CameraStructContainerInterface
    namespaces:
      symbol props iflyauto
      symbol props camera_struct_container
    events:
      data event: type=CameraStructContainer
  service interface ClientServiceContainerInterface
    namespaces:
      symbol props iflyauto
      symbol props struct_container
    methods:
      operation method
        arg msg: type=StructContainer, direction=IN
        arg result: type=StructContainer, direction=OUT
package /HuaweiMDC/interface_manifests/deploymentImpls
  dds service interface deployment StructContainerDdsInterfaceDeployment: service-interface=StructContainerInterface, service-interface-id=1
    dds event deployment eventDdsDeployment: event=StructContainerInterface/event, frag-size=409600, list-size=20, topic-name=TopicOfevent
  dds service interface deployment CameraStructContainerDdsInterfaceDeployment: service-interface=CameraStructContainerInterface, service-interface-id=2
    dds event deployment DdsEventDeployment: event=CameraStructContainerInterface/event, topic-name=TopicOfevent
  someip service interface deployment ClientServiceContainerInterfaceDeployment: service-interface=ClientServiceContainerInterface, service-interface-id=3, service-interface-version={major-version=1, minor-version=0}
    someip method deployment methodSomeipDeployment: method=method, method-id=1, transport-protocol=TCP
    someip event group SomeipEventGroup: event-group-id=2
package /HuaweiMDC/interface_manifests/datatypes
  std cpp implementation data type rawBuffer: category=RAWBUFFER
  std cpp implementation data type StructContainer: category=VECTOR, cpp-template-argument=UInt8
    namespaces:
      symbol props iflyauto
      symbol props struct_container
